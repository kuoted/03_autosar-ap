[part 3 of 4: package /AUTOSAR/AISpecification/PortPrototypeBlueprints_Blueprint]
AUTOSAR XML (schema 00051)
package /AUTOSAR/AISpecification/PortPrototypeBlueprints_Blueprint  (continued)
  2210 x port prototype blueprint:  (continued)
    LiFltOfLiForReadingAtRowThrdCen: interface=LiFltSt1  # Interior Light Source Fault Status | Feedback from the light actuators to be informed of possible fault situation; initial value: NoFlt
    LiFltOfLiForReadingAtRowThrdLe: interface=LiFltSt1  # Interior Light Source Fault Status | Feedback from the light actuators to be informed of possible fault situation; initial value: NoFlt
    LiFltOfLiForReadingAtRowThrdRi: interface=LiFltSt1  # Interior Light Source Fault Status | Feedback from the light actuators to be informed of possible fault situation; initial value: NoFlt
    LiFltOfLiForReadingFrntCen: interface=LiFltSt1  # Interior Light Source Fault Status | Feedback from the light actuators to be informed of possible fault situation; initial value: NoFlt
    LiFltOfLiForReadingFrntLe: interface=LiFltSt1  # Interior Light Source Fault Status | Feedback from the light actuators to be informed of possible fault situation; initial value: NoFlt
    LiFltOfLiForReadingFrntRi: interface=LiFltSt1  # Interior Light Source Fault Status | Feedback from the light actuators to be informed of possible fault situation; initial value: NoFlt
    LiFltOfLiForReadingGroup: interface=LiFltSt1  # Interior Light Source Fault Status | Feedback from the light actuators to be informed of possible fault situation; initial value: NoFlt
    LiFltOfLiForReadingReCen: interface=LiFltSt1  # Interior Light Source Fault Status | Feedback from the light actuators to be informed of possible fault situation; initial value: NoFlt
    LiFltOfLiForReadingReLe: interface=LiFltSt1  # Interior Light Source Fault Status | Feedback from the light actuators to be informed of possible fault situation; initial value: NoFlt
    LiFltOfLiForReadingReRi: interface=LiFltSt1  # Interior Light Source Fault Status | Feedback from the light actuators to be informed of possible fault situation; initial value: NoFlt
    LiFltOfLiForSftyBltLockIllmnFrntCen: interface=LiFltSt1  # Interior Light Source Fault Status | Feedback from the light actuators to be informed of possible fault situation; initial value: NoFlt
    LiFltOfLiForSftyBltLockIllmnFrntLe: interface=LiFltSt1  # Interior Light Source Fault Status | Feedback from the light actuators to be informed of possible fault situation; initial value: NoFlt
    LiFltOfLiForSftyBltLockIllmnFrntRi: interface=LiFltSt1  # Interior Light Source Fault Status | Feedback from the light actuators to be informed of possible fault situation; initial value: NoFlt
    LiFltOfLiForSftyBltLockIllmnGroup: interface=LiFltSt1  # Interior Light Source Fault Status | Feedback from the light actuators to be informed of possible fault situation; initial value: NoFlt
    LiFltOfLiForSftyBltLockIllmnMidCen: interface=LiFltSt1  # Interior Light Source Fault Status | Feedback from the light actuators to be informed of possible fault situation; initial value: NoFlt
    LiFltOfLiForSftyBltLockIllmnMidLe: interface=LiFltSt1  # Interior Light Source Fault Status | Feedback from the light actuators to be informed of possible fault situation; initial value: NoFlt
    LiFltOfLiForSftyBltLockIllmnMidRi: interface=LiFltSt1  # Interior Light Source Fault Status | Feedback from the light actuators to be informed of possible fault situation; initial value: NoFlt
    LiFltOfLiForSftyBltLockIllmnReCen: interface=LiFltSt1  # Interior Light Source Fault Status | Feedback from the light actuators to be informed of possible fault situation; initial value: NoFlt
    LiFltOfLiForSftyBltLockIllmnReLe: interface=LiFltSt1  # Interior Light Source Fault Status | Feedback from the light actuators to be informed of possible fault situation; initial value: NoFlt
    LiFltOfLiForSftyBltLockIllmnReRi: interface=LiFltSt1  # Interior Light Source Fault Status | Feedback from the light actuators to be informed of possible fault situation; initial value: NoFlt
    LiFltOfLiLeForRvsg: interface=LiFltSt1  # Exterior Light Source Fault Status | Feedback for Exterior Light Source Fault Status
    LiFltOfLiRiForRvsg: interface=LiFltSt1  # Exterior Light Source Fault Status | Feedback for Exterior Light Source Fault Status
    LiFltOfLiTrlrPlateNr: interface=LiFltSt1  # Exterior Light Source Fault Status | Feedback for Exterior Light Source Fault Status
    LiFltOfLiVehPlateNr: interface=LiFltSt1  # Exterior Light Source Fault Status | Feedback for Exterior Light Source Fault Status
    LiFltOfPrkgLiFrntLe: interface=LiFltSt1  # Exterior Light Source Fault Status | Feedback for Exterior Light Source Fault Status
    LiFltOfPrkgLiFrntRi: interface=LiFltSt1  # Exterior Light Source Fault Status | Feedback for Exterior Light Source Fault Status
    LiFltOfPrkgLiReLe: interface=LiFltSt1  # Exterior Light Source Fault Status | Feedback for Exterior Light Source Fault Status
    LiFltOfPrkgLiReRi: interface=LiFltSt1  # Exterior Light Source Fault Status | Feedback for Exterior Light Source Fault Status
    LiFltOfPrkgLiTrlrLe: interface=LiFltSt1  # Exterior Light Source Fault Status | Feedback for Exterior Light Source Fault Status
    LiFltOfPrkgLiTrlrRi: interface=LiFltSt1  # Exterior Light Source Fault Status | Feedback for Exterior Light Source Fault Status
    LiFltOfPuddleLiFrntLe: interface=LiFltSt1  # Exterior Light Source Fault Status | Feedback for Exterior Light Source Fault Status
    LiFltOfPuddleLiFrntRi: interface=LiFltSt1  # Exterior Light Source Fault Status | Feedback for Exterior Light Source Fault Status
    LiFltOfPuddleLiReLe: interface=LiFltSt1  # Exterior Light Source Fault Status | Feedback for Exterior Light Source Fault Status
    LiFltOfPuddleLiReRi: interface=LiFltSt1  # Exterior Light Source Fault Status | Feedback for Exterior Light Source Fault Status
    LiFltOfSideMkrCenLe: interface=LiFltSt1  # Exterior Light Source Fault Status | Feedback for Exterior Light Source Fault Status
    LiFltOfSideMkrCenRi: interface=LiFltSt1  # Exterior Light Source Fault Status | Feedback for Exterior Light Source Fault Status
    LiFltOfSideMkrFrntLe: interface=LiFltSt1  # Exterior Light Source Fault Status | Feedback for Exterior Light Source Fault Status
    LiFltOfSideMkrFrntRi: interface=LiFltSt1  # Exterior Light Source Fault Status | Feedback for Exterior Light Source Fault Status
    LiFltOfSideMkrReLe: interface=LiFltSt1  # Exterior Light Source Fault Status | Feedback for Exterior Light Source Fault Status
    LiFltOfSideMkrReRi: interface=LiFltSt1  # Exterior Light Source Fault Status | Feedback for Exterior Light Source Fault Status
    LiFltOfSwtIllmnForHzrdWarn: interface=LiFltSt1  # Fault Status of Hazard Warning Switch Illumination | Feedback from the hazard warning switch light actuators to be informed of possible fault situation; initial value: NoFlt
    LiFltOfTrCmptmtGroup: interface=LiFltSt1  # Interior Light Source Fault Status | Feedback from the light actuators to be informed of possible fault situation; initial value: NoFlt
    LiFltOfTrCmptmtLiCen: interface=LiFltSt1  # Interior Light Source Fault Status | Feedback from the light actuators to be informed of possible fault situation; initial value: NoFlt
    LiFltOfTrCmptmtLiLoLe: interface=LiFltSt1  # Interior Light Source Fault Status | Feedback from the light actuators to be informed of possible fault situation; initial value: NoFlt
    LiFltOfTrCmptmtLiLoRi: interface=LiFltSt1  # Interior Light Source Fault Status | Feedback from the light actuators to be informed of possible fault situation; initial value: NoFlt
    LiFltOfTrCmptmtLiUpLe: interface=LiFltSt1  # Interior Light Source Fault Status | Feedback from the light actuators to be informed of possible fault situation; initial value: NoFlt
    LiFltOfTrCmptmtLiUpRi: interface=LiFltSt1  # Interior Light Source Fault Status | Feedback from the light actuators to be informed of possible fault situation; initial value: NoFlt
    LiFltOfTrlrLiLeForRvsg: interface=LiFltSt1  # Exterior Light Source Fault Status | Feedback for Exterior Light Source Fault Status
    LiFltOfTrlrLiRiForRvsg: interface=LiFltSt1  # Exterior Light Source Fault Status | Feedback for Exterior Light Source Fault Status
    LiFltOfVanityLiFrntLe: interface=LiFltSt1  # Interior Light Source Fault Status | Feedback from the light actuators to be informed of possible fault situation; initial value: NoFlt
    LiFltOfVanityLiFrntRi: interface=LiFltSt1  # Interior Light Source Fault Status | Feedback from the light actuators to be informed of possible fault situation; initial value: NoFlt
    LiFltOfVanityLiGroup: interface=LiFltSt1  # Interior Light Source Fault Status | Feedback from the light actuators to be informed of possible fault situation; initial value: NoFlt
    LiFltOfVanityLiMidLe: interface=LiFltSt1  # Interior Light Source Fault Status | Feedback from the light actuators to be informed of possible fault situation; initial value: NoFlt
    LiFltOfVanityLiMidRi: interface=LiFltSt1  # Interior Light Source Fault Status | Feedback from the light actuators to be informed of possible fault situation; initial value: NoFlt
    LiFltOfVanityLiReLe: interface=LiFltSt1  # Interior Light Source Fault Status | Feedback from the light actuators to be informed of possible fault situation; initial value: NoFlt
    LiFltOfVanityLiReRi: interface=LiFltSt1  # Interior Light Source Fault Status | Feedback from the light actuators to be informed of possible fault situation; initial value: NoFlt
    LiHomeCmngAndHomeLvng: interface=LiExtCmd1  # Coming Home Leaving Home Light | This port provides command to activate coming home/leaving home lights
    LiOnWarn: interface=LiOnWarnReq1  # Lights On Warning | This port provides request for chimer (buzzer) signalling the Lights On status e.g. when Ignition was turned off with Lights On and driver door opened.
    LiPlateNr: interface=LiExtCmd1  # License Plate Illumniation | This port provides command to turn on/off number plate lights
    LiPlateNrOut: interface=LiExtCmd1  # License Plate Illumination Output | This port provides command to turn on/off number plate lights
    LiRvsg: interface=LiExtCmd1  # Reversing Light | This port provides command to turn on/off reverse lights
    LiRvsgOut: interface=LiExtCmd1  # Reversing Light Output | This port provides command to turn on/off reverse lights
    LidAcsRemRe: interface=LockgCenReq1  # Access Remote Rear Lid | Request to activate the central locking master by a remote system to have access to the rear lid
    LidReFromHmiExt: interface=LtchRelsReq1  # Lid Rear from HMI External | User request to release/unlock the rear lid of the vehicle. This request is done outside the vehicle.
    LidReFromHmiInt: interface=LtchRelsReq1  # Lid Rear from HMI Internal | User request to release/unlock the rear lid of the vehicle. This request is done inside the vehicle.
    LidReSt: interface=DoorSt1  # Rear Lid Status | Information of the rear lid, indicates whether the lid is opened or closed
    LidReSts: interface=DoorSts1  # Rear Lid Status | Information of the rear lid, indicates whether the lid is opened or closed
    ListOfObjData: interface=ListOfObjData1  # List of Object Data | List of object attributes detected by forward looking sensor. This information is used for Adaptive Cruise Control (ACC), but not limited for ACC.
    ListOfObjDataAftFusn: interface=ListOfObjData1  # List of Object Data after Fusion | List of object attributes after sensor data fusion.
    LockSt: interface=LockSt1  # Doorlock Status | information about the current locking state of the door
    LockStOfDoorLockReLe: interface=LockSt1  # Rear Doorlock State | information about the current locking state of a rear door
    LockStOfDoorLockReRi: interface=LockSt1  # Rear Doorlock State | information about the current locking state of a rear door
    LockStOfDrvrDoorLock: interface=LockSt1  # Front Doorlock State | information about the current locking state of a front door
    LockStOfLidRe: interface=LockSt1  # Rear Lid Lock State | information about the current locking state of the lid
    LockStOfPassDoorLock: interface=LockSt1  # Front Doorlock State | information about the current locking state of a front door
    LockStOfSteerCol: interface=LockStOfSteerCol1  # Steering Column Lock Status | Indication about the locking status of the steering column
    LockStsOfSteerCol: interface=LockStsOfSteerCol1  # Steering Column Lock Status | Indication about the locking status of the steering column
    LockgCen: interface=LockgCenSt1  # Central Locking | Information related to the state of the central locking of the vehicle
    LockgCmd: interface=LockCmd1  # Door Locking Command | Locking command related to a door. This command locks or unlocks the door.
    LockgCmdOfDoorLockReLe: interface=LockCmd1  # Rear Door Locking Command | Locking command related to a rear door. This command locks or unlocks the door.
    LockgCmdOfDoorLockReRi: interface=LockCmd1  # Rear Door Locking Command | Locking command related to a rear door. This command locks or unlocks the door.
    LockgCmdOfDrvrDoorLock: interface=LockCmd1  # Front Door Locking Command | Locking command related to a front door. This command locks or unlocks the door.
    LockgCmdOfLidRe: interface=LockCmd1  # Locking Command of Rear Lid | Locking command related to rear lid. This command locks or unlocks the lid
    LockgCmdOfPassDoorLock: interface=LockCmd1  # Front Door Locking Command | Locking command related to a front door. This command locks or unlocks the door.
    LockgFb: interface=LockgFbReq1  # Locking Feedback | Request to have a feedback on the locking state of the vehicle
    LocnOfPaseKeyls: interface=TrsmPosn1  # Location of Pase Keyless | Needed to know whether the Keyless is inside or outside the car
    LtchRelsOfLidRe: interface=DiagcLtchRels1  # Latch Release of Lid Rear | Diagnostic request to the sensor component to release/unlock the latch of rear lid
    MassgAdj: interface=MassgAdjReq1  # Massage Function Request | Request from Human Machine Interface (HMI) of the desired massage function to be activated
    MassgAdjOfDrvrSeat: interface=MassgAdjReq1  # Massage Function Request | Request from Human Machine Interface (HMI) of the desired massage function to be activated
    MassgAdjOfPassSeat: interface=MassgAdjReq1  # Massage Function Request | Request from Human Machine Interface (HMI) of the desired massage function to be activated
    MassgAdjOfSeatRowFirstMid: interface=MassgAdjReq1  # Massage Function Request | Request from Human Machine Interface (HMI) of the desired massage function to be activated
    MassgAdjOfSeatRowSecLe: interface=MassgAdjReq1  # Massage Function Request | Request from Human Machine Interface (HMI) of the desired massage function to be activated
    MassgAdjOfSeatRowSecMid: interface=MassgAdjReq1  # Massage Function Request | Request from Human Machine Interface (HMI) of the desired massage function to be activated
    MassgAdjOfSeatRowSecRi: interface=MassgAdjReq1  # Massage Function Request | Request from Human Machine Interface (HMI) of the desired massage function to be activated
    MassgAdjOfSeatRowThrdLe: interface=MassgAdjReq1  # Massage Function Request | Request from Human Machine Interface (HMI) of the desired massage function to be activated
    MassgAdjOfSeatRowThrdMid: interface=MassgAdjReq1  # Massage Function Request | Request from Human Machine Interface (HMI) of the desired massage function to be activated
    MassgAdjOfSeatRowThrdRi: interface=MassgAdjReq1  # Massage Function Request | Request from Human Machine Interface (HMI) of the desired massage function to be activated
    MassgSt: interface=MassgAdjSt1  # Massage Function Status | status of the active massage functions
    MassgStOfDrvrSeat: interface=MassgAdjSt1  # Massage Function Status | Inform Human Machine Interface (HMI) about status of the active massage functions
    MassgStOfPassSeat: interface=MassgAdjSt1  # Massage Function Status | Inform Human Machine Interface (HMI) about status of the active massage functions
    MassgStOfSeatRowFirstMid: interface=MassgAdjSt1  # Massage Function Status | Inform Human Machine Interface (HMI) about status of the active massage functions
    MassgStOfSeatRowSecLe: interface=MassgAdjSt1  # Massage Function Status | Inform Human Machine Interface (HMI) about status of the active massage functions
    MassgStOfSeatRowSecMid: interface=MassgAdjSt1  # Massage Function Status | Inform Human Machine Interface (HMI) about status of the active massage functions
    MassgStOfSeatRowSecRi: interface=MassgAdjSt1  # Massage Function Status | Inform Human Machine Interface (HMI) about status of the active massage functions
    MassgStOfSeatRowThrdLe: interface=MassgAdjSt1  # Massage Function Status | Inform Human Machine Interface (HMI) about status of the active massage functions
    MassgStOfSeatRowThrdMid: interface=MassgAdjSt1  # Massage Function Status | Inform Human Machine Interface (HMI) about status of the active massage functions
    MassgStOfSeatRowThrdRi: interface=MassgAdjSt1  # Massage Function Status | Inform Human Machine Interface (HMI) about status of the active massage functions
    MassgSts: interface=MassgAdjSts1  # Massage Function Status | status of the active massage functions
    MassgStsOfDrvrSeat: interface=MassgAdjSts1  # Massage Function Status | Inform Human Machine Interface (HMI) about status of the active massage functions
    MassgStsOfPassSeat: interface=MassgAdjSts1  # Massage Function Status | Inform Human Machine Interface (HMI) about status of the active massage functions
    MassgStsOfSeatRowFirstMid: interface=MassgAdjSts1  # Massage Function Status | Inform Human Machine Interface (HMI) about status of the active massage functions
    MassgStsOfSeatRowSecLe: interface=MassgAdjSts1  # Massage Function Status | Inform Human Machine Interface (HMI) about status of the active massage functions
    MassgStsOfSeatRowSecMid: interface=MassgAdjSts1  # Massage Function Status | Inform Human Machine Interface (HMI) about status of the active massage functions
    MassgStsOfSeatRowSecRi: interface=MassgAdjSts1  # Massage Function Status | Inform Human Machine Interface (HMI) about status of the active massage functions
    MassgStsOfSeatRowThrdLe: interface=MassgAdjSts1  # Massage Function Status | Inform Human Machine Interface (HMI) about status of the active massage functions
    MassgStsOfSeatRowThrdMid: interface=MassgAdjSts1  # Massage Function Status | Inform Human Machine Interface (HMI) about status of the active massage functions
    MassgStsOfSeatRowThrdRi: interface=MassgAdjSts1  # Massage Function Status | Inform Human Machine Interface (HMI) about status of the active massage functions
    Milg: interface=Milg1  # Mileage | Travelled total distance (in km) of the vehicle.
    MirrActnSt: interface=MirrActnSt1  # Mirror Action State | Information on the mirror, it indicates whether the mirror is in action or not
    MirrActvn: interface=MirrMoveCmd1  # Mirror Activation | Command to activate/deactivate the movement of the mirror.
    MirrAdjAutToRestoreProf{0..3}FromHmi: interface=MirrPanAdjAutReq1  # Mirror Auto Adjust Restore Profile {0..3} from HMI | User request to move the mirror automatically according to the profile {0..3}
    MirrAdjAutToStoreProf0FromHmi: interface=MirrPanAdjAutReq1  # Mirror Auto Adjust Store Profile 0 from HMI | User request to store the mirror position in the profile 0.
    MirrAdjAutToStoreProf1FromHmi: interface=MirrPanAdjAutReq1  # Mirror Auto Adjust Store Profile 1 from HMI | User request to store the mirror position in the profile 1.
    MirrAdjAutToStoreProf2FromHmi: interface=MirrPanAdjAutReq1  # Mirror Auto Adjust Store Profile 2 from HMI | User request to store the mirror position in the profile 2.
    MirrAdjAutToStoreProf3FromHmi: interface=MirrPanAdjAutReq1  # Mirror Auto Adjust Store Profile 3 from HMI | User request to store the mirror position in the profile 3.
    MirrDefrstReqFromHmi: interface=DefrstReq1  # Mirror Defrost Request from HMI | Port for Mirror Defrost Request From Hmi
    MirrFlt: interface=MirrFltSt1  # Mirror Fault | Information related to the state of the mirror (broken or not)
    MirrMemPosnStore: interface=MirrPosnStoreToMemReq1  # Store Mirror Position into Memory | Request to store the position of the mirror in a non volatile memory
    MirrMove: interface=MirrMoveReq1  # Mirror Move | Request to move the mirror
    MirrMoveAut: interface=MirrMoveAutReq1  # Mirror Auto Move | Request to move the mirror automatically
    MirrMoveSt: interface=MirrMoveSt1  # Mirror Move Status | Information on the movement of the mirror
    MirrMoveSts: interface=MirrMoveSts1  # Mirror Move Status | Information on the movement of the mirror
    MirrMovmtManFromHmi: interface=PanAdjmtManReq1  # Mirror Manual Movement from HMI | User request to move the axis of the mirror manually in a certain direction.
    MirrPosn: interface=MirrPosnSt1  # Mirror Position | Status of position of the mirror
    MirrPosnRestore: interface=MemOfMirrPosn1  # Restore Mirror Position | Request to restore the position of the mirror saved in a non volatile memory
    MirrPosnStore: interface=MirrPosnStoreReq1  # Mirror Store Position | Request to save and store the position of the mirror
    MonrPReqForTirePMon: interface=MonrPReqForTirePMon1  # Monitored Pressure Request for Tire Pressure Monitoring | Request by driver that the current measured tire pressure values have to be monitored by Tire Pressure Monitoring (direct measuring systems).
    MonrPTarReqForTirePMon: interface=MonrPTarReqForTirePMon1  # Monitored Pressure Target Request for Tire Pressure Monitoring | Indication that the transmitted target tire pressure values have to be monitored by Tire Pressure Monitoring (direct measuring systems).
    NightPanActv: interface=NightPanReq1  # Night Panel Active | This port provides the information about the "Night-Panel-Switch" (e.g. switch for dimming down all interior lights except for speedometer)
    NoFuCutOffReq: interface=NoFuCutOffReq1  # No Fuel Cut Off Request | Request suppression of engine fuel cut off.
    NozHeatrActvn: interface=NozHeatrCmd1  # Nozzle Heater Activation | Activate nozzle and/or tube heating.
    NozHeatrActvnOfNozHeatrFrnt: interface=NozHeatrCmd1  # Activation of Nozzle Heater | Activate nozzle and/or tube heating.
    NozHeatrActvnOfNozHeatrHdlamp: interface=NozHeatrCmd1  # Activation of Nozzle Heater | Activate nozzle and/or tube heating.
    NozHeatrActvnOfNozHeatrRe: interface=NozHeatrCmd1  # Activation of Nozzle Heater | Activate nozzle and/or tube heating.
    NozHeatrSt: interface=NozHeatrSt1  # Nozzle Heater Status | Feedback on nozzle heater status and failure.
    NozHeatrStOfNozHeatrFrnt: interface=NozHeatrSt1  # Status of Nozzle Heater | Feedback on nozzle heater status and failure.
    NozHeatrStOfNozHeatrHdlamp: interface=NozHeatrSt1  # Status of Nozzle Heater | Feedback on nozzle heater status and failure.
    NozHeatrStOfNozHeatrRe: interface=NozHeatrSt1  # Status of Nozzle Heater | Feedback on nozzle heater status and failure.
    NozHeatrSts: interface=NozHeatrSts1  # Nozzle Heater Status | Feedback on nozzle heater status and failure.
    NozHeatrStsOfNozHeatrFrnt: interface=NozHeatrSts1  # Status of Nozzle Heater | Feedback on nozzle heater status and failure.
    NozHeatrStsOfNozHeatrHdlamp: interface=NozHeatrSts1  # Status of Nozzle Heater | Feedback on nozzle heater status and failure.
    NozHeatrStsOfNozHeatrRe: interface=NozHeatrSts1  # Status of Nozzle Heater | Feedback on nozzle heater status and failure.
    ObjTarSelnForFolwCtrl: interface=ObjTarSelnForFolwCtrl1  # Object Target Selection for Follow Control | List of relevant object attributes and prioritization of objects for Follow Control.
    ObstclDstInPrkgSegFrntInnrLe: interface=ObstclDstInPrkgSeg1  # Obstacle Distance Park Segment Front Inner Left | Distance to obstacle detected in front inner left park segment measured by ultrasonic sensors. Triangulation is considered (fused signal).
    ObstclDstInPrkgSegFrntInnrRi: interface=ObstclDstInPrkgSeg1  # Obstacle Distance Park Segment Front Inner Right | Distance to obstacle detected in front inner right park segment measured by ultrasonic sensors. Triangulation is considered (fused signal).
    ObstclDstInPrkgSegFrntOutrLe: interface=ObstclDstInPrkgSeg1  # Obstacle Distance Park Segment Front Outer Left | Distance to obstacle detected in front outer left park segment measured by ultrasonic sensors. Triangulation is considered (fused signal).
    ObstclDstInPrkgSegFrntOutrRi: interface=ObstclDstInPrkgSeg1  # Obstacle Distance Park Segment Front Outer Right | Distance to obstacle detected in front outer right park segment measured by ultrasonic sensors. Triangulation is considered (fused signal).
    ObstclDstInPrkgSegReInnrLe: interface=ObstclDstInPrkgSeg1  # Obstacle Distance Park Segment Rear Inner Left | Distance to obstacle detected in rear inner left park segment measured by ultrasonic sensors. Triangulation is considered (fused signal).
    ObstclDstInPrkgSegReInnrRi: interface=ObstclDstInPrkgSeg1  # Obstacle Distance Park Segment Rear Inner Right | Distance to obstacle detected in rear inner right park segment measured by ultrasonic sensors. Triangulation is considered (fused signal).
    ObstclDstInPrkgSegReOutrLe: interface=ObstclDstInPrkgSeg1  # Obstacle Distance Park Segment Rear Outer Left | Distance to obstacle detected in rear outer left park segment measured by ultrasonic sensors. Triangulation is considered (fused signal).
    ObstclDstInPrkgSegReOutrRi: interface=ObstclDstInPrkgSeg1  # Obstacle Distance Park Segment Rear Outer Right | Distance to obstacle detected in rear outer right park segment measured by ultrasonic sensors. Triangulation is considered (fused signal).
    OccptClassAtDrvr: interface=OccptClass1  # Occupant Class at Driver | classification of driver
    OccptClassAtPass: interface=OccptClass1  # Occupant Class at Passenger | classification of passenger
    OccptClassAtRowFirstMid: interface=OccptClass1  # Occupant Class at Row First Middle | classification of occupant at first row, middle seat position
    OccptClassAtRowSecLe: interface=OccptClass1  # Occupant Class at Row Second Left | classification of occupant at second row, left seat position
    OccptClassAtRowSecMid: interface=OccptClass1  # Occupant Class at Row Second Middle | classification of occupant at second row, middle seat position
    OccptClassAtRowSecRi: interface=OccptClass1  # Occupant Class at Row Second Right | classification of occupant at second row, right seat position
    OccptClassAtRowThrdLe: interface=OccptClass1  # Occupant Class at Row Third Left | classification of occupant at third row, left seat position
    OccptClassAtRowThrdMid: interface=OccptClass1  # Occupant Class at Row Third Middle | classification of occupant at third row, middle seat position
    OccptClassAtRowThrdRi: interface=OccptClass1  # Occupant Class at Row Third Right | classification of occupant at third row, right seat position
    OccptOutOfPosAtDrvr: interface=OccptOutOfPos1  # Occupant out of Position at Driver | Detection of OOP (out of position) condition at driver position
    OccptOutOfPosAtPass: interface=OccptOutOfPos1  # Occupant out of Position at Passenger | Detection of OOP (out of position) condition at passenger position
    OccptOutOfPosAtRowFirstMid: interface=OccptOutOfPos1  # Occupant out of Position at Row First Middle | Detection of OOP (out of position) condition at first row, middle position
    OccptOutOfPosAtRowSecLe: interface=OccptOutOfPos1  # Occupant out of Position at Row Second Left | Detection of OOP (out of position) condition at second row, left position
    OccptOutOfPosAtRowSecMid: interface=OccptOutOfPos1  # Occupant out of Position at Row Second Middle | Detection of OOP (out of position) condition at second row, middle position
    OccptOutOfPosAtRowSecRi: interface=OccptOutOfPos1  # Occupant out of Position at Row Second Right | Detection of OOP (out of position) condition at second row, right position
    OccptOutOfPosAtRowThrdLe: interface=OccptOutOfPos1  # Occupant out of Position at Row Third Left | Detection of OOP (out of position) condition at third row, left position
    OccptOutOfPosAtRowThrdMid: interface=OccptOutOfPos1  # Occupant out of Position at Row Third Middle | Detection of OOP (out of position) condition at third row, middle position
    OccptOutOfPosAtRowThrdRi: interface=OccptOutOfPos1  # Occupant out of Position at Row Third Right | Detection of OOP (out of position) condition at third row, right position
    OccptWghtMeasdAtDrvr: interface=OccptWght1  # Occupant Weight Measured at Driver | weight of driver
    OccptWghtMeasdAtPass: interface=OccptWght1  # Occupant Weight Measured at Passenger | weight of passenger
    OccptWghtMeasdAtRowFirstMid: interface=OccptWght1  # Occupant Weight Measured at Row First Middle | weight of occupant at first row, middle seat position
    OccptWghtMeasdAtRowSecLe: interface=OccptWght1  # Occupant Weight Measured at Row Second Left | weight of occupant at second row, left seat position
    OccptWghtMeasdAtRowSecMid: interface=OccptWght1  # Occupant Weight Measured at Row Second Middle | weight of occupant at second row, middle seat position
    OccptWghtMeasdAtRowSecRi: interface=OccptWght1  # Occupant Weight Measured at Row Second Right | weight of occupant at second row, right seat position
    OccptWghtMeasdAtRowThrdLe: interface=OccptWght1  # Occupant Weight Measured at Row Third Left | weight of occupant at third row, left seat position
    OccptWghtMeasdAtRowThrdMid: interface=OccptWght1  # Occupant Weight Measured at Row Third Middle | weight of occupant at third row, middle seat position
    OccptWghtMeasdAtRowThrdRi: interface=OccptWght1  # Occupant Weight Measured at Row Third Right | weight of occupant at third row, right seat position
    OccptWghtStdAtDrvr: interface=OccptWght1  # Occupant Weight Standard at Driver | weight of driver
    OccptWghtStdAtPass: interface=OccptWght1  # Occupant Weight Standard at Passenger | weight of passenger
    OccptWghtStdAtRowFirstMid: interface=OccptWght1  # Occupant Weight Standard at Row First Middle | weight of occupant at first row, middle seat position
    OccptWghtStdAtRowSecLe: interface=OccptWght1  # Occupant Weight Standard at Row Second Left | weight of occupant at second row, left seat position
    OccptWghtStdAtRowSecMid: interface=OccptWght1  # Occupant Weight Standard at Row Second Middle | weight of occupant at second row, middle seat position
    OccptWghtStdAtRowSecRi: interface=OccptWght1  # Occupant Weight Standard at Row Second Right | weight of occupant at second row, right seat position
    OccptWghtStdAtRowThrdLe: interface=OccptWght1  # Occupant Weight Standard at Row Third Left | weight of occupant at third row, left seat position
    OccptWghtStdAtRowThrdMid: interface=OccptWght1  # Occupant Weight Standard at Row Third Middle | weight of occupant at third row, middle seat position
    OccptWghtStdAtRowThrdRi: interface=OccptWght1  # Occupant Weight Standard at Row Third Right | weight of occupant at third row, right seat position
    OpenClsCmft: interface=LockgCenReq1  # Comfort Open Close | Locking request for comfort devices such as sunroof or windows
    OperMod: interface=OperModSt1  # Operation Mode | This port provides the vehicle operation states. It can be seen as an abstraction and extension of the normal ignition switch position (also called "clamp position") which is traditionally used to guide functional operation of the vehicle. It also includes information about what state the engine is in, i.e. running or not. This port should be used to control which functionalities / components are active in the vehicle. All states have to be implemented in all vehicles, but not necessarily used.
    OutdBri: interface=OutdBriSt1  # Outside Brightness | information on outside brightness
    OutdT: interface=AmbAirT1  # Outside Temperature | Current ambient air temperature outside the vehicle, also called environment temperature. | Ambient air temperature close to the vehicle. Data format for typical network representation for series projects: Uint8 Unit: °C Type: linear Resolution: 1 Offset: -40 Physically used range: Hex Lower/Upper Limit: 0h / FDh Physical Lower/Upper Limit: -40 / 213 Special values outside the physically used range: FEh = Init FFh = Error, Signal content invalid Cycle Time: 1000 ms (max.) for internal calculation and bus communication. Typical Provider: Body or Powertrain Typical Receiver: Transmission
    OutpMplSt256: interface=OutpMplSt256  # Multiple Output 256 States | The value is used to generate feedback to the user about the system's current state. The value represents one of 256 states, mutually excluding each other, the system can be in or has changed to.
    OutpMplSt4: interface=OutpMplSt4  # Multiple Output 4 States | The value is used to generate feedback to the user about the system's current state. The value represents one of four states, mutually excluding each other, the system can be in or has changed to.
    OutpMplSt8: interface=OutpMplSt8  # Multiple Output 8 States | The value is used to generate feedback to the user about the system's current state. The value represents one of eight states, mutually excluding each other, the system can be in or has changed to.
    PInDoorAtFrntLe: interface=PExtForOccptPedSfty1  # Pressure in Door at Front Left | Differential pressure measured in front left door of vehicle (locking in driving direction)
    PInDoorAtFrntRi: interface=PExtForOccptPedSfty1  # Pressure in Door at Front Right | Differential pressure measured in front right door of vehicle (locking in driving direction)
    PInDoorAtReLe: interface=PExtForOccptPedSfty1  # Pressure in Door at Rear Left | Differential pressure measured in rear left door of vehicle (locking in driving direction)
    PInDoorAtReRi: interface=PExtForOccptPedSfty1  # Pressure in Door at Rear Right | Differential pressure measured in rear right door of vehicle (locking in driving direction)
    PanAdjAut: interface=SeatAdjAut1  # Automatic Seat Adjust Panel | Indicates the user's demands to store and recall seat positions.
    PanAdjAutOfDrvrSeat: interface=SeatAdjAut1  # Automatic Seat Adjust Panel | Indicates the user's demands to store and recall seat positions.
    PanAdjAutOfPassSeat: interface=SeatAdjAut1  # Automatic Seat Adjust Panel | Indicates the user's demands to store and recall seat positions.
    PanAdjAutOfSeatRowFirstMid: interface=SeatAdjAut1  # Automatic Seat Adjust Panel | Indicates the user's demands to store and recall seat positions.
    PanAdjAutOfSeatRowSecLe: interface=SeatAdjAut1  # Automatic Seat Adjust Panel | Indicates the user's demands to store and recall seat positions.
    PanAdjAutOfSeatRowSecMid: interface=SeatAdjAut1  # Automatic Seat Adjust Panel | Indicates the user's demands to store and recall seat positions.
    PanAdjAutOfSeatRowSecRi: interface=SeatAdjAut1  # Automatic Seat Adjust Panel | Indicates the user's demands to store and recall seat positions.
    PanAdjAutOfSeatRowThrdLe: interface=SeatAdjAut1  # Automatic Seat Adjust Panel | Indicates the user's demands to store and recall seat positions.
    PanAdjAutOfSeatRowThrdMid: interface=SeatAdjAut1  # Automatic Seat Adjust Panel | Indicates the user's demands to store and recall seat positions.
    PanAdjAutOfSeatRowThrdRi: interface=SeatAdjAut1  # Automatic Seat Adjust Panel | Indicates the user's demands to store and recall seat positions.
    PanAdjMan: interface=SeatAdjMan1  # Manual Seat Adjust Panel | Enables the user to activate one or more seat actuators using a manual movement control panel.
    PanAdjManOfDrvrSeat: interface=SeatAdjMan1  # Manual Seat Adjust Panel | Enables the user to activate one or more seat actuators using a manual movement control panel.
    PanAdjManOfPassSeat: interface=SeatAdjMan1  # Manual Seat Adjust Panel | Enables the user to activate one or more seat actuators using a manual movement control panel.
    PanAdjManOfSeatRowFirstMid: interface=SeatAdjMan1  # Manual Seat Adjust Panel | Enables the user to activate one or more seat actuators using a manual movement control panel.
    PanAdjManOfSeatRowSecLe: interface=SeatAdjMan1  # Manual Seat Adjust Panel | Enables the user to activate one or more seat actuators using a manual movement control panel.
    PanAdjManOfSeatRowSecMid: interface=SeatAdjMan1  # Manual Seat Adjust Panel | Enables the user to activate one or more seat actuators using a manual movement control panel.
    PanAdjManOfSeatRowSecRi: interface=SeatAdjMan1  # Manual Seat Adjust Panel | Enables the user to activate one or more seat actuators using a manual movement control panel.
    PanAdjManOfSeatRowThrdLe: interface=SeatAdjMan1  # Manual Seat Adjust Panel | Enables the user to activate one or more seat actuators using a manual movement control panel.
    PanAdjManOfSeatRowThrdMid: interface=SeatAdjMan1  # Manual Seat Adjust Panel | Enables the user to activate one or more seat actuators using a manual movement control panel.
    PanAdjManOfSeatRowThrdRi: interface=SeatAdjMan1  # Manual Seat Adjust Panel | Enables the user to activate one or more seat actuators using a manual movement control panel.
    PanicActvnMan: interface=PanicTog1  # Manual Panic Alarm Activation Switch | Information related to panic alarm activation | Example of usage: driver presses a button in order to start/stop panic alarm warning with horn and/or flashers.
    PanicAlrmSt: interface=PanicAlrmSt1  # Panic Alarm State | State of the panic alarm
    PaseAcsRemKeylsForTrsm: interface=LockgCenReq1  # Pase Access Remote Keyless for Transmission | Request for locking or unlocking from the transmitter of Passive Entry (PASE)
    PaseAcsRemKeylsRxn: interface=LockgCenReq1  # Access Remote Pase Keyless Reception | Request for locking or unlocking from the transmitter to the receiver of Passive Entry (PASE)
    PaseActvn: interface=PaseActvnSt1  # Pase Activation | Information related to the activation of passive entry activity
    PaseIdCfmd: interface=IdCfmdSt1  # Passive Entry Identifier Comfirmed | Information that the Passive entry emitter is known signalised within the state of the identifier: confirmed or not
    PaseKeylsInvld: interface=PaseKeylsInvldSt1  # Pase Keyless Invalid | State on the validity of the functionality passive entry
    PasePanic: interface=PasePanicReq1  # Pase Panic | Request related to the panic alert communicated by the passive entry system
    PassBtnForSeatClima: interface=HmiBtn1  # Passenger Button from HMI for Seat Climatisation | Passenger Button Activation From Hmi (on, off) for Seat Climatisation
    PassDoorKeyPad: interface=LockgCenReq1  # Passenger Door Keypad | Request to activate central locking master from the passenger door key pad
    PassDoorKeyPadOfLidRe: interface=LockgCenReq1  # Passenger Door Keypad Rear Lid | Request to activate central locking master on the rear lid from the passenger door key pad
    PassStgDispForSeatClima: interface=StgDisp1  # Passenger Stage Display for Seat Climatisation to HMI | Feedback to Hmi of Passenger Stage requested
    PassStgForSeatClima: interface=StgReq1  # Passenger Stage Request for Seat Climatisation | Passenger Stage Request (no climatisation, heating level, cooling level)
    PedCrashSevCalcd: interface=CrashSev1  # Pedestrian Crash Severity Caculated | Calculated severity of front crash to pedestrian
    PedCrashYposCalcd: interface=CrashYpos1  # Pedestrian Crash Yposition Calculated | Impact position of pedestrian at front bumper in case of vehicle-to-pedestrian collision
    PinionSteerAgFrntBas: interface=PinionSteerAg1  # Pinion Steering Angle Front Base | Measured pinion steer angle at the front steering device.
    PinionSteerAgFrntMeasd: interface=PinionSteerAg1  # Pinion Steering Angle Front Measured | Calculated pinion steer angle at the front steering device. Conditioned Signal (Filtering, Offset-Compensation, Model-based Plausibility Check, etc.)
    PinionSteerAgFrntRaw: interface=PinionSteerAg1  # Pinion Steering Angle Front Raw | Measured pinion steer angle at the front steering device.
    PinionSteerAgFrntStd: interface=PinionSteerAg1  # Pinion Steering Angle Front Standard | Calculated pinion steer angle at the front steering device. Conditioned Signal (Filtering, Offset-Compensation, Model-based Plausibility Check, etc.)
    PinionSteerAgReBas: interface=PinionSteerAg1  # Pinion Steering Angle Rear Base | Pinion angle at rear wheels (measured) if the rear wheel steering system is rack and pinion based. Conditioned Signal (Filtering, Offset-Compensation, Model-based Plausibility Check, etc.)
    PinionSteerAgReMeasd: interface=PinionSteerAg1  # Pinion Steering Angle Rear Measured | Pinion angle at rear wheels (measured) if the rear wheel steering system is rack and pinion based. Conditioned Signal (Filtering, Offset-Compensation, Model-based Plausibility Check, etc.)
    PinionSteerAgReRaw: interface=PinionSteerAg1  # Pinion Steering Angle Rear Raw | Pinion angle at rear wheels (measured) if the rear wheel steering system is rack and pinion based. Conditioned Signal (Filtering, Offset-Compensation, Model-based Plausibility Check, etc.)
    PinionSteerAgReStd: interface=PinionSteerAg1  # Pinion Steering Angle Rear Standard | Pinion angle at rear wheels (measured) if the rear wheel steering system is rack and pinion based. Conditioned Signal (Filtering, Offset-Compensation, Model-based Plausibility Check, etc.)
    PinionSteerAgSpdFrntMeasd: interface=PinionSteerAgSpd1  # Pinion Steering Angle Speed Front Measured | Calculated pinion steer angle speed at the front steering device. Conditioned Signal (Filtering, Offset-Compensation, Model-based Plausibility Check, etc.)
    PinionSteerAgSpdFrntStd: interface=PinionSteerAgSpd1  # Pinion Steering Angle Speed Front Standard | Calculated pinion steer angle speed at the front steering device. Conditioned Signal (Filtering, Offset-Compensation, Model-based Plausibility Check, etc.)
    PinionSteerAgSpdReMeasd: interface=PinionSteerAgSpd1  # Pinion Steering Angle Speed Rear Measured | Pinion speed at rear wheels (measured) if the rear wheel steering system is rack and pinion based. Conditioned Signal (Filtering, Offset-Compensation, Model-based Plausibility Check, etc.)
    PinionSteerAgSpdReStd: interface=PinionSteerAgSpd1  # Pinion Steering Angle Speed Rear Standard | Pinion speed at rear wheels (measured) if the rear wheel steering system is rack and pinion based. Conditioned Signal (Filtering, Offset-Compensation, Model-based Plausibility Check, etc.)
    PitchRateAtCen: interface=PitchRate2  # Pitch Rate at Center | Pitch Rate from sensor element. Coordinate system according to ISO 8855. Raw signal
    PitchRateBas: interface=PitchRate1  # Pitch Rate Base | Pitch rate measured along vehicle y- axis (i.e. compensated for orientation). Coordinate system according to ISO 8855
    PitchRateMeasd: interface=PitchRate1  # Pitch Rate Measured | Pitch rate calculated along vehicle y-axis. Coordinate system according to ISO 8855. Filtered and offset-compensated
    PitchRateRaw: interface=PitchRate1  # Pitch Rate Raw | Pitch rate measured along vehicle y- axis (i.e. compensated for orientation). Coordinate system according to ISO 8855
    PitchRateStd: interface=PitchRate1  # Pitch Rate Standard | Pitch rate calculated along vehicle y-axis. Coordinate system according to ISO 8855. Filtered and offset-compensated
    PosnStore: interface=StorePosnCmd1  # Store Seat Axis Position | Request to store the position of a certain seat axis to the memory position 'profile'.
    PresStOfDrvr: interface=PresStOfOccpt1  # Presence State of Driver | Announce the presence of an occupant at driver seat position
    PresStOfOccptAtRowFirstMid: interface=PresStOfOccpt1  # Presence State of Occupant at Row First Middle | Announce the presence of an occupant at middle seating position at first row
    PresStOfOccptAtRowSecLe: interface=PresStOfOccpt1  # Presence State of Occupant at Row Second Left | Announce the presence of an occupant at left seating position at second row
    PresStOfOccptAtRowSecMid: interface=PresStOfOccpt1  # Presence State of Occupant at Row Second Middle | Announce the presence of an occupant at middle seating position at second row
    PresStOfOccptAtRowSecRi: interface=PresStOfOccpt1  # Presence State of Occupant at Row Second Right | Announce the presence of an occupant at right seating position at second row
    PresStOfOccptAtRowThrdLe: interface=PresStOfOccpt1  # Presence State of Occupant at Row Third Left | Announce the presence of an occupant at left seating position at third row
    PresStOfOccptAtRowThrdMid: interface=PresStOfOccpt1  # Presence State of Occupant at Row Third Middle | Announce the presence of an occupant at middle seating position at third row
    PresStOfOccptAtRowThrdRi: interface=PresStOfOccpt1  # Presence State of Occupant at Row Third Right | Announce the presence of an occupant at right seating position at third row
    PresStOfPass: interface=PresStOfOccpt1  # Presence State of Passenger | Announce the presence of an occupant at passenger seat position
    PrkgBrkActv: interface=PrkgBrkActv1  # Parking Brake Active | Parking brake (conventional or electrical) is activated.
    PrkgBrkAppldIndcn: interface=PrkgBrkAppldIndcn1  # Parking Brake Applied Indication | Indication to Human Machine Interface (HMI) that parking brake is activated.
    PrkgLi: interface=LiExtCmd1  # Parking Light | This port provides command to turn on/off the parking lights
    PrkgLiIndcn: interface=PrkgLiIndcn1  # Parking Light Indication | This port provides indication about the Parking lights on (possible values: left, right, both) /off status to instrument cluster and other body functionalities
    PrkgLiLe: interface=LiExtCmd1  # Parking Light Left | This port provides command to turn on/off parking lights on left side
    PrkgLiLeOut: interface=LiExtCmd1  # Parking Light Left Output | This port provides command to turn on/off parking lights on left side
    PrkgLiRi: interface=LiExtCmd1  # Parking Light Right | This port provides command to turn on/off parking lights on right side
    PrkgLiRiOut: interface=LiExtCmd1  # Parking Light Right Output | This port provides command to turn on/off parking lights on right side
    PrkgLiSwt: interface=PrkgLiIndcn1  # Parking Light Switch | Requests to switch on left, right, both or no parking lights.
    PtAccrPedlPosn: interface=PtAccrPedlPosn1  # Powertrain: Accelerator Pedal Position | Accelerator pedal position. Accelerator pedal ratio shaped and filtered. | The calibration must ensure that the used signal range is 0 – 100 %. 0 % is driver off the pedal, offsets are removed. 100 % must be ensured at end point of the pedal. Consolidated physical value, either a measured value (Measd) or a modeled value (Estimd). Final filtered and offset-corrected consolidated actuator value/physical sensor value. Virtual physical sensor value/fused sensor value that comes as close as possible to the technical signal. If it is not possible to provide a physical sensor value (e.g. failure, implausibility or other reasons), then a substitute value/default value or a frozen value is provided. Data format for typical network representation for series projects: Uint8 Unit: % Type: linear Resolution: 101/254 (= 0,397637795275591) Offset: 0 Physically used range: Hex Lower/Upper Limit: 0h / FDh Physical Lower/Upper Limit: 0 / 100 Special values outside the physically used range: FEh = Init FFh = Error, Signal content invalid Cycle Time: 10 ms (max.) for internal calculation and bus communication. Typical Provider: Powertrain Typical Receiver: Transmission
    PtAccrPedlPosnVirt: interface=PtAccrPedlPosnVirt1  # Powertrain: Virtual Accelerator Pedal Position | Theoretical accelerator pedal value determined using the physical pedal value and requests from Adaptive Cruise Control or Cruise Control etc. | Example of implementation: Within Adaptive Cruise Control / Cruise Control, this is based on the total requested propulsion wheel torque from the driver or the Vehicle Longitudinal Control, otherwise, this is the "Accelerator Pedal Ratio" value. Evaluated signal, jitter free, including plausibility check, monitoring and substitute value but without filtering. 0 %: (Virtual) driver is off the pedal, offsets are removed. 100 %: Must be ensured at end point of the pedal. Must cover the 100 % as well. Data format for typical network representation for series projects: Uint8 Unit: % Type: linear Resolution: 101/254 (= 0,397637795275591) Offset: 0 Physically used range: Hex Lower/Upper Limit: 0h / FDh Physical Lower/Upper Limit: 0 / 100 Special values outside the physically used range: FEh = Init FFh = Error, Signal content invalid Cycle Time: 10 ms (max.) for internal calculation and bus communication. Typical Provider: Powertrain Typical Receiver: Transmission
    PtCluEngSt: interface=PtCluEngSt1  # Powertrain: State of Engine Clutch | State of engine clutch concerning transmission of power. | The signal describes the coupling state of the engine clutch. The engine clutch is implemented typically as a friction clutch. States of power transmission: 0 = open 1 = open_touch 2 = slip_controlled 3 = slip_micro 4 = closed 5 = not_determined (state of power transmission cannot be identified) 6 = hydrodynamic 14 = init 15 = signal error Values 7… 13 are undefined. Data format for typical network representation for series projects: Uint4 Unit: [-] Type: Enum 0 = open 1 = open_touch 2 = slip_controlled 3 = slip_micro 4 = closed 5 = not_determined 6 = hydrodynamic 14 = init 15 = error Values 7… 13 are undefined. Cycle Time: 10 ms (max.) for internal calculation and bus communication. Typical Provider: Powertrain Typical Receiver: Powertrain “State of Power Transmission” in typical series projects:
    PtCluEngStCtrl: interface=PtCluEngStCtrl1  # Powertrain: Control State of Engine Clutch | Current control state of the engine clutch concerning transmission of power. | The signal describes the current control state of the engine clutch. The engine clutch is implemented typically as a friction clutch. States of power transmission: 0 = open => if the engine clutch only transmits the drag torque of the engine clutch. 1 = conditioning => if the engine clutch is preparing for power transmission, for example, by prefilling. 2 = open_touch => if the air gap of the engine clutch is closed but only the drag torque is transmitted. 3 = torque_controlled => if the engine clutch is controlled to transmit a determined torque. 4 = slip_controlled => if the engine clutch is slipping and is transmitting torque, and the differential speed is greater than a calibratable threshold. 5 = slip_micro => if the engine clutch is slipping and is transmitting torque, and the differential speed is less than a calibratable threshold. 6 = closed => if the engine clutch is not slipping, but is transmitting the full torque provided by the combustion engine and can have an additional torque reserve. 7 = not_determined => state of power transmission cannot be identified. 8 = hydrodynamic => only in projects with torque converter. 14 = init => at initialization. 15 = signal error => if an internal fault is detected by the TCM, for example, if the actual physical state of the engine clutch cannot be determined. Values 9… 13 are undefined. Data format for typical network representation for series projects: Uint4 Unit: [-] Type: Enum 0 = open 1 = conditioning 2 = open_touch 3 = torque_controlled 4 = slip_controlled 5 = slip_micro 6 = closed 7 = not determined 8 = hydrodynamic 14 = init 15 = error Values 9… 13 are undefined. Cycle Time: 10 ms (max.) for internal calculation and bus communication. Typical Provider: Powertrain Typical Receiver: Powertrain
    PtCluEngStCtrlTar: interface=PtCluEngStCtrlTar1  # Powertrain: Target Control State of Engine Clutch | Target control state of the engine clutch concerning transmission of power. | The signal describes the target control state of the engine clutch. The engine clutch is implemented typically as a friction clutch. States of power transmission: 0 = open => if the engine clutch only transmits the drag torque of the engine clutch. 1 = conditioning => if the engine clutch is preparing for power transmission, for example, by prefilling. 2 = open_touch => if the air gap of the engine clutch is closed but only the drag torque is transmitted. 3 = torque_controlled => if the engine clutch is controlled to transmit a determined torque. 4 = slip_controlled => if the engine clutch is slipping and is transmitting torque, and the differential speed is greater than a calibratable threshold. 5 = slip_micro => if the engine clutch is slipping and is transmitting torque, and the differential speed is less than a calibratable threshold. 6 = closed => if the engine clutch is not slipping, but is transmitting the full torque provided by the combustion engine and can have an additional torque reserve. 7 = not_determined => state of power transmission cannot be identified. 8 = hydrodynamic => only in projects with torque converter. 14 = init => at initialization. 15 = signal error => if an internal fault is detected by the TCM, for example, if the actual physical state of the engine clutch cannot be determined. Values 9… 13 are undefined. Data format for typical network representation for series projects: Uint4 Unit: [-] Type: Enum 0 = open 1 = conditioning 2 = open_touch 3 = torque_controlled 4 = slip_controlled 5 = slip_micro 6 = closed 7 = not determined 8 = hydrodynamic 14 = init 15 = error Values 9… 13 are undefined. Cycle Time: 10 ms (max.) for internal calculation and bus communication. Typical Provider: Powertrain Typical Receiver: Powertrain
    PtCluEngTqMaxCluPCur: interface=PtCluEngTqMaxCluPCur1  # Powertrain: Engine Clutch Maximum Torque at Current Clutch Pressure | Maximum transmittable torque of engine clutch at current pressure. | Data format for typical network representation for series projects: Uint12 Unit: Nm Type: linear Resolution: 1 Offset: -2048 Physically used range: Hex Lower/Upper Limit: 0h / FFDh Physical Lower/Upper Limit: -2048 / 2045 Special values outside the physically used range: FFEh = Init FFFh = Error, Signal content invalid Cycle Time: 10 ms (max.) for internal calculation and bus communication. Typical Provider: Powertrain Typical Receiver: Transmission
    PtCluN: interface=PtCluN1  # Powertrain: Clutch Speed | Consolidated rotational speed of the clutch input shaft. | Speed of the shaft combining all driving machines in front of the gearbox. Driving machines are, e.g., electric machines and combustion engines. For conventional drivetrains, the signal is identical to the signal "Powertrain: Engine Speed Including Start Stop". For parallel hybrid projects the signal shall be provided based on the speed of the electric machine for accuracy reasons. The accuracy of the clutch speed based on the electric machine has to be defined in close cooperation between electric machine expert and transmission expert. The information about the direction of the clutch speed is also necessary for start-stop functionalities. Experience indicates that speeds of up to -500 rpm may occur. References to other signals: PtEngNInclgStrtStop Data format for typical network representation for series projects: Uint15 Unit: rpm Type: linear Resolution: 1 Offset: -16384 Physically used range: Hex Lower/Upper Limit: 0h / 7FFDh Physical Lower/Upper Limit: -16384 / 16381 Special values outside the physically used range: 7FFEh = Init 7FFFh = Error, Signal content invalid Cycle Time: 10 ms (max.) for internal calculation and bus communication. Typical Provider: Powertrain Typical Receiver: Transmission
    PtCluNLimnLoReq: interface=PtCluNLimnLoReq1  # Powertrain: Request by Powertrain for Lower Limitation of Clutch Speed | Minimum clutch speed requested by powertrain. | The powertrain coordinator sends the required minimum speed needed at clutch. If there is no request, the transmission expects the neutral value 0 rpm. Data format for typical network representation for series projects: Uint14 Unit: rpm Type: linear Resolution: 1 Offset: 0 Physically used range: Hex Lower/Upper Limit: 0h / 3FFDh Physical Lower/Upper Limit: 0 / 16381 Special values outside the physically used range: 3FFEh = Init 3FFFh = Error, Signal content invalid Cycle Time: 10 ms (max.) for internal calculation and bus communication. Typical Provider: Powertrain Typical Receiver: Transmission
    PtCluNLimnUpReq: interface=PtCluNLimnUpReq1  # Powertrain: Request by Powertrain for Upper Limitation of Clutch Speed | Maximum clutch speed requested by powertrain. | The powertrain coordinator sends the required maximum speed needed at clutch. If there is no request, a neutral value must be sent. This neutral value must be agreed on between the torque coordinator expert and the transmission expert. Data format for typical network representation for series projects: Uint14 Unit: rpm Type: linear Resolution: 1 Offset: 0 Physically used range: Hex Lower/Upper Limit: 0h / 3FFDh Physical Lower/Upper Limit: 0 / 16381 Special values outside the physically used range: 3FFEh = Init 3FFFh = Error, Signal content invalid Cycle Time: 10 ms (max.) for internal calculation and bus communication. Typical Provider: Powertrain Typical Receiver: Transmission
    PtDrvrReqTqClu: interface=PtDrvrReqTqClu1  # Powertrain: Driver Request of Torque at Clutch | Torque at clutch requested by the driver. | Combination of all real and virtual driver requests, project specific including idle speed control. Virtual driver requests include cruise control, distance cruise control, vehicle speed limiter, etc. This signal shows the unfiltered driver requested torque and therefore it is not affected by driving comfort functions. The signal determines the earliest torque information in the torque chain architecture. Used to prepare transmission internal system functions to achieve a proper spontaneity according to the driver request. Predicted torque information, which is determined based on the driver pedal position or on driver assistance systems. Independent of whether the engine is running or not, this signal always delivers the torque information as if the engine is running. The calculation of this signal by the provider is not permitted to consider the inertia, which has an effect on the torque at clutch. This means that the signal must be calculated as if the inertia is 0 kg*(m^2). In hybrid projects, a limitation by the torque of the engine clutch is not visible. In projects with engine clutch, this signal is not permitted to be limited due to the state of the engine clutch. Data format for typical network representation for series projects: Uint12 Unit: Nm Type: linear Resolution: 1 Offset: -2048 Physically used range: Hex Lower/Upper Limit: 0h / FFDh Physical Lower/Upper Limit: -2048 / 2045 Special values outside the physically used range: FFEh = Init FFFh = Error, Signal content invalid Cycle Time: 10 ms (max.) for internal calculation and bus communication. Typical Provider: Powertrain Typical Receiver: Transmission Example for “Timing and accuracy requirements on torque signals” in a typical series project: The following image illustrates the respective accuracy requirements: The image “Detailed signal content of Torque at Clutch Signals” shows the effects of functionalities on the torque at clutch signals. Example: “Soot limitation” is marked with an “X” to indicate that it is considered in the signal.
    PtDrvrReqTqCluPredEngN: interface=PtDrvrReqTqCluPredEngN1  # Powertrain: Predicted Driver Request of Torque at Clutch in Target Speed | Predicted driver requested torque at clutch at the engine speed reached in target gear. | Environmental conditions, such as altitude and temperature and engine internal limits, e.g., soot limitation and full load limit, are considered. The calculation of this signal by the provider is not permitted to consider the inertia, which has an effect on the torque at clutch. This means that the signal must be calculated as if the inertia is 0 kg*(m^2). The calculation of this signal is based on signal “Transmission: Predicted Clutch Speed in Target Gear”. References to other signals: TrsmCluNPredGearTar Data format for typical network representation for series projects: Uint12 Unit: Nm Type: linear Resolution: 1 Offset: -2048 Physically used range: Hex Lower/Upper Limit: 0h / FFDh Physical Lower/Upper Limit: -2048 / 2045 Special values outside the physically used range: FFEh = Init FFFh = Error, Signal content invalid Cycle Time: 10 ms (max.) for internal calculation and bus communication. Typical Provider: Powertrain Typical Receiver: Transmission The image “Detailed signal content of Torque at Clutch Signals” shows the effects of functionalities on the torque at clutch signals. Example: “Soot limitation” is marked with an “X” to indicate that it is considered in the signal.
    PtEmNIdle: interface=PtEmNIdle1  # Powertrain: Target Idle Speed of the Electric Machine | Target speed of the electric machine idle speed controller. | Used, for example, for the internal drive-off clutch and for hybrid-specific functions. E.g. necessary for the transition from electric mode to hybrid mode. The idle speed setpoint is also known as “target idle speed”. The signal is always calculated, even if the actual electric machine speed is outside of the activation range of the idle speed controller. This means it is also calculated if the real/physical electric machine speed is e.g. 0 rpm or 5000 rpm. Data format for typical network representation for series projects: Uint8 Unit: rpm Type: linear Resolution: 10 Offset: 0 Physically used range: Hex Lower/Upper Limit: 0h / FDh Physical Lower/Upper Limit: 0 / 2530 Special values outside the physically used range: FEh = Init FFh = Error, Signal content invalid Cycle Time: 10 ms (max.) for internal calculation and bus communication. Typical Provider: Powertrain Typical Receiver: Transmission
    PtEmTq: interface=PtEmTq1  # Powertrain: Electric Machine Torque | Torque of the electric machine at clutch. | Torque output of the electric machine at clutch level. The gear ratio between the electric machine shaft and the clutch, if present, must be considered. The calculation of this signal by the provider is not permitted to consider the inertia, which has an effect on the torque at clutch. This means that the signal must be calculated as if the inertia is 0 kg*(m^2). Timing and accuracy requirements on this torque signal have to be defined in close cooperation of engine and transmission experts, especially for combined engine and electric machine operation. Data format for typical network representation for series projects: Uint12 Unit: Nm Type: linear Resolution: 1 Offset: -2048 Physically used range: Hex Lower/Upper Limit: 0h / FFDh Physical Lower/Upper Limit: -2048 / 2045 Special values outside the physically used range: FFEh = Init FFFh = Error, Signal content invalid Cycle Time: 10 ms (max.) for internal calculation and bus communication. Typical Provider: Powertrain Typical Receiver: Transmission The image “Detailed signal content of Torque at Clutch Signals” shows the effects of functionalities on the torque at clutch signals. Example: “Soot limitation” is marked with an “X” to indicate that it is considered in the signal.
    PtEmTqJRotorShaft: interface=PtEmTqJRotorShaft1  # Powertrain: Electric Machine Torque of Inertia at Rotor Shaft | Inertia torque of the electric machine at clutch level. Definition of the sign: An increasing speed produces a negative sign; a decreasing speed produces a positive sign. | The signal contains the dynamic torque caused by the inertia of the electric machine, which, in parallel hybrid projects, increases or decreases the torque at clutch. Data format for typical network representation for series projects: Uint12 Unit: Nm Type: linear Resolution: 1 Offset: -2048 Physically used range: Hex Lower/Upper Limit: 0h / FFDh Physical Lower/Upper Limit: -2048 / 2045 Special values outside the physically used range: FFEh = Init FFFh = Error, Signal content invalid Cycle Time: 10 ms (max.) for internal calculation and bus communication. Typical Provider: Powertrain Typical Receiver: Engine
    PtEmTqMaxCluNCur: interface=PtEmTqMaxCluNCur1  # Powertrain: Electric Machine Maximum Torque at Current Clutch Speed | Maximum possible torque of electric machine at clutch at current clutch speed and current operating point, including all system limitations. | Theoretical maximum possible torque output of the electric machine at clutch level with maximum possible inverter phase electric current. The current operating point is defined e.g., by the current DC-link voltage, the rotor temperature and the battery power. System limitations are, e.g., speed limits, temperature limits, electric current limits and voltage limits. The gear ratio between the electric machine shaft and the clutch is considered. The calculation of this signal by the provider is not permitted to consider the inertia, which has an effect on the torque at clutch. This means that the signal must be calculated as if the inertia is 0 kg*(m^2). Data format for typical network representation for series projects: Uint12 Unit: Nm Type: linear Resolution: 1 Offset: -2048 Physically used range: Hex Lower/Upper Limit: 0h / FFDh Physical Lower/Upper Limit: -2048 / 2045 Special values outside the physically used range: FFEh = Init FFFh = Error, Signal content invalid Cycle Time: 10 ms (max.) for internal calculation and bus communication. Typical Provider: Powertrain Typical Receiver: Transmission
    PtEmTqMinCluNCur: interface=PtEmTqMinCluNCur1  # Powertrain: Electric Machine Minimum Torque at Current Clutch Speed | Minimum possible torque of electric machine at clutch at current clutch speed and current operating point, including all system limitations. | Theoretical minimum possible torque output of the electric machine at clutch level with maximum possible inverter phase electric current. The current operating point is defined e.g., by the current DC-link voltage, the rotor temperature and the battery power. System limitations are, e.g., speed limits, temperature limits, electric current limits and voltage limits. The gear ratio between the electric machine shaft and the clutch is considered. The calculation of this signal by the provider is not permitted to consider the inertia, which has an effect on the torque at clutch. This means that the signal must be calculated as if the inertia is 0 kg*(m^2). Data format for typical network representation for series projects: Uint12 Unit: Nm Type: linear Resolution: 1 Offset: -2048 Physically used range: Hex Lower/Upper Limit: 0h / FFDh Physical Lower/Upper Limit: -2048 / 2045 Special values outside the physically used range: FFEh = Init FFFh = Error, Signal content invalid Cycle Time: 10 ms (max.) for internal calculation and bus communication. Typical Provider: Powertrain Typical Receiver: Transmission
    PtEmTqRelCluReq: interface=PtEmTqRelCluReq1  # Powertrain: Electric Machine Relative Torque at Clutch Requested by Powertrain | Electric machine relative torque at clutch requested by powertrain. | Torque to be implemented by the electric machine additional to the driver requested torque. Typically used to create the electric machine torque which is necessary to start the combustion engine via the engine clutch without influencing the implementation of the driver requested torque. As long as there is no torque request, the signal "Powertrain: Implementation Type of Electric Machine Relative Torque at Clutch Requested by Powertrain” is “0h = no request” and signal "Powertrain: Electric Machine Relative Torque at Clutch Requested by Powertrain” is “FFEh = Init”. This signal is closely related to signal “Powertrain: Implementation Type of the Electric Machine Relative Torque at Clutch Requested by Powertrain”. References to other signals: PtNrTypEmTqRelCluReq Data format for typical network representation for series projects: Uint12 Unit: Nm Type: linear Resolution: 1 Offset: -2048 Physically used range: Hex Lower/Upper Limit: 0h / FFDh Physical Lower/Upper Limit: -2048 / 2045 Special values outside the physically used range: FFEh = Init FFFh = Error, Signal content invalid Cycle Time: 10 ms (max.) for internal calculation and bus communication. Typical Provider: Powertrain Typical Receiver: Powertrain The image “Detailed signal content of Torque at Clutch Signals” shows the effects of this signal on the torque at clutch signals.
    PtEmTqReq: interface=PtEmTqReq1  # Powertrain: Requested Electric Machine Torque | Requested electric machine torque, including all interventions, including all limitations. | The signal contains the limitations which are closely related to the electric machine or which are attributed to the electric machine by the powertrain coordinator. The content of this signal is related to the clutch level, so a possibly installed ratio between the rotor of the electric machine and the clutch is considered. The calculation of this signal by the provider is not permitted to consider the inertia, which has an effect on the torque at clutch. This means that the signal must be calculated as if the inertia is 0 kg*(m^2). The signal contains all interventions. The goal is that the torque information is sent 50 – 80 ms ahead of the desired real/physical torque. Data format for typical network representation for series projects: Uint12 Unit: Nm Type: linear Resolution: 1 Offset: -2048 Physically used range: Hex Lower/Upper Limit: 0h / FFDh Physical Lower/Upper Limit: -2048 / 2045 Special values outside the physically used range: FFEh = Init FFFh = Error, Signal content invalid Cycle Time: 10 ms (max.) for internal calculation and bus communication. Typical Provider: Powertrain Typical Receiver: Engine Example for “Timing and accuracy requirements on torque signals” in a typical series project: The following image illustrates the respective accuracy requirements: The image “Detailed signal content of Torque at Clutch Signals” shows the effects of functionalities on the torque at clutch signals. Example: “Soot limitation” is marked with an “X” to indicate that it is considered in the signal.
    PtEmTqResvReq: interface=PtEmTqResvReq1  # Powertrain: Torque Reserve Electric Machine Requested by Powertrain | Torque reserve of the electric machine, might be used to start the combustion engine. | This torque reserve is the sum of “Engine: Minimum Torque at Crankshaft Reduced by Ancillary Losses” and the torque necessary to compensate for the inertia, if it is used to start the combustion engine. If no torque reserve is necessary, then the signal is set to 0 Nm. References to other signals: EngTqCrksftRedByAncllryLossMin Data format for typical network representation for series projects: Uint12 Unit: Nm Type: linear Resolution: 1 Offset: -2048 Physically used range: Hex Lower/Upper Limit: 0h / FFDh Physical Lower/Upper Limit: -2048 / 2045 Special values outside the physically used range: FFEh = Init FFFh = Error, Signal content invalid Cycle Time: 10 ms (max.) for internal calculation and bus communication. Typical Provider: Powertrain Typical Receiver: Powertrain
    PtEngNInclgStrtStop: interface=PtEngNInclgStrtStop1  # Powertrain: Engine Speed Including Start Stop | Consolidated rotational speed of the engine crankshaft including start and stop. | Crankshaft speed of the combustion engine. Created by fading from segment synchronous source to tooth-based source during engine stop and by fading from tooth-based source to segment synchronous source during engine start. The information about the direction of the engine speed is necessary for start-stop functionalities. Experience indicates that speeds of up to -500 rpm may occur. Data format for typical network representation for series projects: Uint15 Unit: rpm Type: linear Resolution: 1 Offset: -16384 Physically used range: Hex Lower/Upper Limit: 0h / 7FFDh Physical Lower/Upper Limit: -16384 / 16381 Special values outside the physically used range: 7FFEh = Init 7FFFh= Error, Signal content invalid Cycle Time: 10 ms (max.) for internal calculation and bus communication. Typical Provider: Powertrain Typical Receiver: Transmission
    PtEngNReq: interface=PtEngNReq1  # Powertrain: Engine Speed Requested by Powertrain | Engine crankshaft speed requested by powertrain. | Engine crankshaft speed requested by powertrain, used, e.g., for slip start. This signal is closely related to the status signal: “Powertrain: Request to Enable Engine Speed Request”. This signal is also closely related to the following signal: “Transmission: Clutch Speed Requested by Transmission". For non-hybrid applications, this signal and signal "Transmission: Clutch Speed Requested by Transmission" are identical. Recommendation is to send only the signal set for "Transmission: Clutch Speed Requested by Transmission". For hybrid applications, the signals are identical if the engine clutch is closed. Otherwise, the signals are usually different. So, for hybrid applications, both signal sets are necessary, signal sets for "Powertrain: Engine Speed Requested by Powertrain" and "Transmission: Clutch Speed Requested by Transmission". As long as there is no speed request, the recommendation is to send the initialization value. If there is a valid speed request, then an implementation is expected as fast as possible. Timing and accuracy requirements on the speed request in a typical series project are equivalent to the timing and accuracy requirements on signal "Transmission: Clutch Speed Requested by Transmission". References to other signals: PtEngNReqEnaReq TrsmCluNReq Data format for typical network representation for series projects: Uint14 Unit: rpm Type: linear Resolution: 1 Offset: 0 Physically used range: Hex Lower/Upper Limit: 0h / 3FFDh Physical Lower/Upper Limit: 0 / 16381 Special values outside the physically used range: 3FFEh = Init 3FFFh = Error, Signal content invalid Cycle Time: 10 ms (max.) for internal calculation and bus communication. Typical Provider: Transmission Typical Receiver: Powertrain The image “Detailed signal content of Torque at Clutch Signals” shows the effects of this signal on the torque at clutch signals.
    PtEngNReqEnaReq: interface=PtEngNReqEnaReq1  # Powertrain: Request to Enable Engine Speed Request | Engine speed requested by powertrain enabled or not enabled. | This signal is closely related to the signal "Powertrain: Engine Speed Requested by Powertrain". 0 = not enabled => the request sent by signal "Powertrain: Engine Speed Requested by Powertrain" is not permitted to be implemented. 1 = enabled => the request must be implemented. If the request must be implemented, then the signal must be “1” and the signal “Powertrain: Engine Speed Requested by Powertrain” must be a value in the physically used range, different from initialization and error values. The engine stall protection must have a higher priority than the engine speed request. References to other signals: PtEngNReq Data format for typical network representation for series projects: Uint1 Unit: [-] Type: Enum 0 = not enabled 1 = enabled Cycle Time: 10 ms (max.) for internal calculation and bus communication. Typical Provider: Powertrain Typical Receiver: Powertrain
    PtEngNSpIdle: interface=PtEngNSpIdle1  # Powertrain: Engine Idle Speed Setpoint | Target speed of the engine idle speed controller. | Used, for example, for comfortable gear engagement from neutral gear at vehicle standstill. The idle speed setpoint is also known as "target idle speed". The signal is always calculated, even if the actual engine speed is outside of the activation range of the idle speed controller. This means it is also calculated if the real/physical engine speed is e.g. 0 rpm or 5000 rpm. Data format for typical network representation for series projects: Uint8 Unit: rpm Type: linear Resolution: 10 Offset: 0 Physically used range: Hex Lower/Upper Limit: 0h / FDh Physical Lower/Upper Limit: 0 / 2530 Special values outside the physically used range: FEh = Init FFh = Error, Signal content invalid Cycle Time: 10 ms (max.) for internal calculation and bus communication. Typical Provider: Powertrain Typical Receiver: Transmission
    PtFlgAcDeactvt: interface=PtFlgAcDeactvt1  # Powertrain: Request to Deactivate Air Conditioner (A/C) | Request to deactivate Air Conditioner (A/C) 0 = no deactivation of A/C requested 1 = deactivation of A/C requested
    PtFlgAcDeactvtReq: interface=PtFlgAcDeactvtReq1  # Powertrain: Request to Deactivate Air Conditioner (A/C) | Request to deactivate Air Conditioner (A/C) 0 = no deactivation of A/C requested 1 = deactivation of A/C requested.
    PtFlgAltDeactvt: interface=PtFlgAltDeactvt1  # Powertrain: Request to Deactivate Alternator (Generator) | Request to deactivate Alternator (generator) 0 = no deactivation of Alternator requested 1 = deactivation of Alternator requested
    PtFlgAltDeactvtReq  # Powertrain: Request to Deactivate Alternator (Generator) | Request to deactivate Alternator (generator) 0 = no deactivation of Alternator requested 1 = deactivation of Alternator requested.
    PtFlgDrvOvrdVlc: interface=PtFlgDrvOvrdVlc1  # Powertrain: Driver Request Overrides Vehicle Longitudinal Control (VLC) | Flag is set to 1 if driver request overrides Vehicle Longitudinal Control (VLC), otherwise the flag is set to 0
    PtFlgEngRun: interface=PtFlgEngRun1  # Powertrain: Engine Is Running | Powertrain: Cranking finished and engine is running 0 = engine not running 1 = engine running
    PtFlgEngStop: interface=PtFlgEngStop1  # Powertrain: Engine Is Stopped | Powertrain: Engine is stopped 0 = engine not stopped 1 = engine stopped
    PtFlgEngStopReq: interface=PtFlgEngStopReq1  # Powertrain: Engine Stop Request | Powertrain: Engine stop request 0 = no request to stop engine 1 = request to stop engine
    PtFlgEngStopReqAllwd: interface=PtFlgEngStopReqAllwd1  # Powertrain: Request to Stop Engine Is Allowed | Powertrain: Request to stop engine is allowed 0 = request to stop engine not allowed 1 = request to stop engine allowed
    PtFlgEngStrtReq: interface=PtFlgEngStrtReq1  # Powertrain: Engine Start Request | Powertrain: Engine start request 0 = no request to start engine 1 = request to start engine
    PtFlgEngStrtReqAllwd: interface=PtFlgEngStrtReqAllwd1  # Powertrain: Request to Start Engine Is Allowed | Powertrain: Request to start engine is allowed 0 = request to start engine not allowed 1 = request to start engine allowed
    PtFlgHvacDeactvt: interface=PtFlgHvacDeactvt1  # Powertrain: Request to Deactivate Air Conditioner (A/C) | Request to deactivate Air Conditioner (A/C) 0 = no deactivation of A/C requested 1 = deactivation of A/C requested
    PtFlgNoTqWhlReq: interface=PtFlgNoTqWhlReq1  # Powertrain: No Torque Request for Wheel Torque | Wheel torque request below or equal a certain threshold. Torque demands considered : Driver (accelerator pedal), Cruise Control, Adaptive Cruise Control, Variable Vehicle Speed Limitation, Torque increase by Electronic Stability Control (Msr) | 0: Torque request above threshold 1: Torque request below or equal threshold e.g. threshold could be given by loss torques or a calibration value
    PtFlgTqDecPsbl: interface=PtFlgTqDecPsbl1  # Powertrain: Torque Decrease Possible | A decrease of powertrain torque is possible (especially for Electronic Stability Control (ESC)). | If the limit of torque realization is reached during an intervention the bit will change to false. 0 = decrease of powertrain torque is not possible 1 = decrease of powertrain torque is possible
    PtFlgTqIncPsbl: interface=PtFlgTqIncPsbl1  # Powertrain: Torque Increase Possible | An increase of powertrain torque is possible (especially for Electronic Stability Control (ESC)). | If the limit of torque realization is reached during an intervention the bit will change to false. 0 = increase of powertrain torque is not possible 1 = increase of powertrain torque is possible
    PtFuCutCoastActv: interface=PtFuCutCoastActv1  # Powertrain: Fuel Cut-Off in Coast Active | Fuel cut-off in coast is active. | Fuel cut-off is active for all cylinders of the combustion engine. Typically used for activating adaptation functions in the transmission controller. At initialization, "fuel cut-off inactive" is sent. 0 = Fuel cut-off is inactive 1 = Fuel cut-off is active Data format for typical network representation for series projects: Uint1 Unit: [-] Type: Enum 0 = fuel cut-off inactive 1 = fuel cut-off active Cycle Time: 10 ms (max.) for internal calculation and bus communication. Typical Provider: Powertrain Typical Receiver: Transmission
    PtGearLvrLockReq: interface=PtGearLvrLockReq1  # Powertrain: Gear Lever Lock Request | Locking the gear lever is requested by powertrain. | Locking the gear lever is requested by the powertrain. Typically used to lock the gear lever in the parking position until the driver presses the brake to prevent an unintended vehicle acceleration. The signal is also named "Shift Lock Request". 0 = not requested 1 = requested Data format for typical network representation for series projects: Uint1 Unit: [-] Type: Enum 0 = not requested 1 = requested Cycle Time: 10 ms (max.) for internal calculation and bus communication. Typical Provider: Powertrain Typical Receiver: Transmission
    PtKdDetd: interface=PtKdDetd1  # Powertrain: Kickdown Detected | Accelerator pedal is in a kickdown position. | The kickdown switch is pressed or the accelerator pedal position is greater than a threshold. 0 = no kickdown (Flag reset) 1 = kickdown (Flag set) Data format for typical network representation for series projects: Uint1 Unit: [-] Type: Enum 0 = no kickdown 1 = kickdown Cycle Time: 10 ms (max.) for internal calculation and bus communication. Typical Provider: Powertrain Typical Receiver: Transmission
    PtNClu: interface=PtNClu1  # Speed at Clutch from Powertrain | Signal is used only for vehicles, where the engine speed can be different from the speed at converter or clutch. This signal is a combination of the engine speed and the speed of the electric machine, at the engine/electric machine side of the transmission clutch or converter. | Definition of "Clutch": Signal is sent with initialisation. for Automatic Transmission (AT), Continuously Variable Transmission (CVT) it is the converter clutch for Manual Transmission (MT), Automatic Manual Transmission (AMT) it is the clutch between the gear box and the engine drivetrain.
    PtNEngSp: interface=PtNEngSp1  # Powertrain: Engine Speed Setpoint | calculated engine speed setpoint e.g. idle engine speed setpoint during idle | Default value after reset: zero
    PtNrTypEmTqRelCluReq: interface=PtNrTypEmTqRelCluReq1  # Powertrain: Implementation Type of Electric Machine Relative Torque at Clutch Requested by Powertrain | Defines reference point and the coordination of the relative torque at clutch request to the electric machine. | The reference point is the driver requested torque (reference point for relative requests). 0 = no request => the powertrain does not send a request. 1 = absolute maximum => the powertrain requests an absolute upper limit for the torque to be produced by the electric machine. The real electric machine torque is permitted to be lower. It may be lower due to driver request or due to interventions by other systems. This case is usually used for torque decrease requests. 2 = absolute minimum => the powertrain requests an absolute lower limit for the torque to be produced by the electric machine. The real electric machine torque is permitted to be higher. It may be higher due to driver request or due to interventions by other systems. This case is usually used for torque increase requests. 3 = absolute exact => the powertrain requests exactly the torque to be produced by the electric machine. The real electric machine torque must comply with the request. This case is usually used for exact torque requests independently of whether the request is an increase or a decrease. 4 = relative => the powertrain requests a torque relative to the reference "Powertrain: Torque at Clutch without Transmission Intervention”. The torque request to be implemented is the sum of "Powertrain: Torque at Clutch without Transmission Intervention" and "Powertrain: Electric Machine Relative Torque at Clutch Requested by Powertrain”. If the sign of the relative torque request is positive, then the sum is treated as in case "2 = absolute minimum". If the sign of the relative torque request is negative, then the sum is treated as in case "1 = absolute maximum". Advantage of the relative request: It immediately follows dynamic changes in the reference. It does not depend strongly on communication time delays. This signal does not define whether or not the intervention of stability control has priority over the intervention of the powertrain. The signal can be used in both cases. The priority of stability control versus powertrain intervention is not part of this definition. References to other signals: PtTqCluWoTrsmIntv PtEmTqRelCluReq Data format for typical network representation for series projects: Uint3 Unit: [-] Type: Enum 0 = no request 1 = absolute maximum 2 = absolute minimum 3 = absolute exact 4 = relative Values 5, 6, 7 are undefined. Cycle Time: 10 ms (max.) for internal calculation and bus communication. Typical Provider: Powertrain Typical Receiver: Powertrain
    PtRatTqDistbnReq: interface=PtRatTqDistbnReq1  # Powertrain: Requested Percental Distribution of Torque to Wheels | This signal only considers the torque which can be distributed from one or more central torque producers to the wheels by the transmission system. It does not consider additional torque producers located e.g. at the individual wheels. Where no torque is distributed to the wheels by the transmission system (e.g. one axle not driven or directly driven by an electric machine), the respective values are zero. The sum of all 4 values must be 100%.
    PtTqActAtWhls: interface=PtTqWhlInd1  # Powertrain Torque Actual at Wheels | Vector of 4 signals. Actual torque delivered by the powertrain to the individual wheels. The sum of all 4 signals must be equal to actual total powertrain torque at wheels. | In case of actor/sensor failures or if there is no possibility to determine the correct distribution a rough estimation is done. Additionally a qualifier has to be set, to inform about invalid or backup values.
    PtTqClu: interface=PtTqClu1  # Powertrain: Torque at Clutch | Indicated torque of combustion engine plus torque of electric machine, if present, plus internal engine torque losses plus all losses with an effect on the torque at clutch. The effect of inertia on the torque is not considered. | Torque at clutch is a torque at the mechanical interface between engine and transmission. For manual transmissions, the mechanical interface is the primary side of the clutch, for automatic transmissions, this is the primary side of the converter. Torque at clutch considers the following contributors, if present: 1) Indicated torque of combustion engine, calculated on basis of injection timing and injected fuel, ignition angle and air mass. 2) Torque of electric machine at clutch level. 3) Internal engine torque losses such as friction, pumping, mechanically driven water pump, etc. 4) Ancillary torque losses with an effect on the torque at clutch caused by the alternator, air conditioning, power steering, etc. The calculation of this signal by the provider is not permitted to consider the inertia, which has an effect on the torque at clutch. This means that the signal must be calculated as if the inertia is 0 kg*(m^2). Loss differences from engine to engine and variable torque losses over the life cycle must be considered. In parallel hybrid projects, the combustion engine torque must be considered depending on the engine clutch state. If there is a mechanically driven transmission oil pump, then the oil pump is a consumer of the transmission, not a consumer of the engine. So the oil pump drive torque is not permitted to be subtracted by the provider of this signal. The signal can be calculated based on “Engine: Torque at Crankshaft”, so this signal includes all torque requests from accelerator pedal, cruise control, speed limiter, etc. and all interventions such as torque and speed interventions. Hint for implementation: The torque is a cylinder average, not a time average, via two crankshaft revolutions of all cylinders, in consideration of the current operating parameters. The operating parameters include engine temperature, ignition timing and air mass measured or calculated, lambda, fuel cut level, fuel quantity, injection timing, knock control adaption, geographic altitude and others. References to other signals: EngTqCrksft Data format for typical network representation for series projects: Uint12 Unit: Nm Type: linear Resolution: 1 Offset: -2048 Physically used range: Hex Lower/Upper Limit: 0h / FFDh Physical Lower/Upper Limit: -2048 / 2045 Special values outside the physically used range: FFEh = Init FFFh = Error, Signal content invalid Cycle Time: 10 ms (max.) for internal calculation and bus communication. Typical Provider: Powertrain Typical Receiver: Transmission Example for “Timing and accuracy requirements on torque signals” in a typical series project: The following image illustrates the respective accuracy requirements: The image “Detailed signal content of Torque at Clutch Signals” shows the effects of functionalities on the torque at clutch signals. Example: “Soot limitation” is marked with an “X” to indicate that it is considered in the signal.
    PtTqCluDyn: interface=PtTqCluDyn1  # Dynamic Torque at Clutch from Powertrain | This signal has to consider all engine internal and auxiliary inertia torques, but no transmission inertia torques. | Example of usage: Used for Transmission to calculate a predictive slipping time of the clutch to prepare an ideal termination of shifting. Note definition of "dynamic torque correction": This signal has to consider all internal inertia torques of specific components: Dynamic Torque at Clutch = Torque At Clutch + Engine dynamic moment of inertia. Default value after reset is zero.
    PtTqCluEngMaxProtnReq: interface=PtTqCluEngMaxProtnReq1  # Powertrain: Maximum Torque at Engine Clutch Requested by Powertrain Coordinator for Engine Clutch Protection | Maximum torque for engine clutch protection, independent of direction/ sign of the torque. | The maximum torque is independent of the sign of the torque, i.e. of the direction of the torque flow. The actual torque at engine clutch depends on the combustion engine torque, the electric machine torque, the transmission input torque and on the torque of inertia. Data format for typical network representation for series projects: Uint12 Unit: Nm Type: linear Resolution: 1 Offset: -2048 Physically used range: Hex Lower/Upper Limit: 0h / FFDh Physical Lower/Upper Limit: -2048 / 2045 Special values outside the physically used range: FFEh = Init FFFh = Error, Signal content invalid Cycle Time: 10 ms (max.) for internal calculation and bus communication. Typical Provider: Transmission Typical Receiver: Powertrain Example for “Transmission Requirement for Response” in a typical series project: [[Image: Images\Transmission_Requirement_for_Response_to_TrsmTqCluMaxProtn_Gearbox_Protection.jpg]
    PtTqCluMaxCluNCurLongTerm: interface=PtTqCluMaxCluNCurLongTerm1  # Powertrain: Maximum Torque at Clutch at Current Clutch Speed Long Term Attainable | Maximum possible torque at clutch at current clutch speed which is long term attainable. | For non hybrid-projects this signal reflects the full load engine torque at clutch at current engine speed which the engine could implement within a long time period, especially when maximally charged. It is calculated at current ambient pressure and air temperature and includes the static power limitation of the engine. In parallel hybrid projects, the signal is the sum of the maximum torque of combustion engine and electric machine, considering the engine clutch state. The static power limitation contains, e.g., restrictions for protection and static soot limitation. Permanent knock limitation is considered, knock control is not considered. The calculation of this signal by the provider is not permitted to consider the inertia, which has an effect on the torque at clutch. This means that the signal must be calculated as if the inertia is 0 kg*(m^2). Example for accuracy requirements in a typical series project: ±5 %. Data format for typical network representation for series projects: Uint12 Unit: Nm Type: linear Resolution: 1 Offset: -2048 Physically used range: Hex Lower/Upper Limit: 0h / FFDh Physical Lower/Upper Limit: -2048 / 2045 Special values outside the physically used range: FFEh = Init FFFh = Error, Signal content invalid Cycle Time: 10 ms (max.) for internal calculation and bus communication. Typical Provider: Powertrain Typical Receiver: Transmission
    PtTqCluMaxCluNCurShoTerm: interface=PtTqCluMaxCluNCurShoTerm1  # Powertrain: Maximum Torque at Clutch at Current Clutch Speed Short Term Attainable | Maximum possible torque at clutch at current clutch speed which is short term attainable. | For non-hybrid projects this signal reflects the full load engine torque at clutch at current engine speed, which the engine could implement within a short time period, for example, 200 ms. This period must be defined in close cooperation between engine experts and transmission experts. It is calculated at current ambient pressure and air temperature and includes the static power limitation of the engine. In parallel hybrid projects, the signal is the sum of the maximum torque of combustion engine and electric machine, considering the engine clutch state. The static power limitation contains, e.g., restrictions for protection and static soot limitation. Permanent knock limitation is considered, knock control is not considered. The calculation of this signal by the provider is not permitted to consider the inertia, which has an effect on the torque at clutch. This means that the signal must be calculated as if the inertia is 0 kg*(m^2). Example for accuracy requirements in a typical series project: ±5 %. Data format for typical network representation for series projects: Uint12 Unit: Nm Type: linear Resolution: 1 Offset: -2048 Physically used range: Hex Lower/Upper Limit: 0h / FFDh Physical Lower/Upper Limit: -2048 / 2045 Special values outside the physically used range: FFEh = Init FFFh = Error, Signal content invalid Cycle Time: 10 ms (max.) for internal calculation and bus communication. Typical Provider: Powertrain Typical Receiver: Transmission
    PtTqCluMaxDrv: interface=PtTqCluMaxDrv1  # Powertrain: Maximum Available Torque at Clutch for Driver | Maximum possible torque at clutch at optimum conditions delivered by powertrain for driver | Example of realization: Could take into account: current engine speed, ambient pressure, air temperature, static power limitation due to engine, auxiliaries (everything with impact to the torque output, e.g. power steering pump, Air Conditioner (A/C), generator or starter generator), smoke limitation, fuel quality correction Including maximum over boost
    PtTqCluMinByIgnRtd: interface=PtTqCluMinByIgnRtd1  # Powertrain: Minimum Torque at Clutch By Ignition Retard | Minimum torque at clutch, which the powertrain can provide in the short term, e.g. on engine side by the minimum permitted ignition angle. Cylinder cut-off must NOT be considered. | This signal is needed by the transmission to determine the intensity of the torque intervention. The signal is necessary for the shift strategy to guarantee a comfortable operation of the powertrain system. The engine contribution to this signal is calculated at current engine speed with current air mass, current ambient pressure and current air temperature. In parallel hybrid projects, the torque coordinator must additionally consider the min. torque, which the electric machine(s) could implement at clutch in the current operating point. In projects with engine clutch, the current state of the engine clutch must be considered. The calculation of this signal by the provider is not permitted to consider the inertia, which has an effect on the torque at clutch. This means that the signal must be calculated as if the inertia is 0 kg*(m^2). Example for accuracy requirements in a typical series project: ±7 % or ±5 Nm (max. selection), max. deviation ±20 Nm. Data format for typical network representation for series projects: Uint12 Unit: Nm Type: linear Resolution: 1 Offset: -2048 Physically used range: Hex Lower/Upper Limit: 0h / FFDh Physical Lower/Upper Limit: -2048 / 2045 Special values outside the physically used range: FFEh = Init FFFh = Error, Signal content invalid Cycle Time: 10 ms (max.) for internal calculation and bus communication. Typical Provider: Powertrain Typical Receiver: Transmission
    PtTqCluMinDrv: interface=PtTqCluMinDrv1  # Powertrain: Minimum Available Torque at Clutch for Driver | Minimum possible torque at clutch delivered by powertrain for driver | Example of realization: Could take into account: Losses of auxiliaries, integral part of idle speed controller, indicated torque, engine friction, fuel cut off
    PtTqCluMinFast: interface=PtTqCluMinFast1  # Powertrain: Minimum Torque at Clutch Fast Path | Minimum torque at clutch, which the powertrain can provide in the short term, e.g. on engine side by the minimum permitted ignition angle and cylinder cut-off. | This signal is needed by the transmission to determine the intensity of the torque intervention. The engine contribution to this signal is calculated at current engine speed with current air mass, current ambient pressure and current air temperature. In parallel hybrid projects, the torque coordinator must additionally consider the min. torque, which the electric machine(s) could implement at clutch in the current operating point. In projects with engine clutch, the current state of the engine clutch must be considered. The calculation of this signal by the provider is not permitted to consider the inertia, which has an effect on the torque at clutch. This means that the signal must be calculated as if the inertia is 0 kg*(m^2). Example for accuracy requirements in a typical series project: ±7 % or ±5 Nm (max. selection), max. deviation ±20 Nm. Data format for typical network representation for series projects: Uint12 Unit: Nm Type: linear Resolution: 1 Offset: -2048 Physically used range: Hex Lower/Upper Limit: 0h / FFDh Physical Lower/Upper Limit: -2048 / 2045 Special values outside the physically used range: FFEh = Init FFFh = Error, Signal content invalid Cycle Time: 10 ms (max.) for internal calculation and bus communication. Typical Provider: Powertrain Typical Receiver: Transmission
    PtTqCluReqWoTrsmIntv: interface=PtTqCluReqWoTrsmIntv1  # Powertrain: Requested Torque at Clutch without Transmission Intervention | Driver torque request including all interventions except transmission shift interventions and including all limitations. | Limitations include environmental conditions such as altitude, temperature, etc. and engine limitations such as soot limitation, full load limit, etc. The goal is that the torque information is sent 50 – 80 ms ahead of the desired real/physical torque. For further explanation see signal "Powertrain: Driver Request of Torque at Clutch". In parallel hybrid projects, the signal is the sum of the torque request to the electric machine and that part of the torque request to the combustion engine, which is transferred by the engine clutch. The sum does not consider the transmission intervention. References to other signals: PtDrvrReqTqClu Data format for typical network representation for series projects: Uint12 Unit: Nm Type: linear Resolution: 1 Offset: -2048 Physically used range: Hex Lower/Upper Limit: 0h / FFDh Physical Lower/Upper Limit: -2048 / 2045 Special values outside the physically used range: FFEh = Init FFFh = Error, Signal content invalid Cycle Time: 10 ms (max.) for internal calculation and bus communication. Typical Provider: Powertrain Typical Receiver: Transmission Example for “Timing and accuracy requirements on torque signals” in a typical series project: The following image illustrates the respective accuracy requirements: The image “Detailed signal content of Torque at Clutch Signals” shows the effects of functionalities on the torque at clutch signals. Example: “Soot limitation” is marked with an “X” to indicate that it is considered in the signal.
    PtTqCluTarGear: interface=PtTqCluTarGear1  # Powertrain: Predicted Torque at Clutch at Target Gear | Used for Dual Clutch Transmission (DCT) to calculate the clutch pressure to terminate the shifting comfortably. This torque is calculated with actual pedal position and an engine speed at target gear. | Default value after reset is zero
    PtTqCluWoTrsmIntv: interface=PtTqCluWoTrsmIntv1  # Powertrain: Torque at Clutch without Transmission Intervention | Torque at clutch that would be implemented if no transmission shift interventions are active. | Outside of a transmission intervention, the signal should show the same value as "Powertrain: Torque at Clutch”. Highly dynamic torque contributions by anti jerk are not visible, in contrary to signal “Powertrain: Torque at Clutch”. During interventions, the signal should show the desired torque without considering the intervention, independent of implementation by ignition, air, cylinder cutoff. The effects of the transmission request for shifts on the air path or cylinder cutoff are NOT considered, not even if the fast path request can only be implemented by affecting the air path or cylinder cutoff. The calculation of this signal by the provider is not permitted to consider the inertia, which has an effect on the torque at clutch. This means that the signal must be calculated as if the inertia is 0 kg*(m^2). References to other signals: PtTqClu Data format for typical network representation for series projects: Uint12 Unit: Nm Type: linear Resolution: 1 Offset: -2048 Physically used range: Hex Lower/Upper Limit: 0h / FFDh Physical Lower/Upper Limit: -2048 / 2045 Special values outside the physically used range: FFEh = Init FFFh = Error, Signal content invalid Cycle Time: 10 ms (max.) for internal calculation and bus communication. Typical Provider: Powertrain Typical Receiver: Transmission Example for “Timing and accuracy requirements on torque signals” in a typical series project: The following image illustrates the respective accuracy requirements: The image “Detailed signal content of Torque at Clutch Signals” shows the effects of functionalities on the torque at clutch signals. Example: “Soot limitation” is marked with an “X” to indicate that it is considered in the signal.
    PtTqCrksftRedByAncllryLossReq: interface=PtTqCrksftRedByAncllryLossReq1  # Powertrain: Requested Torque at Crankshaft Reduced by Ancillary Losses | Requested torque at crankshaft reduced by ancillary losses, including all interventions, including all limitations. | The signal contains the limitations which are closely related to the combustion engine or which are attributed to the combustion engine by the powertrain coordinator. The calculation of this signal by the provider is not permitted to consider the inertia, which has an effect on the torque at clutch. This means that the signal must be calculated as if the inertia is 0 kg*(m^2). The signal contains all interventions. The goal is that the torque information is sent 50 – 80 ms ahead of the desired real/physical torque. Data format for typical network representation for series projects: Uint12 Unit: Nm Type: linear Resolution: 1 Offset: -2048 Physically used range: Hex Lower/Upper Limit: 0h / FFDh Physical Lower/Upper Limit: -2048 / 2045 Special values outside the physically used range: FFEh = Init FFFh = Error, Signal content invalid Cycle Time: 10 ms (max.) for internal calculation and bus communication. Typical Provider: Powertrain Typical Receiver: Engine Example for “Timing and accuracy requirements on torque signals” in a typical series project: The following image illustrates the respective accuracy requirements: The image “Detailed signal content of Torque at Clutch Signals” shows the effects of functionalities on the torque at clutch signals. Example: “Soot limitation” is marked with an “X” to indicate that it is considered in the signal.
    PtTqCrksftReqFast: interface=PtTqCrksftReqFast1  # Crankshaft Torque Request to Be Realized by the Fast Path of Powertrain | Required crankshaft torque which should be generated by engine. The engine will restrict this request to its internal limits. | Example of realization: Including fast torque intervention from brake control, transmission control etc.
    PtTqCrksftReqSlow: interface=PtTqCrksftReqSlow1  # Crankshaft Torque Request to Be Realized by the Slow Path of Powertrain | Crankshaft torque which should be realized by the slow path to prepare the engine for a future torque setpoint. The engine will restrict this request to its internal limits. | Example of realization: If there is no distinction between slow and fast path control within the engine management (e.g. for a Diesel engine), this signal can be ignored by the engine management. Without fast torque intervention from brake control, transmission control etc.
    PtTqDecAtWhlsReqByEscFast: interface=PtTqTotAtWhls1  # Powertrain Torque Decrease at Wheels Request by Stability Control Fast | Decreasing torque at wheels requested by Electronic Stability Control below the driver input torque including virtual driver request. Fast refers to the immediate / instant torque request, typically achieved by ignition timing.
    PtTqDecAtWhlsReqByEscSlow: interface=PtTqTotAtWhls1  # Powertrain Torque Decrease at Wheels Request by Stability Control Slow | Decreasing torque at wheels requested by Electronic Stability Control over the driver input torque including virtual driver (target value). Slow refers to the longer term or torque reserve request, usually the input to throttle control.
    PtTqDistbnToWhlsReqdByDtd: interface=PtTqDistbnToWhls1  # Requested Drivetrain Torque Distribution | The Drivetrain Torque Distribution strategy in Chassis requests a distribution of the total powertrain torque at wheels, not a modification to that total torque. Therefore the distribution is requested as a percentage value for each wheel.
    PtTqIncAtWhlsReqByEscFast: interface=PtTqTotAtWhls1  # Powertrain Torque Increase at Wheels Request by ESC Fast | Increasing torque at wheels requested by Electronic Stability Control over the driver input torque including virtual driver (target value). Fast refers to the immediate / instant torque request, typically achieved by ignition timing.
    PtTqIncAtWhlsReqByEscSlow: interface=PtTqTotAtWhls1  # Powertrain Torque Increase at Wheels Request by Stability Control Slow | Increasing torque at wheels requested by Electronic Stability Control over the driver input torque including virtual driver (target value). Slow refers to the longer term or torque reserve request, usually the input to throttle control.
    PtTqJClu: interface=PtTqJClu1  # Powertrain: Torque of Inertia at Clutch | Dynamic moment of inertia of all components of the drive unit on clutch level. Definition of the sign: An increasing speed produces a negative sign; a decreasing speed produces a positive sign. | The signal contains the dynamic torque caused by the inertia which increases or decreases the torque at clutch. The engine internal inertia and the inertia of the ancillaries up to the clutch must be considered. In parallel hybrid projects, the inertia of combustion engine and electric machine are considered. Additionally, the inertia of engine clutch must be considered. Data format for typical network representation for series projects: Uint12 Unit: Nm Type: linear Resolution: 1 Offset: -2048 Physically used range: Hex Lower/Upper Limit: 0h / FFDh Physical Lower/Upper Limit: -2048 / 2045 Special values outside the physically used range: FFEh = Init FFFh = Error, Signal content invalid Cycle Time: 10 ms (max.) for internal calculation and bus communication. Typical Provider: Powertrain Typical Receiver: Transmission
    PtTqMaxAc: interface=PtTqMaxAc1  # Powertrain: Maximum Allowed Torque for A/C Compressor | Allowable torque for Air Conditioning (A/C) compressor. It is an engine crankshaft torque. Examples of realization: This interface could contain either - the torque that the Air Conditioning (A/C) compressor is allowed to consume in steady state - the highest torque that the Air Conditioning (A/C) compressor is allowed to consume at any point in time
    PtTqMaxAlt: interface=PtTqMaxAlt1  # Powertrain: Maximum Allowed Mechanical Load for Alternator (Generator) at Engine Crank Shaft | Allowed mechanical load for alternator (generator) at engine crank shaft.
    PtTqMaxHvac: interface=PtTqMaxHvac1  # Powertrain: Maximum Allowed Torque for A/C Compressor | Allowable torque for Air Conditioning (A/C) compressor. It is an engine crankshaft torque. Examples of realization: This interface could contain either - the torque that the Air Conditioning (A/C) compressor is allowed to consume in steady state - the highest torque that the Air Conditioning (A/C) compressor is allowed to consume at any point in time
    PtTqMaxSteer: interface=PtTqMaxSteer1  # Powertrain: Maximum Allowed Mechanical Load for Steering at Engine Crank Shaft | Allowed mechanical load for steering at engine crank shaft. | In case of electric steering, this should be zero Nm, because the load is included in alternator load.
    PtTqMaxTrsmOilPmp: interface=PtTqMaxTrsmOilPmp1  # Powertrain: Maximum Allowed Transmission Oil Pump Load | Maximum allowed transmission oil pump load at engine crank shaft. | If the oil pump is driven by the engine crank shaft then this value must take into account all relevant dynamic effects. If it is an electric oil pump, the value should be zero Nm, because the load is included in alternator load. The value of this signal is converted to engine crank shaft torque by the provider.
    PtTqResvEng: interface=PtTqResvEng1  # Torque Reserve Request from Powertrain to Engine | Reserved torque request coordinated in the Powertrain coordinator (PTC) to be realized by the combustion engine. The coordination can consider multiple reserved torque requirements, e.g. auxiliary loads such as Air Conditioning (A/C) compressor. | Default value after reset is zero
    PtTqResvReqEng: interface=PtTqResvReqEng1  # Torque Reserve Request from Powertrain to Engine | Reserved torque request coordinated in the Powertrain coordinator (PTC) to be realized by the combustion engine. The coordination can consider multiple reserved torque requirements, e.g. auxiliary loads such as Air Conditioning (A/C) compressor. | Default value after reset is zero.
    PtTqTotActAtWhls: interface=PtTqWhl1  # Powertrain Torque Total Actual at Wheels | Total wheel torque provided by powertrain (sum of torques at wheels) | This signal is computed from "Actual torque at clutch" and other torque losses with influence on wheel torque (e.g. converter, differential). It considers all torque interventions. It includes the actual torque ratio. Negative values indicate drag torque, independently from driving direction.Default value after reset is zero.
    PtTqTotAvlMaxAtWhls: interface=PtTqWhlMax1  # Powertrain Torque Total Available Maximum at Wheels | Maximum possible total torque at wheels. | Example of realization: Could take into account: Current engine speed, ambient pressure, air temperature, static power limitation due to engine, auxiliaries (everything with impact to the torque output, e.g. power steering pump, air conditioner (A/C), generator or starter generator), smoke limitation, fuel quality correction. Incl. actual over boost (whilst temporarily active triggered by driver request). The calculation of torque at wheel could take into account the current gear, hydraulic converter and all losses in the transmission system.Must be initialised to the upper limit of the chosen data type.
    PtTqTotAvlMinAtWhls: interface=PtTqWhlMinWoCutOff1  # Powertrain Torque Total Available Minimum at Wheels | Minimum possible total powertrain torque at wheels without complete fuel cut off. | Any torque value between minimum and maximum can be requested and it is expected that the Powertrain Coordinator (PTC) will deliver that value. Example of realization: Could take into account: Losses of auxiliaries, integral part of idle speed controller, indicated torque, engine friction, fuel cut off Complete fuel cut off excluded, since these are just the complete losses. This is the minimum torque value which can be achieved without any discontinuity and/or impact on emissions.Must be initialised to the lower limit of the chosen data type.
    PtTqTotFastReqAtWhlsByRsc: interface=PtTqTotAtWhls2  # Powertrain Torque Total Fast at Wheels Request by RSC | Requested wheel torque from Roll Stability Control (RSC) to Electronic Stability Control (ESC) (fast). The maximum torque is to be delivered by the powertrain, e.g. a torque decrease request [absolute] for Acceleration Slip Control (ASC) (to prevent wheel spin). The minimum torque is to be delivered by the powertrain, e.g. a torque increase request [absolute] for Engine Drag Torque Control (MSR) (to prevent wheel lock up). If the maximum request is less than the minimum request, the priority must be clearly defined. If no request is active, the value will be the upper limit of the chosen data type. | Must be initialised to the upper and lower limit of the chosen data type.
    PtTqTotMaxAtWhlsReqdByVlc: interface=PtTqTotAtWhls1  # Maximum Torque at Wheel by Vehicle Longitudinal Control (VLC) | Requested wheel torque (to all the driven wheels) after coordination among several vehicle longitudinal control systems (e.g. cruise control, adaptive cruise control, collision mitigation) to be generated by the powertrain. This is the maximum torque to be delivered by the powertrain, e.g. a torque limit request [absolute] (vehicle speed limitation). If the maximum request is less than the minimum request the priority is the Maximum Request (which in the case is the lower value!). If no request is active, the value will be the upper limit of the chosen data type. | Must be initialised to the upper limit of the chosen data type.
    PtTqTotMinAtWhlsReqdByVlc: interface=PtTqTotAtWhls1  # Minimum Torque at Wheel by Vehicle Longitudinal Control (VLC) | Requested wheel torque (to all the driven wheels) after coordination among several vehicle longitudinal control systems (e.g. cruise control, adaptive cruise control, collision mitigation) to be generated by the powertrain. This is the minimum torque to be delivered by the powertrain, e.g. a torque request [absolute] for CC/ACC (Cruise Control, Adaptive Cruise Control). If the maximum request is less than the minimum request the priority must be clearly defined. If no request is active, the value will be the lower limit of the chosen data type. | Must be initialised to the lower limit of the chosen data type.
    PtTqTotReqdAtWhls: interface=PtTqWhlReq1  # Powertrain Torque Total Requested at Wheels | Total requested propulsion wheel torque (sum of torques at wheel). Output wheel torque request from powertrain coordinator (includes wheel torque requests: driver / Vehicle Longitudinal Control (VLC) / Electronic Stability Control (ESC) ). | Negative values indicate drag torque, independently from driving direction.Default value after reset is zero.
    PtTqTotReqdAtWhlsForVlc: interface=PtTqWhlReqDrvVlc1  # Powertrain Torque Total Requested at Wheels for Vehicle Longitudinal Control (VLC) | Total requested propulsion wheel torque (sum of torques at wheel) by the driver or Vehicle Longitudinal Control (VLC). Result of arbitration of driver vs. driver assistance functions in powertrain coordinator.
    PtTqTotSlowReqAtWhlsByRsc: interface=PtTqTotAtWhls2  # Powertrain Torque Total Slow at Wheels Request by RSC | Requested wheel torque from Roll Stability Control (RSC) to Electronic Stability Control (ESC) (slow). The maximum torque is to be delivered by the powertrain, e.g. a torque decrease request [absolute] for Acceleration Slip Control (ASC) (to prevent wheel spin). The minimum torque is to be delivered by the powertrain, e.g. a torque increase request [absolute] for Engine Drag Torque Control (MSR) (to prevent wheel lock up). If the maximum request is less than the minimum request, the priority is the maximum request (which is the lower value in this case!) If no request is active, the value will be the upper limit of the chosen data type. | Must be initialised to the upper and lower limit of the chosen data type.
    PtTqWhl: interface=PtTqWhl1  # Total Wheel Torque Provided by Powertrain | Total wheel torque provided by powertrain (sum of torques at wheels) | This signal is computed from "Actual torque at clutch" and other torque losses with influence on wheel torque (e.g. converter, differential). It considers all torque interventions. It includes the actual torque ratio. Negative values indicate drag torque, independently from driving direction.Default value after reset is zero
    PtTqWhlInd: interface=PtTqWhlInd1  # Torque Delivered by the Powertrain to the Individual Wheels | Vector of 4 signals. Consolidated torque delivered by the powertrain to the individual wheels. The sum of all 4 signals must be equal to Actual total powertrain torque at wheels. | In case of actor/sensor failures or if there is no possibility to determine the correct distribution a rough estimation is done.
    PtTqWhlMax: interface=PtTqWhlMax1  # Powertrain: Maximum Possible Total Torque at Wheels | Maximum possible total torque at wheels. | Example of realization: Could take into account: current engine speed, ambient pressure, air temperature, static power limitation due to engine, auxiliaries (everything with impact to the torque output, e.g. power steering pump, Air Conditioner (A/C), generator or starter generator), smoke limitation, fuel quality correction Incl. actual over boost (whilst temporarily active triggered by driver request). The calculation of torque at wheel could take into account the current gear, hydraulic converter and all losses in the transmission system.Must be initialised to the upper limit of the chosen data type.
    PtTqWhlMaxDrv: interface=PtTqWhlMaxDrv1  # Maximum Possible Total Torque at Wheels at Optimum Conditions Delivered by Powertrain for Driver | Maximum possible total torque at wheels at optimum conditions delivered by powertrain for Driver | Example of realization: Could take into account: current engine speed, ambient pressure, air temperature, static power limitation due to engine, auxiliaries (everything with impact to the torque output, e.g. power steering pump, Air Conditioner (A/C), generator or starter generator), smoke limitation, fuel quality correction Incl. maximum over boost The calculation of torque at wheel could take into account the current gear, hydraulic converter and all losses in the transmission system.Must be initialised to the upper limit of the chosen data type.
    PtTqWhlMin: interface=PtTqWhlMin1  # Minimum Available Total Powertrain Torque at Wheels | Minimum possible total powertrain torque at wheels "for unfired engine". Lowest possible value of the torque delivered to the wheels by the powertrain assuming that complete fuel cut off is enabled. | Example of realization: Could take into account: Losses of auxiliaries, engine friction, complete fuel cut off'Must be initialised to the lower limit of the chosen data type.'
    PtTqWhlMinDrv: interface=PtTqWhlMinDrv1  # Minimum Possible Total Torque at Wheels Delivered by Powertrain for Driver | Minimum possible total torque at wheels delivered by powertrain for driver | Example of realization: Could take into account: Losses of auxiliaries, integral part of idle speed controller, indicated torque, engine friction, fuel cut off'Must be initialised to the lower limit of the chosen data type.'
    PtTqWhlMinWoCutOff: interface=PtTqWhlMinWoCutOff1  # Minimum Possible Total Powertrain Torque at Wheels without Complete Fuel Cut Off | Minimum possible total powertrain torque at wheels without complete fuel cut off. | Any torque value between minimum and maximum can be requested and it is expected that the Powertrain Coordinator (PTC) will deliver that value. Example of realization: Could take into account: Losses of auxiliaries, integral part of idle speed controller, indicated torque, engine friction, fuel cut off Complete fuel cut off excluded, since these are just the complete losses. This is the minimum torque value which can be achieved without any discontinuity and/or impact on emissions.Must be initialised to the lower limit of the chosen data type.
    PtTqWhlReq: interface=PtTqWhlReq1  # Powertrain: Total Requested Propulsion Wheel Torque | Total requested propulsion wheel torque (sum of torques at wheel). Output wheel torque request from powertrain coordinator (includes wheel torque requests driver / Vehicle Longitudinal Control (VLC) / Electronic Stability Control (ESC) ). | Negative values indicate drag torque, independently from driving direction.Default value after reset is zero.
    PtTqWhlReqDrvVlc: interface=PtTqWhlReqDrvVlc1  # Powertrain: Total Requested Propulsion Wheel Torque by the Driver or Vehicle Longitudinal Control (VLC) | Total requested propulsion wheel torque (sum of torques at wheel) by the driver or Vehicle Longitudinal Control (VLC). Result of arbitration of driver vs. driver assistance functions in powertrain coordinator. | Negative values indicate drag torque, independently from driving direction.
    PuddleLi: interface=LiExtCmd1  # Puddle Light | This port provides command to turn on/off puddle lights
    PuddleLiLeOut: interface=LiExtCmd1  # Puddle Light Left Output | This port provides command to turn on/off left puddle lights
    PuddleLiRiOut: interface=LiExtCmd1  # Puddle Light Right Output | This port provides command to turn on/off right puddle lights
    PullAid: interface=PullAidCmd1  # Door Pull Aid | Command to assist the movement of a door
    PullAidOfDoorLockReLe: interface=PullAidCmd1  # Rear Door Pull Aid | This port provide the Pull Aid Command to assist the movement of a rear door.
    PullAidOfDoorLockReRi: interface=PullAidCmd1  # Rear Door Pull Aid | This port provide the Pull Aid Command to assist the movement of a rear door.
    PullAidOfDrvrDoorLock: interface=PullAidCmd1  # Front Door Pull Aid | This port provide the Pull Aid Command to assist the movement of a front door.
    PullAidOfLidRe: interface=PullAidCmd1  # Pull Aid of Lid Rear | This port provide the Pull Aid Command to assist the movement of the rear lid.
    PullAidOfPassDoorLock: interface=PullAidCmd1  # Front Door Pull Aid | This port provide the Pull Aid Command to assist the movement of a front door.
    PwrSply: interface=PwrSplySt1  # Power Supply | Current power supply status
    RadioFrqPanic: interface=RadioFrqPanicReq1  # Radio Frequency Panic | Request to activate panic alarm from Radio Frequency (RF)
    RadioSt: interface=RadioSt1  # Radio Status | Radio presence status
    RadioSts: interface=RadioSts1  # Radio Status | Radio presence status
    RainAmntSt: interface=RainAmntSt1  # Rain Amount Status | information related to the amount of rain detected by the rain sensor
    RainAmntSts: interface=RainAmntSts1  # Rain Amount Status | information related to the amount of rain detected by the rain sensor
    RainSenErr: interface=RainSenErr1  # Rain Sensing Error | Information related to errors or defects detected on the rain sensor
    RainSenReq: interface=RainSenReq1  # Rain Sensing Request | Request switching on off rain sensing and a rain sensing sensitivity level.
    RideHeiLvlEstimdFrnt: interface=RideHeiLvl1  # Ride Height Level Estimated Front | The actual estimated ride height at the front axle.
    RideHeiLvlEstimdRe: interface=RideHeiLvl1  # Ride Height Level Estimated Rear | The actual estimated ride height at the rear axle.
    RideHeiLvlMeasdFrnt: interface=RideHeiLvl1  # Ride Height Level Measured Front | The measured ride height at the front axle (Filtered and offset compensated).
    RideHeiLvlMeasdFrntBas: interface=RideHeiLvl1  # Ride Height Level Measured Front Base | The actual measured ride height at the front axle.
    RideHeiLvlMeasdFrntRaw: interface=RideHeiLvl1  # Ride Height Level Measured Front Raw | The actual measured ride height at the front axle.
    RideHeiLvlMeasdFrntStd: interface=RideHeiLvl1  # Ride Height Level Measured Front Standard | The actual measured ride height at the front axle (Filtered and offset compensated).
    RideHeiLvlMeasdRe: interface=RideHeiLvl1  # Ride Height Level Measured Rear | The measured ride height at the rear axle (Filtered and offset compensated).
    RideHeiLvlMeasdReBas: interface=RideHeiLvl1  # Ride Height Level Measured Rear Base | The actual measured ride height at the rear axle.
    RideHeiLvlMeasdReRaw: interface=RideHeiLvl1  # Ride Height Level Measured Rear Raw | The actual measured ride height at the rear axle.
    RideHeiLvlMeasdReStd: interface=RideHeiLvl1  # Ride Height Level Measured Rear Standard | The actual measured ride height at the rear axle (Filtered and offset compensated).
    RoadBnkAEstimnByEsc: interface=RoadBnkAEstimn1  # Road Bank Acceleration Estimated by ESC | Acceleration component resulting from a banked road provided by Electronic Stability Control (ESC).
    RoadCdn: interface=RoadCdnSt1  # Road Condition | Information about road condition status
    RoadExct: interface=RoadExct1  # Road Excitation | Vertical wheel oscillation amplitude and frequency
    RoadInclnAEstimn: interface=RoadInclnAEstimn1  # Road Inclination Acceleration Estimated | Acceleration component resulting from road inclination in terms of vehicle coordinates. Estimated from longitudinal acceleration from wheel speeds and longitudinal acceleration sensor.
    RoadWhlAgAbsltFrntReqBySteerDrvrAsscSys: interface=RoadWhlAg1  # Road Wheel Angle Absolute Front Request by Steering Driver Assistance System | Requested road wheel angle for front steering actuator by Steering Driver Assistance System.
    RoadWhlAgAbsltFrntReqBySteerVehStabyCtrl: interface=RoadWhlAg1  # Road Wheel Angle Absolute Front Request by Steering Vehicle Stabilizing Control | Requested road wheel angle for front steering actuator by Steering Vehicle Stabilizing System.
    RoadWhlAgAbsltReReqBySteerDrvrAsscSys: interface=RoadWhlAg1  # Road Wheel Angle Absolute Rear Request by Steering Driver Assistance System | Requested absolute road wheel angle for rear wheel steering actuator by Steering Driver Assistance System.
    RoadWhlAgAbsltReReqBySteerVehStabyCtrl: interface=RoadWhlAg1  # Road Wheel Angle Absolute Rear Request by Steering Vehicle Stabilizing Control | Requested absolute road wheel angle for rear wheel steering actuator by Steering Vehicle Stabilizing System.
    RoadWhlAgDeltaFrntReqBySteerDrvrAsscSys: interface=RoadWhlAg1  # Road Wheel Angle Delta Front Request by Steering Driver Assistance System | Driver Assistance System (DAS) requests additional (road wheel) steer angle interventions via front steering actuator (= delta steer angle at steered wheels, at angle superposition steering systems: Middle front axle delta steering angle). Angle related to average front wheel angle.
    RoadWhlAgDeltaFrntReqBySteerVehStabyCtrl: interface=RoadWhlAg1  # Road Wheel Angle Delta Front Request by Steering Vehicle Stabilizing Control | Steering Vehicle Stabilizing Control requests delta (road wheel) steer angle interventions via front steering actuator (= delta steer angle at steered wheels, at angle superposition steering systems: Middle front axle delta steering angle). Angle related to average front wheel angle.
    RoadWhlAgDeltaReReqBySteerDrvrAsscSys: interface=RoadWhlAg1  # Road Wheel Angle Delta Rear Request by Steering Driver Assistance System | Driver Assistance System (DAS) requests additional road wheel steer angle interventions via rear steering actuator (= delta steer angle at steered wheels, at angle superposition steering systems: Middle rear axle delta steering angle). Actual not mediated.
    RoadWhlAgDeltaReReqBySteerVehStabyCtrl: interface=RoadWhlAg1  # Road Wheel Angle Delta Rear Request by Steering Vehicle Stabilizing Control | Steering Vehicle Stabilizing Control requests delta road wheel steer angle interventions via rear steering actuator (= delta steer angle at steered wheels, at angle superposition steering systems: Middle rear axle delta steering angle).
    RoadWhlAgEstimdFrnt: interface=RoadWhlAg1  # Road Wheel Angle Estimated Front | Road wheel angle at front steered wheels. Includes all steering control algorithms (e.g. calculated by a relation converter: Steer wheel angle - road wheel angle using a characteristic map).
    RoadWhlAgEstimdFrntWishdByDrvr: interface=RoadWhlAg1  # Road Wheel Angle Estimated Front Wished by Driver | Front road wheel angle driver wish based on the driver steering wheel input angle plus Variable Gear Ratio plus Steering Driver Assistance System angle. Does not include additional steering road wheel angle from stabilizing control algorithms.
    RoadWhlAgEstimdRe: interface=RoadWhlAg1  # Road Wheel Angle Estimated Rear | Actual estimated road wheel angle at rear steered wheels. Includes all steering control algorithms (e.g. calculated by a relation converter: Steer wheel angle - road wheel angle using a characteristic map).
    RoadWhlAgSpdEstimdFrnt: interface=RoadWhlAgSpd1  # Road Wheel Angle Speed Estimated Front | Time-derivative of the estimated front road wheel angle.
    RoadWhlAgSpdEstimdFrntWishdByDrvr: interface=RoadWhlAgSpd1  # Road Wheel Angle Speed Estimated Front Wished by Driver | Time-derivative of front road wheel angle driver wish.
    RoadWhlAgTotReqFrnt: interface=RoadWhlAg2  # Road Wheel Angle Total Request Front | Total front road wheel angle requests after arbitration of the high level steering functions.
    RoadWhlAgTotReqRe: interface=RoadWhlAg2  # Road Wheel Angle Total Request Rear | Total rear road wheel angle requests after arbitration of the high level steering functions.
    RollCmpLvl: interface=RollCmpLvl1  # Roll Compensation Level | The current compensation level of the body roll angle
    RollMomtmDistbn: interface=RollMomtmDistbn1  # Roll Momentum Distribution | Estimated stabilizer roll torque difference front to rear defined relative to the total stabilizer torque (front and rear)
    RollRateAtCen: interface=RollRate3  # Roll Rate at Center | Roll Rate from sensor element. Coordinate system according to ISO 8855. Raw signal
    RollRateBas: interface=RollRate1  # Roll Rate Base | Roll Rate from sensor element. Coordinate system according to ISO 8855. Raw signal.
    RollRateMeasd: interface=RollRate1  # Roll Rate Measured | Roll Rate from sensor element. Coordinate system according to ISO 8855. Derived from Base Signal after filtering, Offset-Compensation, Model-based Plausibility Check, etc.
    RollRateRaw: interface=RollRate1  # Roll Rate Raw | Roll Rate from sensor element. Coordinate system according to ISO 8855. Raw signal.
    RollRateRngExtd: interface=RollRate2  # Roll Rate Range Extended | Roll Rate from sensor element. Coordinate system according to ISO 8855. Extended signal range.
    RollRateStd: interface=RollRate1  # Roll Rate Standard | Roll Rate from sensor element. Coordinate system according to ISO 8855. Derived from Base Signal after filtering, Offset-Compensation, Model-based Plausibility Check, etc.
    RoofCnvtbCmd: interface=RoofCnvtbCmd1  # Convertible Roof Command | Command for convertible operation: to open or close the convertible roof
    RoofCnvtbInTr: interface=UpReqForRoofCnvtb1  # Convertible Roof Up Request | Request related to Roof folded in the trunk. This request assists the customer to open the trunk with the roof folded in for a luggage access.
    RoofCnvtbInfo: interface=RoofCnvtbSt1  # Convertible Roof Information | Information on the convertible roof (Opened or Closed)
    RoofCnvtbReqFromHmi: interface=RoofCnvtbReq1  # Convertible Roof Request from HMI | Request from Hmi to get the vehicle in a convertible mode
    RoofCnvtbReqRem: interface=RoofCnvtbReq1  # Convertible Roof Request from Remote Key | Request from the remote key to get the vehicle in a convertible mode
    RoofCnvtbSt: interface=RoofCnvtbSt1  # Convertible Roof Status | Information on the convertible roof (Opened or Closed), needed for an internal use of the function
    RoofCnvtbSts: interface=RoofCnvtbSts1  # Convertible Roof Status | Information on the convertible roof (Opened or Closed), needed for an internal use of the function
    RoofPosn: interface=PosnSt1  # Roof Position | Position of the convertible roof
    RoofUnlckd: interface=SnsrRoofCnvtbSt1  # Roof Unlocked Status | Status of convertible sensor for roof unlocked
    RscCtrlDi: interface=RscCtrlDi1  # RSC Control Disable | Roll Stability Control is disabled due to detected fault or electronic control unit (ECU) initialization.
    RscCtrlIntvgPerWhl: interface=RscCtrlIntvgPerWhl1  # RSC Control Intervening per Wheel | Wheel has roll stability control intervening. Wheel individual.
    SeatAxisActtn: interface=SeatMove1  # Seat Axis Actuation Command | This port allows a command of the axis movement in a certain direction, with a certain speed
    SeatAxisMemPosn: interface=SeatStorePosnSt1  # Seat Axis Memory Position | Memory-position data from storage memory for the current profile of a certain seat axis.
    SeatAxisMemPosnOfAxisActrBackBlstrLe: interface=SeatStorePosnSt1  # Seat Axis Memory Position | Memory position data from storage memory for the current profile of a certain seat axis.
    SeatAxisMemPosnOfAxisActrBackBlstrRi: interface=SeatStorePosnSt1  # Seat Axis Memory Position | Memory position data from storage memory for the current profile of a certain seat axis.
    SeatAxisMemPosnOfAxisActrCushBlstrLe: interface=SeatStorePosnSt1  # Seat Axis Memory Position | Memory position data from storage memory for the current profile of a certain seat axis.
    SeatAxisMemPosnOfAxisActrCushBlstrRi: interface=SeatStorePosnSt1  # Seat Axis Memory Position | Memory position data from storage memory for the current profile of a certain seat axis.
    SeatAxisMemPosnOfAxisActrCushExtn: interface=SeatStorePosnSt1  # Seat Axis Memory Position | Memory position data from storage memory for the current profile of a certain seat axis.
    SeatAxisMemPosnOfAxisActrHdrestFold: interface=SeatStorePosnSt1  # Seat Axis Memory Position | Memory position data from storage memory for the current profile of a certain seat axis.
    SeatAxisMemPosnOfAxisActrHdrestHei: interface=SeatStorePosnSt1  # Seat Axis Memory Position | Memory position data from storage memory for the current profile of a certain seat axis.
    SeatAxisMemPosnOfAxisActrHdrestTilt: interface=SeatStorePosnSt1  # Seat Axis Memory Position | Memory position data from storage memory for the current profile of a certain seat axis.
    SeatAxisMemPosnOfAxisActrHei: interface=SeatStorePosnSt1  # Seat Axis Memory Position | Memory position data from storage memory for the current profile of a certain seat axis.
    SeatAxisMemPosnOfAxisActrHeiFrnt: interface=SeatStorePosnSt1  # Seat Axis Memory Position | Memory position data from storage memory for the current profile of a certain seat axis.
    SeatAxisMemPosnOfAxisActrHeiRe: interface=SeatStorePosnSt1  # Seat Axis Memory Position | Memory position data from storage memory for the current profile of a certain seat axis.
    SeatAxisMemPosnOfAxisActrIncl: interface=SeatStorePosnSt1  # Seat Axis Memory Position | Memory position data from storage memory for the current profile of a certain seat axis.
    SeatAxisMemPosnOfAxisActrLumExtn: interface=SeatStorePosnSt1  # Seat Axis Memory Position | Memory position data from storage memory for the current profile of a certain seat axis.
    SeatAxisMemPosnOfAxisActrLumHei: interface=SeatStorePosnSt1  # Seat Axis Memory Position | Memory position data from storage memory for the current profile of a certain seat axis.
    SeatAxisMemPosnOfAxisActrSld: interface=SeatStorePosnSt1  # Seat Axis Memory Position | Memory position data from storage memory for the current profile of a certain seat axis.
    SeatAxisMemPosnOfAxisActrTopIncl: interface=SeatStorePosnSt1  # Seat Axis Memory Position | Memory position data from storage memory for the current profile of a certain seat axis.
    SeatAxisMove: interface=SeatMove1  # Seat Axis Move Request | Request to move the specified axis of the seat to the indicated position.
    SeatAxisMoveOfAxisActrBackBlstrLe: interface=SeatMove1  # Seat Axis Move Request | Request to move the specified axis of the seat to the indicated position.
    SeatAxisMoveOfAxisActrBackBlstrRi: interface=SeatMove1  # Seat Axis Move Request | Request to move the specified axis of the seat to the indicated position.
    SeatAxisMoveOfAxisActrCushBlstrLe: interface=SeatMove1  # Seat Axis Move Request | Request to move the specified axis of the seat to the indicated position.
    SeatAxisMoveOfAxisActrCushBlstrRi: interface=SeatMove1  # Seat Axis Move Request | Request to move the specified axis of the seat to the indicated position.
    SeatAxisMoveOfAxisActrCushExtn: interface=SeatMove1  # Seat Axis Move Request | Request to move the specified axis of the seat to the indicated position.
    SeatAxisMoveOfAxisActrHdrestFold: interface=SeatMove1  # Seat Axis Move Request | Request to move the specified axis of the seat to the indicated position.
    SeatAxisMoveOfAxisActrHdrestHei: interface=SeatMove1  # Seat Axis Move Request | Request to move the specified axis of the seat to the indicated position.
    SeatAxisMoveOfAxisActrHdrestTilt: interface=SeatMove1  # Seat Axis Move Request | Request to move the specified axis of the seat to the indicated position.
    SeatAxisMoveOfAxisActrHei: interface=SeatMove1  # Seat Axis Move Request | Request to move the specified axis of the seat to the indicated position.
    SeatAxisMoveOfAxisActrHeiFrnt: interface=SeatMove1  # Seat Axis Move Request | Request to move the specified axis of the seat to the indicated position.
    SeatAxisMoveOfAxisActrHeiRe: interface=SeatMove1  # Seat Axis Move Request | Request to move the specified axis of the seat to the indicated position.
    SeatAxisMoveOfAxisActrIncl: interface=SeatMove1  # Seat Axis Move Request | Request to move the specified axis of the seat to the indicated position.
    SeatAxisMoveOfAxisActrLumExtn: interface=SeatMove1  # Seat Axis Move Request | Request to move the specified axis of the seat to the indicated position.
    SeatAxisMoveOfAxisActrLumHei: interface=SeatMove1  # Seat Axis Move Request | Request to move the specified axis of the seat to the indicated position.
    SeatAxisMoveOfAxisActrSld: interface=SeatMove1  # Seat Axis Move Request | Request to move the specified axis of the seat to the indicated position.
    SeatAxisMoveOfAxisActrTopIncl: interface=SeatMove1  # Seat Axis Move Request | Request to move the specified axis of the seat to the indicated position.
    SeatAxisPosn: interface=SeatAxisPosnSt1  # Seat Axis Position | This provides information about the current status of the seat axis actuator. There are three parts: current movement, speed and position.
    SeatAxisPosnOfAxisActrBackBlstrLe: interface=SeatAxisPosnSt1  # Seat Axis Position | This provides information about the current status of the seat axis actuator. There are three parts: current movement, speed and position.
    SeatAxisPosnOfAxisActrBackBlstrRi: interface=SeatAxisPosnSt1  # Seat Axis Position | This provides information about the current status of the seat axis actuator. There are three parts: current movement, speed and position.
    SeatAxisPosnOfAxisActrCushBlstrLe: interface=SeatAxisPosnSt1  # Seat Axis Position | This provides information about the current status of the seat axis actuator. There are three parts: current movement, speed and position.
    SeatAxisPosnOfAxisActrCushBlstrRi: interface=SeatAxisPosnSt1  # Seat Axis Position | This provides information about the current status of the seat axis actuator. There are three parts: current movement, speed and position.
    SeatAxisPosnOfAxisActrCushExtn: interface=SeatAxisPosnSt1  # Seat Axis Position | This provides information about the current status of the seat axis actuator. There are three parts: current movement, speed and position.
    SeatAxisPosnOfAxisActrHdrestFold: interface=SeatAxisPosnSt1  # Seat Axis Position | This provides information about the current status of the seat axis actuator. There are three parts: current movement, speed and position.
    SeatAxisPosnOfAxisActrHdrestHei: interface=SeatAxisPosnSt1  # Seat Axis Position | This provides information about the current status of the seat axis actuator. There are three parts: current movement, speed and position.
    SeatAxisPosnOfAxisActrHdrestTilt: interface=SeatAxisPosnSt1  # Seat Axis Position | This provides information about the current status of the seat axis actuator. There are three parts: current movement, speed and position.
    SeatAxisPosnOfAxisActrHei: interface=SeatAxisPosnSt1  # Seat Axis Position | This provides information about the current status of the seat axis actuator. There are three parts: current movement, speed and position.
    SeatAxisPosnOfAxisActrHeiFrnt: interface=SeatAxisPosnSt1  # Seat Axis Position | This provides information about the current status of the seat axis actuator. There are three parts: current movement, speed and position.
    SeatAxisPosnOfAxisActrHeiRe: interface=SeatAxisPosnSt1  # Seat Axis Position | This provides information about the current status of the seat axis actuator. There are three parts: current movement, speed and position.
    SeatAxisPosnOfAxisActrIncl: interface=SeatAxisPosnSt1  # Seat Axis Position | This provides information about the current status of the seat axis actuator. There are three parts: current movement, speed and position.
    SeatAxisPosnOfAxisActrLumExtn: interface=SeatAxisPosnSt1  # Seat Axis Position | This provides information about the current status of the seat axis actuator. There are three parts: current movement, speed and position.
    SeatAxisPosnOfAxisActrLumHei: interface=SeatAxisPosnSt1  # Seat Axis Position | This provides information about the current status of the seat axis actuator. There are three parts: current movement, speed and position.
    SeatAxisPosnOfAxisActrSld: interface=SeatAxisPosnSt1  # Seat Axis Position | This provides information about the current status of the seat axis actuator. There are three parts: current movement, speed and position.
    SeatAxisPosnOfAxisActrTopIncl: interface=SeatAxisPosnSt1  # Seat Axis Position | This provides information about the current status of the seat axis actuator. There are three parts: current movement, speed and position.
    SeatAxisStorePosn: interface=StorePosnCmd1  # Store Seat Axis Position | Request to store the position of a certain seat axis to the memory position 'profile'.
    SeatAxisStorePosnOfAxisActrBackBlstrLe: interface=StorePosnCmd1  # Store Seat Axis Position | Request to store the position of a certain seat axis to the memory position 'profile'.
    SeatAxisStorePosnOfAxisActrBackBlstrRi: interface=StorePosnCmd1  # Store Seat Axis Position | Request to store the position of a certain seat axis to the memory position 'profile'.
    SeatAxisStorePosnOfAxisActrCushBlstrLe: interface=StorePosnCmd1  # Store Seat Axis Position | Request to store the position of a certain seat axis to the memory position 'profile'.
    SeatAxisStorePosnOfAxisActrCushBlstrRi: interface=StorePosnCmd1  # Store Seat Axis Position | Request to store the position of a certain seat axis to the memory position 'profile'.
    SeatAxisStorePosnOfAxisActrCushExtn: interface=StorePosnCmd1  # Store Seat Axis Position | Request to store the position of a certain seat axis to the memory position 'profile'.
    SeatAxisStorePosnOfAxisActrHdrestFold: interface=StorePosnCmd1  # Store Seat Axis Position | Request to store the position of a certain seat axis to the memory position 'profile'.
    SeatAxisStorePosnOfAxisActrHdrestHei: interface=StorePosnCmd1  # Store Seat Axis Position | Request to store the position of a certain seat axis to the memory position 'profile'.
    SeatAxisStorePosnOfAxisActrHdrestTilt: interface=StorePosnCmd1  # Store Seat Axis Position | Request to store the position of a certain seat axis to the memory position 'profile'.
    SeatAxisStorePosnOfAxisActrHei: interface=StorePosnCmd1  # Store Seat Axis Position | Request to store the position of a certain seat axis to the memory position 'profile'.
    SeatAxisStorePosnOfAxisActrHeiFrnt: interface=StorePosnCmd1  # Store Seat Axis Position | Request to store the position of a certain seat axis to the memory position 'profile'.
    SeatAxisStorePosnOfAxisActrHeiRe: interface=StorePosnCmd1  # Store Seat Axis Position | Request to store the position of a certain seat axis to the memory position 'profile'.
    SeatAxisStorePosnOfAxisActrIncl: interface=StorePosnCmd1  # Store Seat Axis Position | Request to store the position of a certain seat axis to the memory position 'profile'.
    SeatAxisStorePosnOfAxisActrLumExtn: interface=StorePosnCmd1  # Store Seat Axis Position | Request to store the position of a certain seat axis to the memory position 'profile'.
    SeatAxisStorePosnOfAxisActrLumHei: interface=StorePosnCmd1  # Store Seat Axis Position | Request to store the position of a certain seat axis to the memory position 'profile'.
    SeatAxisStorePosnOfAxisActrSld: interface=StorePosnCmd1  # Store Seat Axis Position | Request to store the position of a certain seat axis to the memory position 'profile'.
    SeatAxisStorePosnOfAxisActrTopIncl: interface=StorePosnCmd1  # Store Seat Axis Position | Request to store the position of a certain seat axis to the memory position 'profile'.
    SeatBltRmnAcoustWarnReq: interface=SeatBltRmnAcoustWarnReq1  # Seat Belt Reminder Acoustic Warning Request | Request to Human Machine Interface (HMI) to sound the seat belt reminder unbuckled warning.
    SeatBltRmnFrqCtrlAcoustWarn: interface=SeatBltRmnFrqCtrlAcoustWarn1  # Seat Belt Reminder Frequenz Control Acoustic Warning | Control of warning frequency to sound in case unbuckled occupants detected
    SeatBltRmnLdnCtrlAcoustWarn: interface=SeatBltRmnLdnCtrlAcoustWarn1  # Seat Belt Reminder Loudness Control Acoustic Warning | Control of warning loudness to sound in case unbuckled occupants detected
    SeatBltRmnOpticWarnReq: interface=SeatBltRmnOpticWarnReq1  # Seat Belt Reminder Optical Warning Request | Request to HMI to display the seat belt reminder optical warning of unbuckled occupants. Optionally the seating position of the not buckled occupant(s) is to display. Therefore dedicated ports are available for seating positions giving the buckling state of the occupant.
    SeatBltRmnWarnSt: interface=SeatBltRmnWarnSt1  # Seat Belt Reminder Warning State | Detected warning state of seat belt reminder
    SeatClimaCmd: interface=SeatClimaCmd1  # Command To Actuator Of Seat Climatisation | Climatisation command To Actuator Of a Seat
    SeatFixa: interface=SeatFixaSt1  # Seat Fixation Status | Information on correct fixation of the seat
    SeatFixaSt: interface=SeatFixaSt1  # Seat Fixation Status | Information on correct fixation of the seat
    SeatFixaStOfDrvrSeat: interface=SeatFixaSt1  # Seat Fixation Status | Information on correct fixation of the seat
    SeatFixaStOfPassSeat: interface=SeatFixaSt1  # Seat Fixation Status | Information on correct fixation of the seat
    SeatFixaStOfSeatRowFirstMid: interface=SeatFixaSt1  # Seat Fixation Status | Information on correct fixation of the seat
    SeatFixaStOfSeatRowSecLe: interface=SeatFixaSt1  # Seat Fixation Status | Information on correct fixation of the seat
    SeatFixaStOfSeatRowSecMid: interface=SeatFixaSt1  # Seat Fixation Status | Information on correct fixation of the seat
    SeatFixaStOfSeatRowSecRi: interface=SeatFixaSt1  # Seat Fixation Status | Information on correct fixation of the seat
    SeatFixaStOfSeatRowThrdLe: interface=SeatFixaSt1  # Seat Fixation Status | Information on correct fixation of the seat
    SeatFixaStOfSeatRowThrdMid: interface=SeatFixaSt1  # Seat Fixation Status | Information on correct fixation of the seat
    SeatFixaStOfSeatRowThrdRi: interface=SeatFixaSt1  # Seat Fixation Status | Information on correct fixation of the seat
    SeatFixaSts: interface=SeatFixaSts1  # Seat Fixation Status | Information on correct fixation of the seat
    SeatFixaStsOfDrvrSeat: interface=SeatFixaSts1  # Seat Fixation Status | Information on correct fixation of the seat
    SeatFixaStsOfPassSeat: interface=SeatFixaSts1  # Seat Fixation Status | Information on correct fixation of the seat
    SeatFixaStsOfSeatRowFirstMid: interface=SeatFixaSts1  # Seat Fixation Status | Information on correct fixation of the seat
