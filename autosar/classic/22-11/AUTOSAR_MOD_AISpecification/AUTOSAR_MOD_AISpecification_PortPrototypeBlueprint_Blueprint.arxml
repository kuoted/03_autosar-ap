[part 4 of 4: package /AUTOSAR/AISpecification/PortPrototypeBlueprints_Blueprint]
AUTOSAR XML (schema 00051)
package /AUTOSAR/AISpecification/PortPrototypeBlueprints_Blueprint  (continued)
  2210 x port prototype blueprint:  (continued)
    SeatFixaStsOfSeatRowSecLe: interface=SeatFixaSts1  # Seat Fixation Status | Information on correct fixation of the seat
    SeatFixaStsOfSeatRowSecMid: interface=SeatFixaSts1  # Seat Fixation Status | Information on correct fixation of the seat
    SeatFixaStsOfSeatRowSecRi: interface=SeatFixaSts1  # Seat Fixation Status | Information on correct fixation of the seat
    SeatFixaStsOfSeatRowThrdLe: interface=SeatFixaSts1  # Seat Fixation Status | Information on correct fixation of the seat
    SeatFixaStsOfSeatRowThrdMid: interface=SeatFixaSts1  # Seat Fixation Status | Information on correct fixation of the seat
    SeatFixaStsOfSeatRowThrdRi: interface=SeatFixaSts1  # Seat Fixation Status | Information on correct fixation of the seat
    SeatMoveAut: interface=SeatMoveAutReq1  # Auto Adjust Move | Request to perform automatic seat movement to a certain position. This position could be determined by a user request from the seat panel, an access from the remote key, a keyless access, driver-easy-entry request or if reverse gear was detected, to move the head-rest to the "down position".
    SeatMoveSt: interface=SeatMoveSt1  # Seat Move Status | This port provides information about movement status of the seat to the requested position.
    SeatMoveSts: interface=SeatMoveSts1  # Seat Move Status | This port provides information about movement status of the seat to the requested position.
    SeatPosnStore: interface=SeatStorePosnReq1  # Seat Position Store | Request to store the position of the seat to the corresponding profile number.
    SeatT: interface=SeatTVal1  # Seat Temperature | Temperature level From Sensor Of a Seat
    SeatTCmd: interface=SeatTCmd1  # Seat Temperature to Adapter | Seat Temperature Command To Adapter
    SeatTCmdOfDrvrSeat: interface=SeatTCmd1  # Seat Temperature to Adapter | Seat Temperature Command To Adapter
    SeatTCmdOfPassSeat: interface=SeatTCmd1  # Seat Temperature to Adapter | Seat Temperature Command To Adapter
    SeatTCmdOfSeatReLe: interface=SeatTCmd1  # Seat Temperature to Adapter | Seat Temperature Command To Adapter
    SeatTCmdOfSeatReRi: interface=SeatTCmd1  # Seat Temperature to Adapter | Seat Temperature Command To Adapter
    SetSpd: interface=SetSpd1  # Set Speed | Set speed, set by the driver. This set speed is used to control the vehicle target speed in case of free driving or Cruise Control only.
    SetSpdDec: interface=SetSpdDec1  # Set Speed Decrease | Status of deceleration switch to decrease the Adaptive Cruise Control (ACC) / Cruise Control (CC) set speed. ACC decreases the target speed by specified steps defined in the ACC state machine. Cruise Control decelerates the vehicle as long as the driver pushes the button.
    SetSpdInc: interface=SetSpdInc1  # Set Speed Increase | Status of acceleration switch to increase the Adaptive Cruise Control (ACC) / Cruise Control (CC) set speed. ACC increases the target speed by specified steps defined in the ACC state machine. Cruise Control accelerates the vehicle as long as the driver pushes the button.
    SetSpdIndcn: interface=SetSpdIndcn1  # Set Speed Indication | Set speed of driver using Cruise Control (CC) or Adaptive Cruise Control (ACC) as displayed for driver.
    SideMkr: interface=LiExtCmd1  # Side Marker | This port provides command to turn on/off side markers
    SideMkrOut: interface=LiExtCmd1  # Side Marker Output | This port provides command to turn on/off side markers
    SnsrAlrmSimpleSt: interface=SnsrAlrmSimpleSt1  # Status Of Sensor Adapter Simple Alarm | State of the adapter simple alarm antitheft sensor
    SnsrAlrmSimpleStOfBackWin: interface=SnsrAlrmSimpleSt1  # Status of [Sensor Adapter Simple Alarm] | State of the simple alarm antitheft sensors remapped towards different alarm adapters.
    SnsrAlrmSimpleStOfDoorFrntLe: interface=SnsrAlrmSimpleSt1  # Status of [Sensor Adapter Simple Alarm] | State of the simple alarm antitheft sensors remapped towards different alarm adapters.
    SnsrAlrmSimpleStOfDoorFrntRi: interface=SnsrAlrmSimpleSt1  # Status of [Sensor Adapter Simple Alarm] | State of the simple alarm antitheft sensors remapped towards different alarm adapters.
    SnsrAlrmSimpleStOfDoorReLe: interface=SnsrAlrmSimpleSt1  # Status of [Sensor Adapter Simple Alarm] | State of the simple alarm antitheft sensors remapped towards different alarm adapters.
    SnsrAlrmSimpleStOfDoorReRi: interface=SnsrAlrmSimpleSt1  # Status of [Sensor Adapter Simple Alarm] | State of the simple alarm antitheft sensors remapped towards different alarm adapters.
    SnsrAlrmSimpleStOfHood: interface=SnsrAlrmSimpleSt1  # Status of [Sensor Adapter Simple Alarm] | State of the simple alarm antitheft sensors remapped towards different alarm adapters.
    SnsrAlrmSimpleStOfRadio: interface=SnsrAlrmSimpleSt1  # Status of [Sensor Adapter Simple Alarm] | State of the simple alarm antitheft sensors remapped towards different alarm adapters.
    SnsrAlrmSimpleStOfSnsrGlassBreak: interface=SnsrAlrmSimpleSt1  # Status of [Sensor Adapter Simple Alarm] | State of the simple alarm antitheft sensors remapped towards different alarm adapters.
    SnsrAlrmSimpleStOfTankFlap: interface=SnsrAlrmSimpleSt1  # Status of [Sensor Adapter Simple Alarm] | State of the simple alarm antitheft sensors remapped towards different alarm adapters.
    SnsrAlrmSimpleStOfTr: interface=SnsrAlrmSimpleSt1  # Status of [Sensor Adapter Simple Alarm] | State of the simple alarm antitheft sensors remapped towards different alarm adapters.
    SnsrAlrmSimpleStOfTrlr: interface=SnsrAlrmSimpleSt1  # Status of [Sensor Adapter Simple Alarm] | State of the simple alarm antitheft sensors remapped towards different alarm adapters.
    SnsrAlrmSimpleSts: interface=SnsrAlrmSimpleSts1  # Status Of Sensor Adapter Simple Alarm | State of the adapter simple alarm antitheft sensor
    SnsrAlrmSimpleStsOfBackWin: interface=SnsrAlrmSimpleSts1  # Status of [Sensor Adapter Simple Alarm] | State of the simple alarm antitheft sensors remapped towards different alarm adapters.
    SnsrAlrmSimpleStsOfDoorFrntLe: interface=SnsrAlrmSimpleSts1  # Status of [Sensor Adapter Simple Alarm] | State of the simple alarm antitheft sensors remapped towards different alarm adapters.
    SnsrAlrmSimpleStsOfDoorFrntRi: interface=SnsrAlrmSimpleSts1  # Status of [Sensor Adapter Simple Alarm] | State of the simple alarm antitheft sensors remapped towards different alarm adapters.
    SnsrAlrmSimpleStsOfDoorReLe: interface=SnsrAlrmSimpleSts1  # Status of [Sensor Adapter Simple Alarm] | State of the simple alarm antitheft sensors remapped towards different alarm adapters.
    SnsrAlrmSimpleStsOfDoorReRi: interface=SnsrAlrmSimpleSts1  # Status of [Sensor Adapter Simple Alarm] | State of the simple alarm antitheft sensors remapped towards different alarm adapters.
    SnsrAlrmSimpleStsOfHood: interface=SnsrAlrmSimpleSts1  # Status of [Sensor Adapter Simple Alarm] | State of the simple alarm antitheft sensors remapped towards different alarm adapters.
    SnsrAlrmSimpleStsOfRadio: interface=SnsrAlrmSimpleSts1  # Status of [Sensor Adapter Simple Alarm] | State of the simple alarm antitheft sensors remapped towards different alarm adapters.
    SnsrAlrmSimpleStsOfSnsrGlassBreak: interface=SnsrAlrmSimpleSts1  # Status of [Sensor Adapter Simple Alarm] | State of the simple alarm antitheft sensors remapped towards different alarm adapters.
    SnsrAlrmSimpleStsOfTankFlap: interface=SnsrAlrmSimpleSts1  # Status of [Sensor Adapter Simple Alarm] | State of the simple alarm antitheft sensors remapped towards different alarm adapters.
    SnsrAlrmSimpleStsOfTr: interface=SnsrAlrmSimpleSts1  # Status of [Sensor Adapter Simple Alarm] | State of the simple alarm antitheft sensors remapped towards different alarm adapters.
    SnsrAlrmSimpleStsOfTrlr: interface=SnsrAlrmSimpleSts1  # Status of [Sensor Adapter Simple Alarm] | State of the simple alarm antitheft sensors remapped towards different alarm adapters.
    SnsrAntithftPasSt: interface=SnsrAlrmSt1  # Passive Anti Theft Sensor State | State of the passive antitheft sensor
    SnsrCtrl: interface=CmdForSnsr1  # Sensor Control For Sensor Adapter Alarm | Command to control the adapter alarm antitheft sensor (arm, disarm, exclude,...)
    SnsrCtrlForBackWin: interface=CmdForSnsr1  # Sensor Control for [Sensor Adapter Simple Alarm] | Command to control the adapter simple alarm antitheft sensor (arm, disarm, exclude,...)
    SnsrCtrlForDoorFrntLe: interface=CmdForSnsr1  # Sensor Control for [Sensor Adapter Simple Alarm] | Command to control the adapter simple alarm antitheft sensor (arm, disarm, exclude,...)
    SnsrCtrlForDoorFrntRi: interface=CmdForSnsr1  # Sensor Control for [Sensor Adapter Simple Alarm] | Command to control the adapter simple alarm antitheft sensor (arm, disarm, exclude,...)
    SnsrCtrlForDoorReLe: interface=CmdForSnsr1  # Sensor Control for [Sensor Adapter Simple Alarm] | Command to control the adapter simple alarm antitheft sensor (arm, disarm, exclude,...)
    SnsrCtrlForDoorReRi: interface=CmdForSnsr1  # Sensor Control for [Sensor Adapter Simple Alarm] | Command to control the adapter simple alarm antitheft sensor (arm, disarm, exclude,...)
    SnsrCtrlForHood: interface=CmdForSnsr1  # Sensor Control for [Sensor Adapter Simple Alarm] | Command to control the adapter simple alarm antitheft sensor (arm, disarm, exclude,...)
    SnsrCtrlForRadio: interface=CmdForSnsr1  # Sensor Control for [Sensor Adapter Simple Alarm] | Command to control the adapter simple alarm antitheft sensor (arm, disarm, exclude,...)
    SnsrCtrlForScanrIntr: interface=CmdForSnsr1  # Sensor Control for Interior Scanner | Command to control the adapter complex alarm antitheft sensor (arm, disarm, exclude,...)
    SnsrCtrlForSnsrGlassBreak: interface=CmdForSnsr1  # Sensor Control for [Sensor Adapter Simple Alarm] | Command to control the adapter simple alarm antitheft sensor (arm, disarm, exclude,...)
    SnsrCtrlForSnsrIncln: interface=CmdForSnsr1  # Sensor Control for Inclination Sensor | Command to control the adapter complex alarm antitheft sensor (arm, disarm, exclude,...)
    SnsrCtrlForSoundrBattBacked: interface=CmdForSnsr1  # Sensor Control for Battery Backed Sounder | Command to control the adapter complex alarm antitheft sensor (arm, disarm, exclude,...)
    SnsrCtrlForTankFlap: interface=CmdForSnsr1  # Sensor Control for [Sensor Adapter Simple Alarm] | Command to control the adapter simple alarm antitheft sensor (arm, disarm, exclude,...)
    SnsrCtrlForTr: interface=CmdForSnsr1  # Sensor Control for [Sensor Adapter Simple Alarm] | Command to control the adapter simple alarm antitheft sensor (arm, disarm, exclude,...)
    SnsrCtrlForTrlr: interface=CmdForSnsr1  # Sensor Control for [Sensor Adapter Simple Alarm] | Command to control the adapter simple alarm antitheft sensor (arm, disarm, exclude,...)
    SnsrCtrlOfAntithftPas: interface=CmdForSnsr1  # Passive Anti Theft Sensor Control | Command to control the passive antitheft sensor (arm, disarm, exclude,...)
    SnsrGlassBreakOut: interface=SnsrGlassBreakSt1  # Glass Break Sensor Sensor Out | State of the glass break antitheft sensor
    SnsrInclnIn: interface=SnsrInclnCmd1  # Inclination Sensor In | Command to control the inclination sensor (configuration, arm, disarm,...)
    SnsrInclnInhb: interface=SnsrInclInhbReq1  # Inhibit Inclination Sensor | Inhibition request by user via Hmi for the inclination sensor
    SnsrInclnInhb1: interface=SnsrInclnInhbReq1  # Inhibit Inclination Sensor | Inhibition request by user via Hmi for the inclination sensor
    SnsrInclnOut: interface=SnsrInclnSt1  # Inclination Sensor Out | State of the inclination antitheft sensor
    SnsrIntrScanrIn: interface=SnsrIntrScanrCmd1  # Interior Scanner Sensor In | Command to control the interior scanner sensor (configuration, arm, disarm,...)
    SnsrIntrScanrInhb: interface=SnsrIntrScanrInhbReq1  # Inhibit Interior Scanner Sensor | Inhibition request by user for the interior scanner sensor
    SnsrIntrScanrOut: interface=SnsrIntrScanrSt1  # Interior Scannner Sensor Out | State of the interior scanner antitheft sensor
    SnsrSoundrBattBackedIn: interface=SnsrSoundrBattBackedCmd1  # Battery Backed Sounder Sensor In | Command to control the battery backed sounder sensor (configuration, arm, disarm, charging...)
    SnsrSoundrBattBackedOut: interface=SnsrSoundrBattBackedSt1  # Battery Backed Sounder Sensor Out | State of the battery backed sounder sensor antitheft sensor
    SnsrSt: interface=SnsrAlrmSt1  # Sensor State Of Sensor Adapter Alarm | State of the adapter alarm antitheft sensor
    SnsrStOfBackWin: interface=SnsrAlrmSt1  # Sensor State of [Sensor Adapter Simple Alarm] | State of the adapter simple alarm antitheft sensor
    SnsrStOfDoorFrntLe: interface=SnsrAlrmSt1  # Sensor State of [Sensor Adapter Simple Alarm] | State of the adapter simple alarm antitheft sensor
    SnsrStOfDoorFrntRi: interface=SnsrAlrmSt1  # Sensor State of [Sensor Adapter Simple Alarm] | State of the adapter simple alarm antitheft sensor
    SnsrStOfDoorReLe: interface=SnsrAlrmSt1  # Sensor State of [Sensor Adapter Simple Alarm] | State of the adapter simple alarm antitheft sensor
    SnsrStOfDoorReRi: interface=SnsrAlrmSt1  # Sensor State of [Sensor Adapter Simple Alarm] | State of the adapter simple alarm antitheft sensor
    SnsrStOfHood: interface=SnsrAlrmSt1  # Sensor State of [Sensor Adapter Simple Alarm] | State of the adapter simple alarm antitheft sensor
    SnsrStOfRadio: interface=SnsrAlrmSt1  # Sensor State of [Sensor Adapter Simple Alarm] | State of the adapter simple alarm antitheft sensor
    SnsrStOfScanrIntr: interface=SnsrAlrmSt1  # Sensor State of Interior Scanner | State of the adapter complex alarm antitheft sensor
    SnsrStOfSnsrGlassBreak: interface=SnsrAlrmSt1  # Sensor State of [Sensor Adapter Simple Alarm] | State of the adapter simple alarm antitheft sensor
    SnsrStOfSnsrIncln: interface=SnsrAlrmSt1  # Sensor State of Inclination Sensor | State of the adapter complex alarm antitheft sensor
    SnsrStOfSoundrBattBacked: interface=SnsrAlrmSt1  # Sensor State of Battery Backed Sounder | State of the adapter complex alarm antitheft sensor
    SnsrStOfTankFlap: interface=SnsrAlrmSt1  # Sensor State of [Sensor Adapter Simple Alarm] | State of the adapter simple alarm antitheft sensor
    SnsrStOfTr: interface=SnsrAlrmSt1  # Sensor State of [Sensor Adapter Simple Alarm] | State of the adapter simple alarm antitheft sensor
    SnsrStOfTrlr: interface=SnsrAlrmSt1  # Sensor State of [Sensor Adapter Simple Alarm] | State of the adapter simple alarm antitheft sensor
    SpdLatEstimdByEsc: interface=SpdLat1  # Speed Lateral Estimated by ESC | Estimated lateral vehicle speed component at Center Of Gravity (COG) (depending on available sensors).
    SprgCoeffEstimd: interface=SprgCoeffEstimd1  # Spring Coefficient Estimated | Estimation of the actual spring coefficient provided by the spring system
    SprgCoeffEstimd1: interface=SprgCoeff1  # Spring Coefficient Estimated | Estimation of the actual spring coefficient provided by the spring system
    SprgCtrlTunActvReq: interface=SprgCtrlTunActvReq1  # Spring Control Tuning Active Request | Spring control tuning mode request by the driver.
    SprgCtrlTunMod: interface=SprgCtrlTunMod1  # Spring Control Tuning Mode | Spring tuning mode for display to the driver and provided to other systems
    SprgFEstimd: interface=SprgFEstimd1  # Spring Force Estimated | Estimation of the actual spring forces provided by the spring system.
    SprgFEstimd1: interface=SprgF1  # Spring Force Estimated | Estimation of the actual spring forces provided by the spring system.
    SprgTrvl: interface=SprgTrvl1  # Spring Travel | Spring travel continuous values at individual wheels (one for each corner).
    SsmFlgGearParkReq: interface=GearParkReq1  # Standstill Manager: Request to Engage the Parking Lock | Parking lock request from Stand Still Manager to automatic transmission to set parking position.
    SsmReqTypToEpb: interface=BrkReqTyp1  # Stand Still Management Request Type to EPB | Type of vehicle deceleration force requested by Stand Still Manager to Electric Parking Brake.
    SsmReqTypToEsc: interface=BrkReqTyp2  # Stand Still Management Request Type to ESC | Type of vehicle deceleration force requested by Stand Still Manager (SSM) to Electronic Stability Control (ESC).
    SsmStToEpb: interface=SsmSt1  # Stand Still Management Status to EPB | Failure status of the Stand Still Manager (SSM) regarding electric parking brake.
    SsmStToEsc: interface=SsmSt1  # Stand Still Management Status to ESC | Failure status of the Stand Still Manager (SSM) regarding hydraulic brake.
    SsmStsToEpb: interface=SsmSts1  # Stand Still Management Status to EPB | Failure status of the Stand Still Manager (SSM) regarding electric parking brake.
    SsmStsToEsc: interface=SsmSts1  # Stand Still Management Status to ESC | Failure status of the Stand Still Manager (SSM) regarding hydraulic brake.
    St: interface=LvlDefrstSt1  # Defrost Status | Port for Defrost Status
    StOfActrDefrstFrnt: interface=LvlDefrstSt1  # Defrost Status | Port for Defrost Status
    StOfActrDefrstRe: interface=LvlDefrstSt1  # Defrost Status | Port for Defrost Status
    StOfActrMirrDefrst: interface=LvlDefrstSt1  # Defrost Status | Port for Defrost Status
    StabrCtrlMod: interface=StabrCtrlMod1  # Stabilizer Control Mode | Stabilizer mode for display to driver and provided to other systems
    StabrCtrlTunReq: interface=StabrCtrlTunReq1  # Stabilizer Control Tuning Request | Stabilizer control tuning mode request by the driver.
    StabrRate: interface=StabrRate1  # Stabilizer Rate | Current stabilizer rate of active stabilizers.
    StabrRateReq: interface=StabrRate1  # Stabilizer Rate Request | Requested stabilizer rate to be set by active stabilizer system.
    StabrSt: interface=StabrSt1  # Stabilizer Status | Status of the active or switchable stabilizer on front and rear axle.
    StabrSts: interface=StabrSts1  # Stabilizer Status | Status of the active or switchable stabilizer on front and rear axle.
    StandStillCmftReqByAcc: interface=StandStillCmftReqByAcc1  # Stand Still Comfort Request by ACC | To keep standstill requested by Adaptive Cruise Control (ACC) to Vehicle Longitudinal Control (VLC).
    SteerAgGrdtMaxAllwd: interface=SteerAgGrdtSuppsnMaxAllwd1  # Steering Angle Gradient Maximum Allowed | Maximum allowed superposition steering angle gradient normalized to road wheel angle (actuator potential).
    SteerAgSum: interface=SteerWhlAg1  # Steering Angle Sum | Sum of driver steering angle and superposition angle on steering wheel level.
    SteerAgSuppsn: interface=SteerWhlAg1  # Steering Angle Superposition | Total superposition steering angle on road wheel level.
    SteerAgSuppsnBascSt: interface=SteerSt1  # Steering Angle Superposition Basic Status | Status of Basic Steering Angle Superposition.
    SteerAgSuppsnBascSts: interface=SteerSts1  # Steering Angle Superposition Basic Status | Status of Basic Steering Angle Superposition.
    SteerAgSuppsnEstimdOfCmftFct: interface=SteerWhlAg1  # Steering Angle Superposition Estimated of Comfort Function | Estimated superposition steering angle from comfort functions (e.g. variable gear ratio, pre-control, etc.) on road wheel level.
    SteerCtrlTunReq: interface=SteerCtrlTunReq1  # Steering Control Tuning Request | Steering controller tuning request by the driver.
    SteerDrvrAsscSysModReq: interface=SteerDrvrAsscSysModReq1  # Steering Driver Assistance System Mode Request | Indication to Steering Driver Assistance System, which among several functional or tuning modes has to be activated.
    SteerDrvrAsscSysStIndcn: interface=SteerDrvrAsscSysStIndcn1  # Steering Driver Assistance System Status Indication | Indication from Steering Driver Assistance System of which functional (or non-functional) status it has.
    SteerDrvrAsscSysStsIndcn: interface=SteerDrvrAsscSysStsIndcn1  # Steering Driver Assistance System Status Indication | Indication from Steering Driver Assistance System of which functional (or non-functional) status it has.
    SteerLoadHyd: interface=SteerLoadHyd1  # Steering Load Hydraulic | Hydraulic power steering load at engine crankshaft. This value must take into account all relevant dynamic effects. If electric power steering, this value should be zero, because the load is included in alternator load. It is converted to engine crankshaft torque by the provider. | Default value after reset is zero.
    SteerLoadHydReq: interface=SteerLoadHyd1  # Steering Load Hydraulic Request | Requested hydraulic power steering load at engine crankshaft. This value represents the torque consumption in a predicted future state. If electric power steering, this value should be zero, because the load is included in alternator load. It is converted to engine crankshaft torque by the provider. | Default value after reset is zero.
    SteerMotAgFrntBas: interface=SteerMotAgFrnt1  # Steering Motor Angle Front Base | Measured angle of the front steering device at the steer motor (for steering angle superposition systems).
    SteerMotAgFrntMeasd: interface=SteerMotAgFrnt1  # Steering Motor Angle Front Measured | Conditioned angle of the front steering device at the steer motor (for steering angle superposition systems) (Filtered and Offset corrected)
    SteerMotAgFrntRaw: interface=SteerMotAgFrnt1  # Steering Motor Angle Front Raw | Measured angle of the front steering device at the steer motor (for steering angle superposition systems).
    SteerMotAgFrntStd: interface=SteerMotAgFrnt1  # Steering Motor Angle Front Standard | Conditioned angle of the front steering device at the steer motor (for steering angle superposition systems) (Filtered and Offset corrected)
    SteerMotAgSpdFrntMeasd: interface=SteerMotAgSpdFrnt1  # Steering Motor Angle Speed Front Measured | Conditioned derivative of the angular position measured at the front steering device with respect to the motor shaft.
    SteerMotAgSpdFrntStd: interface=SteerMotAgSpdFrnt1  # Steering Motor Angle Speed Front Standard | Conditioned derivative of the angular position measured at the front steering device with respect to the motor shaft.
    SteerTq: interface=SteerLoadHyd1  # Actual Hydraulic Power Steering Load at Engine Crank Shaft | Hydraulic power steering load at engine crankshaft. This value must take into account all relevant dynamic effects. If electric power steering, this value should be zero, because the load is included in alternator load. It is converted to engine crankshaft torque by the provider. | Default value after reset is zero.
    SteerTqReq: interface=SteerLoadHyd1  # Requested Hydraulic Power Steering Load at Engine Crank Shaft | Requested hydraulic power steering load at engine crankshaft. This value represents the torque consumption in a predicted future state. If electric power steering, this value should be zero, because the load is included in alternator load. It is converted to engine crankshaft torque by the provider. | Default value after reset is zero.
    SteerTqSum: interface=SteerTqSum1  # Steering Torque Sum | Sum of driver steering torque and superposition delta torque at steering wheel level.
    SteerTqSuppsnBascSt: interface=SteerSt1  # Steering Torque Superposition Basic Status | Status of Basic Steering Torque Superposition.
    SteerTqSuppsnBascSts: interface=SteerSts1  # Steering Torque Superposition Basic Status | Status of Basic Steering Torque Superposition.
    SteerTqSuppsnFrntSt: interface=SteerTqSuppsnFrntSt1  # Steering Torque Superposition Front Status | Status of the Basic Steering Torque Superposition that indicates whether it is able to apply the requested delta torque or not.
    SteerTqSuppsnFrntSts: interface=SteerTqSuppsnFrntSts1  # Steering Torque Superposition Front Status | Status of the Basic Steering Torque Superposition that indicates whether it is able to apply the requested delta torque or not.
    SteerVehStabyCtrlMod: interface=SteerVehStabyCtrlMod1  # Steering Vehicle Stability Control Mode | Steering vehicle stability system mode currently in operation.
    SteerVehStabyCtrlModReq: interface=SteerVehStabyCtrlModReq1  # Steering Vehicle Stability Control Mode Request | Vehicle stability system tuning mode request by the driver.
    SteerWhlAgBas: interface=SteerWhlAg1  # Steering Wheel Angle Base | Measured steering angle at steering positioned between the steering wheel and the Basic Steering Angle Superposition (BSAS) system if it is there. Driving intention of driver. (Does not include steering kinematic effects).
    SteerWhlAgMeasd: interface=SteerWhlAg1  # Steering Wheel Angle Measured | Conditioned steer angle at steering positioned between the steering wheel and the Basic Steering Angle Superposition (BSAS) system if it is there. Driving intention of driver. (Does not include steering kinematic effects, offset-compensated, filtered). Derived from measured steering wheel angular position)
    SteerWhlAgRaw: interface=SteerWhlAg1  # Steering Wheel Angle Raw | Measured steering angle at steering positioned between the steering wheel and the Basic Steering Angle Superposition (BSAS) system if it is there. Driving intention of driver. (Does not include steering kinematic effects).
    SteerWhlAgSpdMeasd: interface=SteerWhlAgSpd1  # Steering Wheel Angle Speed Measured | Conditioned (offset-compensated, filtered) steering wheel angle speed. | E.g. measured by a sensor located between the steering wheel and the Steering Angle Superposition system (if available). Does not include steering kinematic effects. Derived from measured steering wheel angular position.
    SteerWhlAgSpdStd: interface=SteerWhlAgSpd1  # Steering Wheel Angle Speed Standard | Conditioned (offset-compensated, filtered) steering wheel angle speed. | E.g. measured by a sensor located between the steering wheel and the Steering Angle Superposition system (if available). Does not include steering kinematic effects. Derived from measured steering wheel angular position.
    SteerWhlAgStd: interface=SteerWhlAg1  # Steering Wheel Angle Standard | Conditioned steer angle at steering positioned between the steering wheel and the Basic Steering Angle Superposition (BSAS) system if it is there. Driving intention of driver. (Does not include steering kinematic effects, offset-compensated, filtered). Derived from measured steering wheel angular position)
    SteerYawStabyCtrlIntvg: interface=YawStabyCtrlIntvg1  # Steering Yaw Stability Control Intervening | Current intervention of yaw stability control by steering.
    StgDispReLeForSeatClima: interface=StgDisp1  # Rear Left Stage Display for Seat Climatisation to HMI | Feedback to Hmi of Rear Left Passenger Stage requested
    StgDispReRiForSeatClima: interface=StgDisp1  # Rear Right Stage Display for Seat Climatisation to HMI | Feedback to Hmi of Rear Right Passenger Stage requested
    StgReLeForSeatClima: interface=StgReq1  # Rear Left Stage Request for Seat Climatisation | Rear Left Passenger Stage Request (no climatisation, heating level, cooling level)
    StgReRiForSeatClima: interface=StgReq1  # Rear Right Stage Request for Seat Climatisation | Rear Right Passenger Stage Request (no climatisation, heating level, cooling level)
    Sts: interface=LvlDefrstSts1  # Defrost Status | Port for Defrost Status
    StsOfActrDefrstFrnt: interface=LvlDefrstSts1  # Defrost Status | Port for Defrost Status
    StsOfActrDefrstRe: interface=LvlDefrstSts1  # Defrost Status | Port for Defrost Status
    StsOfActrMirrDefrst: interface=LvlDefrstSts1  # Defrost Status | Port for Defrost Status
    SuspCtrlTunReq: interface=SuspCtrlTunReq1  # Suspension Control Tuning Request | Request to Suspension to switch between several functional or tuning modes.
    SuspHei: interface=CarHeiSt1  # Car Height | Port that receives information about the suspension height (that is related to vehicle actual total load or tyres pressure status)
    SuspMod: interface=SuspMod1  # Suspension Mode | Suspension mode for display to the driver.
    SuspYawStabyCtrlIntvg: interface=YawStabyCtrlIntvg1  # Suspension Yaw Stability Control Intervening | Active intervention from yaw stability control performed by the suspension
    SwilSprgSt: interface=SwilSprgSt1  # Switchable Spring Status | Status provided by switchable spring.
    SwilSprgSts: interface=SwilSprgSts1  # Switchable Spring Status | Status provided by switchable spring.
    SwtBeamHi: interface=LiExtReq1  # High Beam Switch | Demand to activate/ deactivate high beam.
    SwtBeamLo: interface=LiExtReq1  # Low Beam Switch | Demand to activate/ deactivate low beam.
    SwtFlashBeam: interface=LiExtReq1  # Flash Beam Switch | Request to switch on the flash beam
    SwtFogLiFrnt: interface=LiExtReq1  # Front Fog Light Switch | Requests to switch on front fog lights
    SwtFogLiRe: interface=LiExtReq1  # Rear Fog Light Switch | Requests to switch on rear fog lights
    SwtForHzrdWarn: interface=LiExtReq1  # Hazard Warning Switch | Demand to activate/ deactivate hazard warning blinking
    SwtHomeCmngAndHomeLvng: interface=LiExtReq1  # Coming Home Leaving Home Switch | Demand to activate/ deactivate coming home/ leaving home functionalities
    SwtIndcr: interface=IndcrTurnReq1  # Turn Signal Lever Switch | Driver's turn indication, it is traditionally based on a movement of the left lever. It is a demand to activate / deactivate left or right indicator blinking or temporary blinking left / right. As long as direction indication is requested, the corresponding value should be set.
    SwtLiAut: interface=LiExtReq1  # Automatic Light Switch | Request the activation of the automatic light mode
    SwtLiDaytiRunng: interface=LiExtReq1  # Daytime Running Light Switch | Demand to activate/ deactivate daytime running light (DRL).
    SwtLiPosn: interface=LiExtReq1  # Position Light Switch | Requests to switch on the position lights. (Parking light left and parking light right at the same time)
    SwtStrt: interface=SwtStrtSt1  # Start Switch | Information related to the start switch. It indicates whether the switch is pushed or not.
    SwtTrSecu: interface=SnsrRoofCnvtbSt1  # Trunk Security Switch Status | Status of convertible sensor for trunk security
    TAtBmp: interface=BmpT1  # Temperature at Bumper | Temperature measured at bumper
    TankFlapHmi: interface=LtchRelsReq1  # Tank Flap HMI | User request to release/unlock the Tank Flap of the vehicle.
    TankFlapLockgCmd: interface=LockCmd1  # Tank Flap Locking Command | Command to lock the tank flap
    TankFlapLockgSt: interface=LockSt1  # Tank Flap Locking State | Locking state of the tank flap
    TankFlapLtchRels: interface=DiagcLtchRels1  # Tank Flap Latch Release | Diagnostic request to the sensor component to release/unlock the latch of tank flap
    TankFlapLtchRelsTog: interface=DiagcTog1  # Tank Flap Latch Release Toggle | Diagnostic request to the sensor component to request a "Toggle-Function" of the latch of the tank flap
    TankFlapSt: interface=DoorSt1  # Tank Flap Status | Information on the state of the tank flap
    TankFlapSts: interface=DoorSts1  # Tank Flap Status | Information on the state of the tank flap
    TelltlDefrstActvn: interface=TelltlDefrstCmd1  # Defrost Telltale Activation | Port for Defrost Telltale Activation
    TelltlDefrstReqFrnt: interface=DefrstReq1  # Front Defrost Telltale Request | Port for Front Defrost Telltale Request From Hvac
    TelltlDefrstReqRe: interface=DefrstReq1  # Rear Defrost Telltale Request | Port for Rear Defrost Telltale Request From Hvac
    TelltlDefrstSt: interface=DefrstSt1  # Defrost Telltale Status | Port for Defrost Telltale Status
    TelltlDefrstSts: interface=DefrstSts1  # Defrost Telltale Status | Port for Defrost Telltale Status
    TerminalClmpMod: interface=TerminalClmpModReq1  # Terminal Clamp Mode | Requested modes to power management and powertrain system, based on driver's operation
    TerminalPosnSt: interface=TerminalPosnSt1  # Terminal Position State | Information on the position of mechanical key switch
    TintgAutReq: interface=TintgAutReq1  # Auto Tinting Request | User request to set the mirrors tinting automatically
    TintgAutSt: interface=TintgAutSt1  # Auto Tinting Status | Status of the automatic tinting.
    TintgAutSts: interface=TintgAutSts1  # Auto Tinting Status | Status of the automatic tinting.
    TintgSt: interface=MirrTintgSt1  # Tinting Status | Status related to the tinting of the mirror
    TintgSts: interface=MirrTintgSts1  # Tinting Status | Status related to the tinting of the mirror
    TintgVal: interface=TintgValReq1  # Tinting Value | Request on the level of tinting needed. It is indicated by a value
    TirePEstimdPerWhl: interface=TirePEstimdPerWhl1  # Tire Pressure Estimated per Wheel | Set of estimated wheel individual absolute tire inflation pressure values. | For indirect measuring systems
    TirePEstimdPerWhl1: interface=TirePPerWhl1  # Tire Pressure Estimated per Wheel | Set of estimated wheel individual absolute tire inflation pressure values. | For indirect measuring systems
    TirePMeasdPerWhl: interface=TirePMeasdPerWhl1  # Tire Pressure Measured per Wheel | Set of current measured tire pressures. | For direct measuring systems
    TirePMonAcptOfWhlNewReq: interface=TirePMonAcptOfWhlNewReq1  # Tire Pressure Monitoring Accept of Wheel New Request | Request that one or more new wheels have to be accepted and monitored by Tire Pressure Monitoring. | For direct measuring systems.
    TirePMonCalStIndcnPerWhl: interface=TirePMonCalStIndcnPerWhl1  # Tire Pressure Monitoring Calibration Status Indication per Wheel | Calibration status indication of the Tire Pressure Monitoring to Human Machine Interface (HMI). Wheel individual. | For direct and indirect measuring systems
    TirePMonCalStsIndcnPerWhl: interface=TirePMonCalStsIndcnPerWhl1  # Tire Pressure Monitoring Calibration Status Indication per Wheel | Calibration status indication of the Tire Pressure Monitoring to Human Machine Interface (HMI). Wheel individual. | For direct and indirect measuring systems
    TirePMonIndcnOfWhlNewRcnd: interface=TirePMonIndcnOfWhlNewRcnd1  # Tire Pressure Monitoring New Wheel Recognized Indication | Indication, that one or more new wheels with new sensor ID have been recognized. | For direct measuring systems
    TirePMonRstAckd: interface=TirePMonRstAckd1  # Tire Pressure Monitoring Reset Acknowledged | Acknowledge of the Tire Pressure Monitoring that a tire pressure monitoring reset request has been received. | For direct and indirect measuring systems
    TirePMonRstReq: interface=TirePMonRstReq1  # Tire Pressure Monitoring Reset Request | Request of a reset of the tire pressure monitoring by the driver or diagnostic tool. | For direct and indirect measuring systems.
    TirePMonSt: interface=TirePMonSt1  # Tire Pressure Monitoring Status | Status of the tire pressure monitoring system. | For direct and indirect measuring systems
    TirePMonSts: interface=TirePMonSts1  # Tire Pressure Monitoring Status | Status of the tire pressure monitoring system. | For direct and indirect measuring systems
    TirePMonWarnIndcn: interface=TirePMonWarnIndcn1  # Tire Pressure Monitoring Warning Indication | Indication that at least at one tire a significant loss of tire pressure has been recognized. | For direct and indirect measuring systems
    TirePMonWarnIndcnPerWhl: interface=TirePMonWarnIndcnPerWhl1  # Tire Pressure Monitoring Warning Indication per Wheel | Indication which type of loss of tire pressure has been recognized at wheel. | For direct and indirect measuring systems. For indirect measuring Tire Pressure Monitoring probably not all states can be used.
    TirePThdPerAxle: interface=TirePThdPerAxle1  # Tire Pressure Threshold per Axle | Set of target tire pressure to be monitored at the axles. | For direct measuring systems.
    TirePThdPerAxleIndcn: interface=TirePThdPerAxle1  # Tire Pressure Threshold per Axle Indication | Set of tire pressure threshold per axle provided by Tire Pressure Monitoring. | For direct measuring systems
    TireTEstimdPerWhl: interface=TireTEstimdPerWhl1  # Tire Temperature Estimated per Wheel | Set of estimated wheel individual air temperature inside tire from Tire Pressure Monitoring.
    TireTEstimdPerWhl1: interface=TireTPerWhl1  # Tire Temperature Estimated per Wheel | Set of estimated wheel individual air temperature inside tire from Tire Pressure Monitoring.
    TireTMeasdPerWhl: interface=TireTMeasdPerWhl1  # Tire Temperature Measured per Wheel | Set of current measured tire temperatures. | For direct measuring systems.
    TogSt: interface=TogSt1  # Toggle Status | The value is used to generate feedback to the user about the system's current state. The value represents one of two states, mutually excluding each other, the system can be in or has changed to.
    TqSlowAtCluReqdByDrvr: interface=DrvReqTqCluSlow1  # Torque Slow at Clutch Requested by Driver | Anticipated torque at clutch requested by the driver to be generated by the powertrain.
    TracCtrlIndcn: interface=TracCtrlIndcn1  # Traction Control Indication | Traction control is active.
    TracCtrlIntvg: interface=TracCtrlIntvg1  # Traction Control Intervening | Traction control intervention status. True if intervening at at least one wheel.
    TracCtrlOvrdnByRsc: interface=CtrlOvrdnByRsc1  # Traction Control Overridden by RSC | Flag indicating Roll Stability Control (RSC) brake torque overrides Traction Control (TC). This enables RSC to request more torque than TC. (Vector of 4)
    TrfCaseCoorrSt: interface=DftlCoorrSts1  # Status of the Transfer Case Coordinator
    TrlrHitch: interface=TrlrHitchSt1  # Trailer Hitch Status | used to indicate the status/position of trailer hitch
    TrlrIndcrDisp: interface=TrlrIndcrDisp1  # Trailer Indicator Display | This port provides Indication to Instrument cluster of trailer turn indicators status.
    TrlrSt: interface=TrlrSt1  # Trailer Status | Indication about presence of trailer.
    TrlrSts: interface=TrlrSts1  # Trailer Status | Indication about presence of trailer.
    TrlrSwt: interface=TrlrSt1  # Trailer Switch | This port provides Hmi switch status related to presence of trailer
    TrsmActrStOfAxleFrnt: interface=TrsmAxleActrSt1  # Transmission Actuator State Axle Front | Status of the transmission actuator at the front axle.
    TrsmActrStOfAxleRe: interface=TrsmAxleActrSt1  # Transmission Actuator State Axle Rear | Status of the transmission actuator at the rear axle.
    TrsmAuthent: interface=TrsmAuthent1  # Transmission Authentication | Authentication process between transmitter and receiver (device inside the vehicle). This information is internal to Passive Entry (PASE) System
    TrsmAuthentFromPaseMgr: interface=TrsmAuthent1  # Transmission Authentication from Pase Manager | Authentication process between transmitter and receiver (device inside the vehicle). This is an external information delivered by Passive Entry (PASE)
    TrsmAuthentFromRxn: interface=TrsmAuthent1  # Transmission Authentication from Reception | The authentication of the Passive Entry (PASE) access device (transmission device) is used by the access device to be recognized (authenticated) by the system. The authentication information is given by the transmission device to reception device (antenna) to the PASE system.
    TrsmCluNLimnReq: interface=TrsmCluNLimnReq1  # Transmission: Limitation of Clutch Speed | Maximum speed at clutch permitted by transmission. | The timing and accuracy requirements in a typical series project are the same as for signal "Transmission: Clutch Speed Requested by Transmission". References to other signals: TrsmCluNReq Data format for typical network representation for series projects: Uint14 Unit: rpm Type: linear Resolution: 1 Offset: 0 Physically used range: Hex Lower/Upper Limit: 0h / 3FFDh Physical Lower/Upper Limit: 0 / 16381 Special values outside the physically used range: 3FFEh = Init 3FFFh = Error, Signal content invalid Cycle Time: 10 ms (max.) for internal calculation and bus communication. Typical Provider: Transmission Typical Receiver: Powertrain The timing and accuracy requirements in a typical series project are the same as for signal "Transmission: Clutch Speed Requested by Transmission", see:
    TrsmCluNMinReq: interface=TrsmCluNMinReq1  # Transmission: Minimum Clutch Speed Requested by Transmission | Minimum clutch speed requested by transmission. | A higher speed potentially required by another system is permissible. Limitation typically implemented by the engine and/or the electric machine to e.g. 1200 rpm. Used, for example, to provide sufficient oil pressure at high temperature. Data format for typical network representation for series projects: Uint11 Unit: rpm Type: linear Resolution: 1 Offset: 0 Physically used range: Hex Lower/Upper Limit: 0h / 7FDh Physical Lower/Upper Limit: 0 / 2045 Special values outside the physically used range: 7FEh = Init 7FFh = Error, Signal content invalid Cycle Time: 10 ms (max.) for internal calculation and bus communication. Typical Provider: Transmission Typical Receiver: Powertrain Example for timing and accuracy requirements for the response to the signal in a typical series project: The image “Detailed signal content of Torque at Clutch Signals” shows the effects of this signal on the torque at clutch signals.
    TrsmCluNPredGearTar: interface=TrsmCluNPredGearTar1  # Transmission: Predicted Clutch Speed in Target Gear | Predicted clutch speed in target gear. | The predicted speed, calculated at the current vehicle speed, is the speed at clutch which is expected to be reached when the target gear is engaged. For transmissions without a converter: The slip of the drive-off element is supposed to be zero for the calculation of this signal. For these types of transmissions, the predicted clutch speed in target gear is identical to the predicted speed at gearbox input shaft in target gear. For transmissions with a converter: The signal is calculated with the current slip of the drive-off element, because the slip in the target gear is unknown. For these types of transmissions, the predicted clutch speed in target gear is the combination of the predicted speed at gearbox input shaft in target gear with the differential speed in the converter. This means that the current converter slip is considered. Data format for typical network representation for series projects: Uint14 Unit: rpm Type: linear Resolution: 1 Offset: 0 Physically used range: Hex Lower/Upper Limit: 0h / 3FFDh Physical Lower/Upper Limit: 0 / 16381 Special values outside the physically used range: 3FFEh = Init 3FFFh = Error, Signal content invalid Cycle Time: 10 ms (max.) for internal calculation and bus communication. Typical Provider: Transmission Typical Receiver: Powertrain
    TrsmCluNReq: interface=TrsmCluNReq1  # Transmission: Clutch Speed Requested by Transmission | Clutch speed requested by transmission. | Used for shift intervention, coasting including sailing, start-stop and other use cases. This signal is closely related to the following two signals: “Transmission: Target Time to Reach Clutch Speed Requested by Transmission”, “Transmission: Request to Enable Clutch Speed Request”. As long as there is no speed request, the recommendation is to send the initialization value. If the requested time to reach target speed is less than the implementation time the engine needs, then a reaction is expected as fast as possible. The lowest request implemented by the engine is the idle speed. The idle speed controller has priority. The highest request implemented by the engine is the max. admissible engine speed. The engine protection has priority. In parallel hybrid projects, this speed can be implemented by the combustion engine, the electric machine or both of them. In these projects, there are two additional signals which refer to the crankshaft of the combustion engine: “Powertrain: Engine Speed Requested by Powertrain”, “Powertrain: Request to Enable Engine Speed Request”. References to other signals: TrsmTiCluNReqTar TrsmCluNReqEnaReq PtEngNReq PtEngNReqEnaReq Data format for typical network representation for series projects: Uint14 Unit: rpm Type: linear Resolution: 1 Offset: 0 Physically used range: Hex Lower/Upper Limit: 0h / 3FFDh Physical Lower/Upper Limit: 0 / 16381 Special values outside the physically used range: 3FFEh = Init 3FFFh = Error, Signal content invalid Cycle Time: 10 ms (max.) for internal calculation and bus communication. Typical Provider: Transmission Typical Receiver: Powertrain Example for timing and accuracy requirements on the speed request in a typical series project: The image “Detailed signal content of Torque at Clutch Signals” shows the effects of this signal on the torque at clutch signals.
    TrsmCluNReqEnaReq: interface=TrsmCluNReqEnaReq1  # Transmission: Request to Enable Clutch Speed Request | Clutch speed requested by transmission enabled or not enabled. | 0 = not enabled => the request sent by the signals "Transmission: Clutch Speed Requested by Transmission" and "Transmission: Target Time to Reach Clutch Speed Requested by Transmission" is not permitted to be implemented. 1 = enabled => the request must be implemented. If the request must be implemented, then the signal must be “1” and the signal “Transmission: Clutch Speed Requested by Transmission” must be a value in the physically used range, different from initialization and error values. The engine stall protection must have a higher priority than the engine speed request. References to other signals: TrsmCluNReq TrsmTiCluNReqTar Data format for typical network representation for series projects: Uint1 Unit: [-] Type: Enum 0 = not enabled 1 = enabled Cycle Time: 10 ms (max.) for internal calculation and bus communication. Typical Provider: Transmission Typical Receiver: Powertrain
    TrsmCluSt: interface=TrsmCluSt1  # Transmission: Clutch State | State of the clutch. | Be aware that this information is not necessarily equal with the drivetrain open information. If a torque converter clutch is open, the drivetrain can still be closed. In contrary the drivetrain is open for Manual Transmission (MT) and Automatic Manual Transmission (AMT), if the clutch is open! Default value after reset is open.
    TrsmCluStAct: interface=TrsmCluStAct1  # Transmission: Actual Clutch State | Actual state of the clutch. | There exist 4 principal states: open, intermediate, near closed, hard closed (Note: The definition of intermediate and near closed has to be made for each project separately) Definition of "Clutch": Be aware that this information is not necessarily equal with the drivetrain open information. If a torque converter clutch is open, the drivetrain can still be closed. In contrary the drivetrain is open for Manual Transmission (MT) and Automatic Manual Transmission (AMT), if the clutch is open!Default value after reset is open. for Automatic Transmission (AT), Continuously Variable Transmission (CVT) it is the converter clutch for Manual Transmission (MT), Automatic Manual Transmission (AMT) it is the clutch between the gear box and the engine drivetrain
    TrsmCluStConsold: interface=TrsmCluStConsold1  # Transmission: Consolidated Clutch State | Actual state of the clutch. | Be aware that this information is not necessarily equal with the drivetrain open information. If a torque converter clutch is open, the drivetrain can still be closed. In contrary the drivetrain is open for Manual Transmission (MT) and Automatic Manual Transmission (AMT), if the clutch is open!Default value after reset is open.
    TrsmCluStTar: interface=TrsmCluStTar1  # Transmission: Target State of the Clutch | Target state of the clutch. | There exist 4 principal states: open, intermediate, near closed, hard closed (Note: The definition of intermediate and near closed has to be made for each project separately) Definition of "Clutch": Be aware that this information is not necessarily equal with the drivetrain open information. If a torque converter clutch is open, the drivetrain can still be closed. In contrary the drivetrain is open for Manual Transmission (MT) and Automatic Manual Transmission (AMT), if the clutch is open!Default value after reset is open. for Automatic Transmission (AT), Continuously Variable Transmission (CVT) it is the converter clutch for Manual Transmission (MT), Automatic Manual Transmission (AMT) it is the clutch between the gear box and the engine drivetrain
    TrsmDrvOffElmSt: interface=TrsmDrvOffElmSt1  # Transmission: State of Drive-Off Element | State of drive-off element concerning power transmission. | The signal describes the transmission of power of the drive-off element only, independent of the gearbox design. The signal is independent of the position of the drive-off element in the power flow. The signal is also independent of whether the drive-off element is only used for drive-off or additionally used as a shift clutch. Drive-off elements are implemented, for example, as hydraulic torque converter or friction clutch. There are gearboxes where drive-off element and gearbox core are separate mechanical parts. There are also gearboxes where a clutch in the gearbox is used as both, drive-off element and shift clutch: a) If the clutch is used as a drive-off element: The signal is defined by the state of this clutch. b) If the clutch is used as a shift clutch: The state of the signal is "closed". States of power transmission: 0 = open 1 = open_touch 2 = slip_controlled 3 = slip_micro 4 = closed 5 = not_determined (state of power transmission cannot be identified) 6 = hydrodynamic 14 = init 15 = signal error Values 7… 13 are undefined. Data format for typical network representation for series projects: Uint4 Unit: [-] Type: Enum 0 = open 1 = open_touch 2 = slip_controlled 3 = slip_micro 4 = closed 5 = not_determined 6 = hydrodynamic 14 = init 15 = error Values 7… 13 are undefined. Cycle Time: 10 ms (max.) for internal calculation and bus communication. Typical Provider: Transmission Typical Receiver: Powertrain “State of Power Transmission” in typical series projects:
    TrsmDrvOffElmStTar: interface=TrsmDrvOffElmStTar1  # Transmission: Target State of Drive-Off Element | Target state of the drive-off element concerning transmission of power. | The signal describes the target transmission of power of the drive-off element only, independent of the gearbox design. The signal is independent of the position of the drive-off element in the power flow. The signal is also independent of whether the drive-off element is only used for drive-off or additionally used as a shift clutch. Drive-off elements are implemented, for example, as a hydraulic torque converter or friction clutch. There are gearboxes with separate mechanical parts for the drive-off element and the gearbox core. There are also gearboxes where a clutch in the gearbox is used as both, drive-off element and shift clutch: a) If the clutch is used as a drive-off element: The signal is defined by the state of this clutch. b) If the clutch is used as a shift clutch: The state of the signal is "closed". States of power transmission: 0 = open 1 = open_touch 2 = slip_controlled 3 = slip_micro 4 = closed 5 = not_determined (state of power transmission cannot be identified) 6 = hydrodynamic 14 = init 15 = signal error Values 7… 13 are undefined. Data format for typical network representation for series projects: Uint4 Unit: [-] Type: Enum 0 = open 1 = open_touch 2 = slip_controlled 3 = slip_micro 4 = closed 5 = not_determined 6 = hydrodynamic 14 = init 15 = error Values 7… 13 are undefined. Cycle Time: 10 ms (max.) for internal calculation and bus communication. Typical Provider: Transmission Typical Receiver: Powertrain “State of Power Transmission” in typical series projects:
    TrsmFlgCtrsftActv: interface=TrsmFlgCtrsftActv1  # Transmission: Countershaft Active | Indicates whether the gear is in low range mode, e.g. for sport utility vehicles (SUV) or Offroad-vehicles with countershaft gearboxes (high range / low range) - 0: countershaft inactive (standard condition) - 1: countershaft active
    TrsmFlgDtOpen: interface=TrsmFlgDtOpen1  # Transmission: Drivetrain Opened | Indicates whether the drive train is open due to driver input. Transitional states between fully open and fully closed drivetrain shall be indicated as open in this signal. | Automatic Transmission (AT): Lever in N or in P or in neutral state because of internal reasons (e.g. internal failure) Manual Transmission (MT): Estimation based on clutch pedal pressed and optional neutral gear recognition. 0 : Drivetrain fully closed 1 : Drivetrain fully open or between fully open and fully closed.
    TrsmFlgParkLockEngd: interface=TrsmFlgParkLockEngd1  # Transmission: Park Lock Engaged | Status of gearbox on engaged parking lock (P-drive) of the Automatic Transmission (AT). 0 : not engaged 1 : engaged
    TrsmFlgShiftProgs: interface=TrsmFlgShiftProgs1  # Transmission: Gear Shift in Progress | Flag indicates that a gear shift is in progress. | A gear shift is in progress while the transmission is changing the gear. This typically includes the preparation of the clutches, i.e. the fast filling phase of the clutch on automatic transmissions. “Gear shift is active” is a synonym for “Gear shift is in progress”. Data format for typical network representation for series projects: Uint1 Unit: [-] Type: Enum 0 = No Shift in Progress (Flag reset) 1 = Shift in Progress (Flag set) Cycle Time: 10 ms (max.) for internal calculation and bus communication. Typical Provider: Transmission Typical Receiver: Powertrain
    TrsmFlgSptMod: interface=TrsmFlgSptMod1  # Transmission: Sport Mode Request by Driver | Flag signals that the driver activated the sport mode. 0 = deactivated 1 = activated
    TrsmFlgSptModReq: interface=TrsmFlgSptModReq1  # Transmission: Sport Mode Request by Driver | Flag signals that the driver activated the sport mode. 0 = deactivated 1 = activated
    TrsmFlgWntrMod: interface=TrsmFlgWntrMod1  # Transmission: Winter Mode Request by Driver | Flag signals that the driver activated the winter mode 0 = deactivated 1 = activated
    TrsmFlgWntrModReq: interface=TrsmFlgWntrModReq1  # Transmission: Winter Mode Request by Driver | Flag signals that the driver activated the winter mode 0 = deactivated 1 = activated
    TrsmGbxCoreSt: interface=TrsmGbxCoreSt1  # Transmission: State of Gearbox Core | State of gearbox core concerning power transmission. | The signal describes the transmission of power between gearbox input shaft and output shaft. The signal summarizes the state of power transmission of all gears and all gearbox internal clutches except for the drive-off element. The gearbox core is the part of the gearbox which is not used as drive-off element. There are gearboxes where drive-off element and gearbox core are separate mechanical parts. There are also gearboxes where a clutch in the gearbox is used as both, drive-off element and shift clutch. a) If the clutch is used as a drive-off element: The signal "Transmission: State of Drive-Off Element” is defined by the state of this clutch. The signal specified by this text is then defined by the state of the other parts of the gearbox. These other parts are the gearbox core. b) If the clutch is used as a shift clutch: The state of the signal "Transmission: State of Drive-Off Element” is "closed". The signal specified by this text is then defined by the state of all parts of the gearbox. Then all parts of the gearbox are the gearbox core. States of power transmission: 0 = open 1 = open_touch 2 = slip_controlled 3 = slip_micro 4 = closed 5 = not_determined (state of power transmission cannot be identified) 6 = hydrodynamic 14 = init 15 = signal error Values 7… 13 are undefined. References to other signals: TrsmDrvOffElmSt Data format for typical network representation for series projects: Uint4 Unit: [-] Type: Enum 0 = open 1 = open_touch 2 = slip_controlled 3 = slip_micro 4 = closed 5 = not_determined 6 = hydrodynamic 14 = init 15 = error Values 7… 13 are undefined. Cycle Time: 10 ms (max.) for internal calculation and bus communication. Typical Provider: Transmission Typical Receiver: Powertrain “State of Power Transmission” in typical series projects:
    TrsmGbxSt: interface=TrsmGbxSt1  # Transmission: State of Gearbox | State of the gearbox concerning transmission of power. | The signal is defined for the serial connection of the drive-off element and the gearbox core with one input shaft and one output shaft. Gearboxes with more than one input shaft or more than one output shaft are not in the scope of this definition. States of power transmission: 0 = open 1 = open_touch 2 = slip_controlled 3 = slip_micro 4 = closed 5 = not_determined (state of power transmission cannot be identified) 6 = hydrodynamic 14 = init 15 = signal error Values 7… 13 are undefined. Data format for typical network representation for series projects: Uint4 Unit: [-] Type: Enum 0 = open 1 = open_touch 2 = slip_controlled 3 = slip_micro 4 = closed 5 = not_determined 6 = hydrodynamic 14 = init 15 = error Values 7… 13 are undefined. Cycle Time: 10 ms (max.) for internal calculation and bus communication. Typical Provider: Transmission Typical Receiver: Powertrain “State of Power Transmission” in typical series projects:
    TrsmGearSt: interface=TrsmGearSt1  # Transmission: Transmission Gear State | Gear state of the transmission. | Outside of a gear shift phase, this signal displays the gear which is engaged in the gearbox core. During a gear shift phase, this signal displays the gear which will be engaged at the end of the gear shift phase. For consecutive shifts during one gear shift phase, the gear which is intended to be engaged at the end is displayed. The target gear may change during the gear shift phase. The gear shift phase can be identified by the signal “Transmission: Gear Shift in Progress”. Gear information does not necessarily reflect the current driving direction of the vehicle. A signed gear as a pure numerical value (signed integer) can be created from the following payload part of the interface: 0 = reverse gear 2 1 = reverse gear 1 2 = no gear engaged 3 = gear 1 4 = gear 2 … 28 = gear 26 29 = no discrete gear State “no discrete gear" is typically used by continuous variable transmissions (CVT). References to other signals: TrsmFlgShiftProgs Data format for typical network representation for series projects: Uint5 Unit: [-] Type: Enum 0 = reverse gear 2 1 = reverse gear 1 2 = no gear engaged 3 = gear 1 4 = gear 2 … 28 = gear 26 29 = no discrete gear 30 = init 31 = error Cycle Time: 10 ms (max.) for internal calculation and bus communication. Typical Provider: Transmission Typical Receiver: Powertrain
    TrsmId: interface=TrsmId1  # Transmission Identifier | Information related to the access device (transmission device) used to enter the car. This information provides the Identifier (ID), it is sent by the transmission device or access card to be recognized by the system
    TrsmIdFromRxn: interface=TrsmId1  # Transmission Identifier from Reception | The identification of the Passive Entry (PASE) access device (transmission device) is used by the access device to be recognized (Identified) by the system. The identification information is given by the transmission device to reception device (antenna) to the PASE system.
    TrsmInpN: interface=TrsmInpN1  # Transmission: Transmission Input Speed | Transmission input speed. | Rotational speed of the input shaft of the gearbox core. For automatic transmissions with a converter, the input shaft of the gearbox core and the output shaft of the converter are identical. The signal is not defined for transmissions with a gearbox core with more than one input shaft. The signal is especially not defined for double clutch transmissions. Data format for typical network representation for series projects: Uint15 Unit: rpm Type: linear Resolution: 1 Offset: -16384 Physically used range: Hex Lower/Upper Limit: 0h / 7FFDh Physical Lower/Upper Limit: -16384 / 16381 Special values outside the physically used range: 7FFEh = Init 7FFFh = Error, Signal content invalid Cycle Time: 10 ms (max.) for internal calculation and bus communication. Typical Provider: Transmission Typical Receiver: Powertrain
    TrsmIntvModReqForTqCluMaxFastReqForShiftIntv: interface=TrsmIntvModReqForTqCluMaxFastReqForShiftIntv1  # Transmission: Intervention Mode Request for Maximum Torque at Clutch for Shift Intervention on Fast Path | Combination of ignition retard and cylinder cut-off for implementation of maximum torque requested for shift intervention on fast path. | 0 = No restrictions => ignition angle and cylinder cut-off permitted, default for diesel engines 1 = Ignition angle => cylinder cut-off not permitted 2 = Cylinder cut-off => ignition angle not permitted In parallel hybrid projects, implementation of the torque request by the electric machine is permitted. If the distribution of the torque request to electric machine and combustion engine must be defined, then a separate signal is necessary. Data format for typical network representation for series projects: Uint2 Unit: [-] Type: Enum 0 = no restriction 1 = ignition angle 2 = cylinder cut-off Value 3 is undefined. Cycle Time: 10 ms (max.) for internal calculation and bus communication. Typical Provider: Transmission Typical Receiver: Powertrain
    TrsmIntvModReqForTqCluReqForShiftIntv: interface=TrsmIntvModReqForTqCluReqForShiftIntv1  # Transmission: Intervention Mode Request for Torque at Clutch for Shift Intervention | Combination of ignition retard, cylinder cut-off and air mass modulation for implementation of transmission torque request for shift intervention on fast path. | 0 = no restrictions => ignition angle, cylinder cut-off and air mass modulation permitted, default for diesel engines 1 = Ignition angle and cylinder cut-off => air mass modulation not permitted 2 = Ignition angle => cylinder cut-off and air mass modulation not permitted 3 = Ignition angle and air => cylinder cut-off not permitted 4 = Air => ignition angle and cylinder cut-off not permitted 5 = Cylinder cut-off => ignition angle and air mass modulation not permitted 6 = Cylinder cut-off and air => ignition retard not permitted 7 = Undefined => to be treated as "0 = no restrictions". In parallel hybrid projects, implementation of the torque request by the electric machine is permitted. If the distribution of the torque request to electric machine and combustion engine must be defined, then a separate signal is necessary. Data format for typical network representation for series projects: Uint3 Unit: [-] Type: Enum 0 = no restriction 1 = ignition angle and cylinder cut-off 2 = ignition angle 3 = ignition angle and air 4 = air 5 = cylinder cut-off 6 = cylinder cut-off and air Value 7 is undefined. Cycle Time: 10 ms (max.) for internal calculation and bus communication. Typical Provider: Transmission Typical Receiver: Powertrain
    TrsmNInp: interface=TrsmNInp1  # Transmission: Speed at Input | For Transmission with a Torque Converter this interface represents the turbine speed, which is the output speed of the Torque Converter. For Dual Clutch Transmission (DCT) this speed represents the speed of the active clutch. | For low speed values the speed might be a virtual speed.
    TrsmNrGearAct: interface=TrsmNrGearAct1  # Transmission: Actual Gear | Shows the gear being currently engaged in the gear box. Mapping of physical gear to representation is left open, but according to: - Negative values: Reverse gears. (Only for manual transmission: If no information about reverse gears is available then corresponding positive values are used for reverse gears.) - Positive values: forward gears; 0 is drive train open (no torque at clutch is transmitted between the running engine(s) and the wheels). | The use of Continuously Variable Transmission (CVT) has to be handled by separate SW-functionalities. Also for Continuously Variable Transmission (CVT). 0 is defined as open drive train.Default value after reset is zero.
    TrsmNrGearConsold: interface=TrsmNrGearConsold1  # Transmission: Consolidated Gear | Shows the gear being currently engaged in the gear box. Mapping of physical gear to representation is left open, but according to: - Negative values: Reverse gears. (Only for manual transmission: If no information about reverse gears is available then corresponding positive values are used for reverse gears.) - Positive values: forward gears; 0 is drive train open (no torque at clutch is transmitted between the running engine(s) and the wheels). | The use of Continuously Variable Transmission (CVT) has to be handled by separate SW-functionalities. Also for Continuously Variable Transmission (CVT). 0 is defined as open drive train.Default value after reset is zero.
    TrsmNrGearReq: interface=TrsmNrGearReq1  # Transmission: Requested Gear | Shows the gear being currently requested by the ratio strategy. Mapping of physical gear to representation is left open, but according to: - Negative values: Reverse gears. (Only for manual transmission: If no information about reverse gears is available then corresponding positive values are used for reverse gears.) - Positive values: forward gears; 0 is drive train open (no torque at clutch is transmitted between the running engine(s) and the wheels). | The use of Continuously Variable Transmission (CVT) has to be handled by separate SW-functionalities. Also for Continuously Variable Transmission (CVT). 0 is defined as open drive train.Default value after reset is zero.
    TrsmNrGearTar: interface=TrsmNrGearTar1  # Transmission: Target Gear | Shows the gear which will be engaged in the gear box. | During the shifting process this value informs about the gear which is expected to be engaged in the gear box after the shifting process. Therefore it switches to the expected gear state with the beginning of the shifting process. Mapping of physical gear to representation is left open, but according to: (Only for manual transmission: If no information about reverse gears is available then corresponding positive values are used for reverse gears.) 0 is drive train open (no torque at clutch is transmitted between the running engine(s) and the wheels). The use of Continuously Variable Transmission (CVT) has to be handled by separate SW-functionalities. Also for Continuously Variable Transmission (CVT). 0 is defined as open drive train.Default value after reset is zero. Negative values: Reverse gears. Positive values: forward gears;
    TrsmNrTyp: interface=TrsmNrTyp1  # Transmission Type | Information on standard transmission. | Initialization possible by "EOL" or "Key On". This information can come from compiler switch, calibration label, or as learned variant (SW identifies Gearbox type)signal is sent with initialisation
    TrsmNrTypOfTqCluMaxMinFastSlowReqForShiftIntv: interface=TrsmNrTypOfTqCluMaxMinFastSlowReqForShiftIntv1  # Transmission: Implementation Type of Request for Maximum and Minimum Torque at Clutch for Shift Intervention on Fast and Slow Path | Defines reference point of the signals requesting the maximum/minimum torque at clutch for shift intervention on fast/slow path. | This signal affects all of the following signals: “Transmission: Request for Maximum Torque at Clutch for Shift Intervention on Fast Path”, “Transmission: Request for Minimum Torque at Clutch for Shift Intervention on Fast Path”, “Transmission: Request for Maximum Torque at Clutch for Shift Intervention on Slow Path”, “Transmission: Request for Minimum Torque at Clutch for Shift Intervention on Slow Path”. 0 = absolute => the transmission requests an absolute limit for the torque to be produced by the engine on the fast and / or slow path. 1 = relative => the transmission requests a relative intervention for the torque to be produced by the engine on the fast and / or slow path. The reference signal is "Powertrain: Torque at Clutch without Transmission Intervention”. References to other signals: TrsmTqCluMaxFastReqForShiftIntv TrsmTqCluMinFastReqForShiftIntv TrsmTqCluMaxSlowReqForShiftIntv TrsmTqCluMinSlowReqForShiftIntv PtTqCluWoTrsmIntv Data format for typical network representation for series projects: Uint1 Unit: [-] Type: Enum 0 = absolute 1 = relative Cycle Time: 10 ms (max.) for internal calculation and bus communication. Typical Provider: Transmission Typical Receiver: Powertrain
    TrsmNrTypOfTqCluReqForShiftIntv: interface=TrsmNrTypOfTqCluReqForShiftIntv1  # Transmission: Implementation Type of Request for Torque at Clutch for Shift Intervention | Defines reference point and coordination of transmission torque request on fast path. | The reference point is 0 Nm for absolute requests and driver requested torque for relative requests. 0 = no request => the transmission does not send a request 1 = absolute maximum => the transmission requests an absolute upper limit for the torque to be produced by the engine. The real engine torque is permitted to be lower. It may be lower due to driver request or due to interventions by other systems. This case is usually used for torque decrease requests. 2 = absolute minimum => the transmission requests an absolute lower limit for the torque to be produced by the engine. The real engine torque is permitted to be higher. It may be higher due to driver request or due to interventions by other systems. This case is usually used for torque increase requests. 3 = absolute exact => the transmission requests exactly the torque to be produced by the engine. The real engine torque must comply with the request. This case is used for exact torque requests independently of whether the request is an increase or a decrease. 4 = relative => the transmission requests a torque relative to the reference "Powertrain: Torque at Clutch without Transmission Intervention”. The torque request to be implemented is the sum of "Powertrain: Torque at Clutch without Transmission Intervention" and "Transmission: Request for Torque at Clutch for Shift Intervention”. If the sign of the relative torque request is positive, then the sum is treated such as "2 = absolute minimum". If the sign of the relative torque request is negative, then the sum is treated such as "1 = absolute maximum". Advantage of the relative request: It immediately follows dynamic changes in the reference. It does not depend strongly on communication time delays. Advantage of the absolute request: It is independent of the reference and its dynamic behavior, so it meets exact absolute requests from the transmission. This signal does not define whether or not the intervention of stability control has priority over the intervention of the transmission. The signal can be used in both cases. The priority of stability control versus transmission intervention is not part of this definition. References to other signals: PtTqCluWoTrsmIntv TrsmTqCluReqForShiftIntv Data format for typical network representation for series projects: Uint3 Unit: [-] Type: Enum 0 = no request 1 = absolute maximum 2 = absolute minimum 3 = absolute exact 4 = relative Values 5, 6, 7 are undefined. Cycle Time: 10 ms (max.) for internal calculation and bus communication. Typical Provider: Transmission Typical Receiver: Powertrain
    TrsmNrTypOfTqCluResvReq: interface=TrsmNrTypOfTqCluResvReq1  # Transmission: Implementation Type of Request for Torque Reserve at Clutch | Defines reference point of torque reserve requested by transmission. | 0 = no request => the transmission does not send a request. 1 = absolute minimum => the transmission requests an increase in the torque at clutch on slow path to the transmitted value, and compensation of the increased air mass by ignition retard and/or injection cutoff. 2 = relative => the transmission requests an increase in the torque at clutch on slow path to the transmitted value relative to the signal "Powertrain: Torque at Clutch without Transmission Intervention", and compensation of the increased air mass by ignition retard and/or injection cutoff. If the status is "relative", then only positive values are permitted for "Transmission: Request for Torque Reserve at Clutch". References to other signals: PtTqCluWoTrsmIntv TrsmTqCluResvReq Data format for typical network representation for series projects: Uint2 Unit: [-] Type: Enum 0 = no request 1 = absolute minimum 2 = relative Value 3 is undefined. Cycle Time: 10 ms (max.) for internal calculation and bus communication. Typical Provider: Transmission Typical Receiver: Powertrain
    TrsmPosnForPase: interface=TrsmPosn1  # Transmission Position for Passive Entry | Information precises the position of all transmitters outside of the vehicle - Near or far from the car - rear or front of the car - right or left side of the car This information is internal for Passive Entry functionality
    TrsmPosnFromPaseMgr: interface=TrsmPosn1  # Transmission Position from Pase Manager | Information precises the position of all transmitters outside of the vehicle - Near or far from the car - rear or front of the car - right or left side of the car This information is displayed through the system
    TrsmRatGear: interface=TrsmRatGear1  # Transmission: Get the Gear Ratio of the Gear of Interest (C/S) | The gear ratio of the gear of interest. (Client/Server) | Theoretical transmission ratio i = ntransmission_in / ntransmission_out transmission_in = after converter transmission_out = gearbox out The gear ratio means the theoretical/physical ratio belonging to each gear and not any actual measured value (proposal for Continuously Variable Transmission(CVT): if there is a wide range for gear states, this value could deliver a theoretical value). Negative values: Reverse driving direction. Without considering the: 1.) axle ratio 2.) converter ratio 3.) High/Low-Range ratio'Default value after reset is 1.0.'
    TrsmRatGearAct: interface=TrsmRatGearAct1  # Transmission: The Actual Gear Ratio Being Currently Engaged in the Gear Box | Actual gear ratio The gear ratio being currently engaged in the gear box. | Theoretical transmission ratio i = ntransmission_in / ntransmission_out transmission_in = after converter transmission_out = gearbox out The gear ratio means the theoretical/physical ratio belonging to each gear and not any actual measured value (proposal for Continuously Variable Transmission(CVT): if there is a wide range for gear states, this value could deliver a theoretical value). Negative values: Reverse driving direction. Without considering the: 1.) axle ratio 2.) converter ratio 3.) High/Low-Range ratio'Default value after reset is 1.0.'
    TrsmRatGearConsold: interface=TrsmRatGearConsold1  # Transmission: The Consolidated Gear Ratio Being Currently Engaged in the Gear Box | Actual gear ratio The gear ratio being currently engaged in the gear box. | Theoretical transmission ratio i = ntransmission_in / ntransmission_out transmission_in = after converter transmission_out = gearbox out The gear ratio means the theoretical/physical ratio belonging to each gear and not any actual measured value (proposal for Continuously Variable Transmission(CVT): if there is a wide range for gear states, this value could deliver a theoretical value). Negative values: Reverse driving direction. Without considering the: 1.) axle ratio 2.) converter ratio 3.) High/Low-Range ratio'Default value after reset is 1.0.'
    TrsmRatGearReq: interface=TrsmRatGearReq1  # Transmission: Requested Gear Ratio | The gear ratio which is requested by ratio strategy | Theoretical transmission ratio i = ntransmission_in / ntransmission_out transmission_in = after converter transmission_out = gearbox out The gear ratio means the theoretical/physical ratio belonging to each gear and not any actual measured value. Proposal for Continuously Variable Transmission (CVT): if there is a wide range for gear states, this value could deliver a theoretical ratio. Negative values: Reverse driving direction. Without considering the: 1.) Axle ratio 2.) Converter ratio 3.) High/Low-Range ratio'Default value after reset is 1.0.'
    TrsmRatGearTar: interface=TrsmRatGearTar1  # Transmission: The Gear Ratio Which Will Be Engaged in the Gear Box When Target Gear Is Reached | Target gear ratio The gear ratio which will be engaged in the gear box when target gear is reached. | Theoretical transmission ratio i = ntransmission_in / ntransmission_out transmission_in = after converter transmission_out = gearbox out The gear ratio means the theoretical/physical ratio belonging to each gear and not any actual measured value (proposal for Continuously Variable Transmission(CVT): if there is a wide range for gear states, this value could deliver a theoretical value). Negative values: Reverse driving direction. Without considering the: 1.) axle ratio 2.) converter ratio 3.) High/Low-Range ratio'Default value after reset is 1.0.'
    TrsmRatTqPtAct: interface=TrsmRatTqPtAct1  # Transmission: Actual Powertrain Torque Ratio | Torque conversion ratio including everything between engine and wheel, i.e. converter gain (only for hydraulic converter), gear box and axle ratio. | TQwheel = (TQclutch * FACconverter * ntransmission_in / nwheel) - TQlossDT TQ conversion ratio = FACconverter * ntransmission_in / nwheel (remark: TQlossDT is not considered here) FACconverter = converter gain transmission_in = after converter/clutch Inertia is not considered. The torque conversion ratio considers only the total powertrain torque at wheels, not the wheel individual torque distribution. At open drivetrain: To get a valid value during the open drivetrain always the lowest gear should be used except: Driver or strategy selects "N" or "P": every transmission has an open drivetrain Low vehicle speed: Manual Transmission (MT), Automatic Manual Transmission (AMT) and Dual Clutch Transmission (DCT) have an open drivetrain. For Automatic Transmission (AT) and Continuously Variable Transmission (CVT) the drivetrain is still closed (hydraulic converter) Shifting: Only Manual Transmission (MT) and Automatic Manual Transmission (AMT) have an open drivetrain for Automatic Manual Transmission (AMT), if a gear shift is detected, the torque ratio calculation changes from using the current gear state to the target gear state at some point during the shift. This point of change must be agreed between transmitter and receiver. The torque ratio never indicates neutral during a shift. for Automatic Transmission (AT), Continuously Variable Transmission (CVT) and Dual Clutch Transmission (DCT): While the drivetrain is open the transmission prepares a theoretical gear position to engage immediately after the driver selects "D". This theoretical gear state information should be used.Default value after reset is 1.0.
    TrsmRatTqPtConsold: interface=TrsmRatTqPtConsold1  # Transmission: Consolidated Powertrain Torque Ratio | Torque conversion ratio including everything between engine and wheel, i.e. converter gain (only for hydraulic converter), gear box and axle ratio. | TQwheel = (TQclutch * FACconverter * ntransmission_in / nwheel) - TQlossDT TQ conversion ratio = FACconverter * ntransmission_in / nwheel (remark: TQlossDT is not considered here) FACconverter = converter gain transmission_in = after converter/clutch Inertia is not considered. The torque conversion ratio considers only the total powertrain torque at wheels, not the wheel individual torque distribution. At open drivetrain: To get a valid value during the open drivetrain always the lowest gear should be used except: Driver or strategy selects "N" or "P": every transmission has an open drivetrain Low vehicle speed: Manual Transmission (MT), Automatic Manual Transmission (AMT) and Dual Clutch Transmission (DCT) have an open drivetrain. For Automatic Transmission (AT) and Continuously Variable Transmission (CVT) the drivetrain is still closed (hydraulic converter) Shifting: Only Manual Transmission (MT) and Automatic Manual Transmission (AMT) have an open drivetrain for Automatic Manual Transmission (AMT), if a gear shift is detected, the torque ratio calculation changes from using the current gear state to the target gear state at some point during the shift. This point of change must be agreed between transmitter and receiver. The torque ratio never indicates neutral during a shift. for Automatic Transmission (AT), Continuously Variable Transmission (CVT) and Dual Clutch Transmission (DCT): While the drivetrain is open the transmission prepares a theoretical gear position to engage immediately after the driver selects "D". This theoretical gear state information should be used.Default value after reset is 1.0.
    TrsmRatTqTrsmOutpByTqClu: interface=TrsmRatTqTrsmOutpByTqClu1  # Transmission: Ratio of Torque at Transmission Output by Torque at Clutch | Ratio of torque at transmission output by torque at clutch. | Current ratio of “Torque at Transmission Output” by “Torque at Clutch”. This ratio covers the ratio of the gearbox, but does not cover the ratio of the transfer case or the ratio of the reduction gearbox, if present. For transmissions without a converter: The slip of the drive-off element is supposed to be zero for the calculation of this signal. For transmissions with a converter: The signal is calculated with the current converter torque ratio. The converter torque ratio is continuously updated. For transmissions with a converter, the signal is the combination of the current torque ratio of the gearbox core and the actual torque ratio of the converter including the converter clutch, if present. Data format for typical network representation for series projects: Uint14 Unit: [-] Type: linear Resolution: 0,0078125 Offset: 0 Physically used range: Hex Lower/Upper Limit: 0h / 3FFDh Physical Lower/Upper Limit: 0 / 127,9765 Special values outside the physically used range: 3FFEh = Init 3FFFh = Error, Signal content invalid Cycle Time: 10 ms (max.) for internal calculation and bus communication. Typical Provider: Transmission Typical Receiver: Powertrain
    TrsmRatTqTrsmOutpByTqCluTar: interface=TrsmRatTqTrsmOutpByTqCluTar1  # Transmission: Target Ratio of Torque at Transmission Output By Torque at Clutch | Target ratio of torque at transmission output by torque at clutch. | The ratio of "Torque at Transmission Output" by "Torque at Clutch", calculated at the current vehicle speed, is expected to be reached when the target gear is engaged. This ratio covers the ratio of the gearbox, but not the transfer case and the reduction gearbox, if present. For transmissions without a converter: The slip of the drive-off element is supposed to be zero for the calculation of this signal. For transmissions with a converter: The signal is calculated with the current converter torque ratio, because the converter torque ratio in the target gear is unknown. The converter torque ratio is continuously updated. For transmissions with a converter, the signal is the combination of the torque ratio of the gearbox core in target gear and the current torque ratio of the converter including the converter clutch, if present. The signal changes synchronously with the change of the "Transmission: Transmission Gear State". References to other signals: TrsmGearSt Data format for typical network representation for series projects: Uint14 Unit: [-] Type: linear Resolution: 0,0078125 Offset: 0 Physically used range: Hex Lower/Upper Limit: 0h / 3FFDh Physical Lower/Upper Limit: 0 / 127,9765 Special values outside the physically used range: 3FFEh = Init 3FFFh = Error, Signal content invalid Cycle Time: 10 ms (max.) for internal calculation and bus communication. Typical Provider: Transmission Typical Receiver: Powertrain
    TrsmRatTqWhlByTqClu: interface=TrsmRatTqWhlByTqClu1  # Transmission: Ratio of Torque at Wheel by Torque at Clutch | Ratio of torque at wheel by torque at clutch. | Current ratio of "Torque at Wheel" by "Torque at Clutch". This ratio covers the ratio of the gearbox, the transfer case and the reduction gearbox, if present. For transmissions without a converter: The slip of the drive-off element is supposed to be zero for the calculation of this signal. For transmissions with a converter: The signal is calculated with the current converter torque ratio. The converter torque ratio is continuously updated. For transmissions with a converter, the signal is the combination of the current torque ratio of the gearbox core and the current torque ratio of the converter including the converter clutch, if present. Data format for typical network representation for series projects: Uint14 Unit: [-] Type: linear Resolution: 0,0078125 Offset: 0 Physically used range: Hex Lower/Upper Limit: 0h / 3FFDh Physical Lower/Upper Limit: 0 / 127,9765 Special values outside the physically used range: 3FFEh = Init 3FFFh = Error, Signal content invalid Cycle Time: 10 ms (max.) for internal calculation and bus communication. Typical Provider: Transmission Typical Receiver: Powertrain
    TrsmRatTqWhlByTqCluTar: interface=TrsmRatTqWhlByTqCluTar1  # Transmission: Target Ratio of Torque at Wheel by Torque at Clutch | Target ratio of torque at wheel by torque at clutch. | The ratio of "Torque at Wheel" by "Torque at Clutch", calculated at the current vehicle speed, is expected to be reached when the target gear is engaged. This ratio covers the ratio of the gearbox, the transfer case and the reduction gearbox, if present. For transmissions without a converter: The slip of the drive-off element is supposed to be zero for the calculation of this signal. For transmissions with a converter: The signal is calculated with the current converter torque ratio, because the converter torque ratio in the target gear is unknown. The converter torque ratio is continuously updated. For transmissions with a converter, the signal is the combination of the torque ratio of the gearbox core in target gear and the current torque ratio of the converter including the converter clutch, if present. The signal changes synchronously with the change of the "Transmission: Transmission Gear State". References to other signals: TrsmGearSt Data format for typical network representation for series projects: Uint14 Unit: [-] Type: linear Resolution: 0,0078125 Offset: 0 Physically used range: Hex Lower/Upper Limit: 0h / 3FFDh Physical Lower/Upper Limit: 0 / 127,9765 Special values outside the physically used range: 3FFEh = Init 3FFFh = Error, Signal content invalid Cycle Time: 10 ms (max.) for internal calculation and bus communication. Typical Provider: Transmission Typical Receiver: Powertrain
    TrsmRednGbxSt: interface=TrsmRednGbxSt1  # Transmission: State of Reduction Gearbox | State of the reduction gearbox concerning transmission of power. | The signal is defined for reduction gearboxes with dog clutch, which is the most common case. Correspondingly, reduction gearboxes with more than two states of power transmission are not in scope of this definition. States of power transmission: 0 = open 1 = closed 2 = init 3 = signal error Data format for typical network representation for series projects: Uint2 Unit: [-] Type: Enum 0 = open 1 = closed 2 = init 3 = error Cycle Time: 10 ms (max.) for internal calculation and bus communication. Typical Provider: Transmission Typical Receiver: Powertrain “State of Power Transmission” in typical series projects:
    TrsmRxnOfPasePanic: interface=TrsmRxnOfPasePanicReq1  # Transmission Reception of Pase Panic | Panic request given by Passive Entry (PASE) Key to command a panic alert.
    TrsmStAxleFrntActr: interface=TrsmAxleActrSt1  # Transmission: Status of the Front Axle Actuator | Status of the Front Axle Actuator. This could be a Torque Vector Device, an active control differential or a locking differential
    TrsmStAxleReActr: interface=TrsmAxleActrSt1  # Transmission: Status of the Rear Axle Actuator | Status of the Rear Axle Actuator. This could be a Torque Vector Device, an active control differential or a locking differential
    TrsmStGearLvr: interface=TrsmStGearLvr1  # Transmission: Actual Gear Lever Position | The signal is based on the lever position. Only defined for automatic transmissions.
    TrsmStTrfCaseDftl: interface=TrsmStTrfCaseDftl1  # Transmission: Status of the Transfer Case Differential | Status of the Transfer Case Differential
    TrsmTOil: interface=TrsmTOil1  # Transmission: Transmission Oil Temperature | Transmission oil temperature. | Data format for typical network representation for series projects: Uint8 Unit: °C Type: linear Resolution: 1 Offset: -40 Physically used range: Hex Lower/Upper Limit: 0h / FDh Physical Lower/Upper Limit: -40 / 213 Special values outside the physically used range: FEh = Init FFh = Error, Signal content invalid Cycle Time: 100 ms (max.) for internal calculation and bus communication. Typical Provider: Transmission Typical Receiver: Powertrain
    TrsmTiCluNReqTar: interface=TrsmTiCluNReqTar1  # Transmission: Target Time to Reach Clutch Speed Requested by Transmission | Target time to reach clutch speed requested by transmission. | The speed at clutch requested by "Transmission: Clutch Speed Requested by Transmission" must be reached in the transmitted target time. As long as there is no speed request, the recommendation is to send the initialization value. References to other signals: TrsmCluNReq Data format for typical network representation for series projects: Uint8 Unit: ms Type: linear Resolution: 20 Offset: 0 Physically used range: Hex Lower/Upper Limit: 0h / FDh Physical Lower/Upper Limit: 0 / 5060 Special values outside the physically used range: FEh = Init FFh = Error, Signal content invalid Cycle Time: 10 ms (max.) for internal calculation and bus communication. Typical Provider: Transmission Typical Receiver: Powertrain Example for timing and accuracy requirements on the speed request in a typical series project:
    TrsmTqCluGbxCnsNIdleCtrlr: interface=TrsmTqCluGbxCnsNIdleCtrlr1  # Transmission: Gearbox Torque Consumption at Clutch for Idle Speed Controller | Gearbox torque at clutch consumption based on transmission oil pump torque losses and drive-off element torque. | The torque consumed by the gearbox must be provided to the engine to ensure stable idle speed operation. Together with other torque losses, it significantly contributes to the idle speed controller setpoint, especially if there is no driver torque request. Consequently it is used for precontrol in the idle speed controller and defines an essential part of the minimum limit for the driver torque request. The gearbox torque consumption is a) the sum of the drive-off element torque and the absolute value of the transmission oil pump torque losses, if the propulsion unit is in idle speed, the vehicle is at a standstill and there is no driver torque request. Especially the drive-off element torque depends on the targeted state of power transmission of the gearbox, which is determined primarily by the gear lever position. b) the absolute value of the transmission oil pump torque losses, if the drive-off element is closed. c) a combination of a) and b) depending on the propulsion unit speed, vehicle speed and gearbox control strategy in all other situations. In this case, this signal might even be greater than the torque value of a) because the propulsion unit speed is greater than the idle speed. But the combination is limited by a powertrain torque limit. If the torque at clutch is greater than this limit, then this signal is less than the real/physical torque at clutch. A typical behavior is that the summated torque a) at vehicle standstill is ramped to the transmission oil pump torque b). The ramp depends on the vehicle speed and reaches b) at low vehicle speeds, e.g., 7km/h. The transition from idle speed to driving usually is completed at this velocity. Data format for typical network representation for series projects: Uint12 Unit: Nm Type: linear Resolution: 1 Offset: -2048 Physically used range: Hex Lower/Upper Limit: 0h / FFDh Physical Lower/Upper Limit: -2048 / 2045 Special values outside the physically used range: FFEh = Init FFFh = Error, Signal content invalid Cycle Time: 10 ms (max.) for internal calculation and bus communication. Typical Provider: Transmission Typical Receiver: Powertrain
    TrsmTqCluGrdtUpprLimReq: interface=TrsmTqCluGrdtUpprLimReq1  # Transmission: Clutch Torque Gradient Upper Limit Requested by Transmission | Transmission request to limit the clutch torque gradient if changes in the real and virtual driver requests could cause the clutch torque gradient to be greater than the specified limit. | Transmission request to limit the clutch torque gradient if changes in the real and virtual driver requests could cause the clutch torque gradient to be greater than the specified limit. Other requests such as engine internal stall protection and idle speed control or other external interventions, are not permitted to be limited. This signal offers the following benefit in comparison to the transmission torque requests: The effect of the signal must be visible on signals "Powertrain: Torque at Clutch", "Powertrain: Torque at Clutch without Transmission Intervention", "Powertrain: Requested Torque at Clutch without Transmission Intervention", “Powertrain: Predicted Driver Request of Torque at Clutch in Target Speed”. As a default value, or if there is no request from the transmission, the passive value (FEh) is sent. The target is to implement this gradient limitation as fast as possible by fast and slow request. For “Mild Hybrids” and “Full Hybrids” (Parallel Hybrids), the transmission transmits the “gradient of the summarized torque request of combustion engine and electric machine”. For “Full Hybrids” (Parallel Hybrids), the torque transmitted by the engine clutch must be considered. References to other signals: PtTqClu PtTqCluWoTrsmIntv PtTqCluReqWoTrsmIntv PtDrvrReqTqCluPredEngN Data format for typical network representation for series projects: Uint8 Unit: Nm/ s Type: linear Resolution: 50 Offset: 0 Physically used range: Hex Lower/Upper Limit: 0h / FDh Physical Lower/Upper Limit: 0 / 12650 Special values outside the physically used range: FEh = Init FFh = Error, Signal content invalid Cycle Time: 10 ms (max.) for internal calculation and bus communication. Typical Provider: Transmission Typical Receiver: Powertrain homogenous transition without torque jumps, preventive protection without unintended effects on driving behavior, improvement of dynamics in comparison to limitation by the transmission torque requests.
    TrsmTqCluLoss: interface=TrsmTqCluLoss1  # Transmission: Transmission Torque Losses at Clutch | Transmission torque losses at clutch. | The transmission torque losses include the torque of the gearbox oil pump and gearbox internal losses, e.g., bearing friction and drag torque losses of clutches. Torque losses occurring at a shaft with a speed different from the clutch speed must be converted to clutch speed considering the relevant transmission ratio. Typically, the values are from test bench measurements. These losses are usually considered when converting engine to wheel torque and vice versa. In projects in which the differential and transfer case and/or reduction gearbox are integrated in the transmission housing, the signal also considers the losses of these components. The value sent on the network is the absolute value of the transmission torque losses. The value on the application level must consider the sign. The Application Data Type must cover negative values. Data format for typical network representation for series projects: Uint8 Unit: Nm Type: linear Resolution: 1 Offset: -253 Physically used range: Hex Lower/Upper Limit: 0h / FDh Physical Lower/Upper Limit: -253 / 0 Special values outside the physically used range: FEh = Init FFh = Error, Signal content invalid Cycle Time: 10 ms (max.) for internal calculation and bus communication. Typical Provider: Transmission Typical Receiver: Powertrain
    TrsmTqCluMaxFastReqForShiftIntv: interface=TrsmTqCluMaxFastReqForShiftIntv1  # Transmission: Request for Maximum Torque at Clutch for Shift Intervention on Fast Path | Maximum torque at clutch requested by transmission for shift intervention on fast path. | Usually used for shift intervention, but permitted for all purposes. As long as there is no torque request from the transmission, a constant substitute value (“no request”) or the maximum value is transmitted on the signal. In parallel hybrid projects, the transmission transmits the summarized torque request of the combustion engine and the electric machine. This signal is defined for an absolute intervention. The interface for relative interventions to the reference "Powertrain: Torque at Clutch without Transmission Intervention" must be defined separately. References to other signals: PtTqCluWoTrsmIntv Data format for typical network representation for series projects: Uint12 Unit: Nm Type: linear Resolution: 1 Offset: -2048 Physically used range: Hex Lower/Upper Limit: 0h / FFDh Physical Lower/Upper Limit: -2048 / 2045 Special values outside the physically used range: FFEh = Init FFFh = Error, Signal content invalid Cycle Time: 10 ms (max.) for internal calculation and bus communication. Typical Provider: Transmission Typical Receiver: Powertrain Example for “Transmission Requirement for Response” in a typical series project: The following image illustrates the respective accuracy requirements: The image “Detailed signal content of Torque at Clutch Signals” shows the effects of functionalities on the torque at clutch signals. Example: “Soot limitation” is marked with an “X” to indicate that it is considered in the signal.
    TrsmTqCluMaxProtnReq: interface=TrsmTqCluMaxProtnReq1  # Transmission: Maximum Torque at Clutch Requested by Transmission for Gearbox Protection | Maximum torque limitation for gearbox protection. | A torque decrease in the engine is performed via fast path and slow path. The engine limits the value of the torque at clutch as defined in the signal "Powertrain: Torque at Clutch", so the effects of dynamic torque are not considered. The lower limit to be considered by the engine depends on the torque necessary for the engine internal stall protection. The global target is to prevent damage to gearbox and drivetrain, e.g. caused by mechanical and thermal overload. The indicated torque must be calculated based on this signal, without consideration of the torque influence of inertia. Although this signal is a transmission intervention, the effect must also be visible on all signals with the suffix "...without Intervention". The calculation of this signal by the provider is not permitted to consider the inertia, which has an effect on the torque at clutch. This means that the signal must be calculated as if the inertia is 0 kg*(m^2). References to other signals: PtTqClu Data format for typical network representation for series projects: Uint12 Unit: Nm Type: linear Resolution: 1 Offset: -2048 Physically used range: Hex Lower/Upper Limit: 0h / FFDh Physical Lower/Upper Limit: -2048 / 2045 Special values outside the physically used range: FFEh = Init FFFh = Error, Signal content invalid Cycle Time: 10 ms (max.) for internal calculation and bus communication. Typical Provider: Transmission Typical Receiver: Powertrain Example for “Transmission Requirement for Response” in a typical series project: [[Image: Images\Transmission_Requirement_for_Response_to_TrsmTqCluMaxProtn_Gearbox_Protection.jpg]
    TrsmTqCluMaxSlowReqForShiftIntv: interface=TrsmTqCluMaxSlowReqForShiftIntv1  # Transmission: Request for Maximum Torque at Clutch for Shift Intervention on Slow Path | Maximum torque at clutch requested by transmission for shift intervention on slow path. | Usually used for shift intervention, but permitted for all purposes. As long as there is no torque request from the transmission, a constant substitute value (“no request”) or the maximum value is transmitted on the signal. In parallel hybrid projects, the transmission transmits the summarized torque request of the combustion engine and the electric machine. This signal is defined for an absolute intervention. The interface for relative interventions to the reference "Powertrain: Torque at Clutch without Transmission Intervention" must be defined separately. References to other signals: PtTqCluWoTrsmIntv Data format for typical network representation for series projects: Uint12 Unit: Nm Type: linear Resolution: 1 Offset: -2048 Physically used range: Hex Lower/Upper Limit: 0h / FFDh Physical Lower/Upper Limit: -2048 / 2045 Special values outside the physically used range: FFEh = Init FFFh = Error, Signal content invalid Cycle Time: 10 ms (max.) for internal calculation and bus communication. Typical Provider: Transmission Typical Receiver: Powertrain The image “Detailed signal content of Torque at Clutch Signals” shows the effects of this signal on the torque at clutch signals.
    TrsmTqCluMinFastReqForShiftIntv: interface=TrsmTqCluMinFastReqForShiftIntv1  # Transmission: Request for Minimum Torque at Clutch for Shift Intervention on Fast Path | Minimum torque at clutch requested by transmission for shift intervention on fast path. | Usually used for shift intervention, but permitted for all purposes. As long as there is no torque request from the transmission, a constant substitute value (“no request”) or the minimum value is transmitted on the signal. In parallel hybrid projects, the transmission transmits the summarized torque request of the combustion engine and the electric machine. This signal is defined for an absolute intervention. The interface for relative interventions to the reference "Powertrain: Torque at Clutch without Transmission Intervention" must be defined separately. References to other signals: PtTqCluWoTrsmIntv Data format for typical network representation for series projects: Uint12 Unit: Nm Type: linear Resolution: 1 Offset: -2048 Physically used range: Hex Lower/Upper Limit: 0h / FFDh Physical Lower/Upper Limit: -2048 / 2045 Special values outside the physically used range: FFEh = Init FFFh = Error, Signal content invalid Cycle Time: 10 ms (max.) for internal calculation and bus communication. Typical Provider: Transmission Typical Receiver: Powertrain Example for “Transmission Requirement for Response” in a typical series project: The image “Detailed signal content of Torque at Clutch Signals” shows the effects of this signal on the torque at clutch signals.
    TrsmTqCluMinProtnReq: interface=TrsmTqCluMinProtnReq1  # Transmission: Minimum Torque at Clutch Requested by Transmission for Gearbox Protection | Minimum torque limitation for gearbox protection. | The global target is to prevent damage to gearbox and drivetrain, e.g. caused by mechanical and thermal overload. The signal ensures that the gearbox is not loaded with very low negative torque at clutch. Signal is relevant for projects with an electric machine. The implementation of the gearbox request is limited by the driving motors: For efficiency and safety reasons, the minimum torque for gearbox protection is not permitted to lead to a positive indicated or inner torque on any of the driving motors. The limitation must be implemented only by affecting the negative torque of the electric machine. The effects of dynamic torque are not considered. Although this signal is a transmission intervention, the effect must also be visible on all signals with the suffix "...without Transmission Intervention". Data format for typical network representation for series projects: Uint12 Unit: Nm Type: linear Resolution: 1 Offset: -2048 Physically used range: Hex Lower/Upper Limit: 0h / FFDh Physical Lower/Upper Limit: -2048 / 2045 Special values outside the physically used range: FFEh = Init FFFh = Error, Signal content invalid Cycle Time: 10 ms (max.) for internal calculation and bus communication. Typical Provider: Transmission Typical Receiver: Powertrain
    TrsmTqCluMinSlowReqForShiftIntv: interface=TrsmTqCluMinSlowReqForShiftIntv1  # Transmission: Request for Minimum Torque at Clutch for Shift Intervention on Slow Path | Minimum torque at clutch requested by transmission for shift intervention on slow path. | Usually used for shift intervention, but permitted for all purposes. As long as there is no torque request from the transmission, a constant substitute value (“no request”) or the minimum value is transmitted on the signal. In parallel hybrid projects, the transmission transmits the summarized torque request of the combustion engine and the electric machine. This signal is defined for an absolute intervention. The interface for relative interventions to the reference "Powertrain: Torque at Clutch without Transmission Intervention" must be defined separately. References to other signals: PtTqCluWoTrsmIntv Data format for typical network representation for series projects: Uint12 Unit: Nm Type: linear Resolution: 1 Offset: -2048 Physically used range: Hex Lower/Upper Limit: 0h / FFDh Physical Lower/Upper Limit: -2048 / 2045 Special values outside the physically used range: FFEh = Init FFFh = Error, Signal content invalid Cycle Time: 10 ms (max.) for internal calculation and bus communication. Typical Provider: Transmission Typical Receiver: Powertrain The image “Detailed signal content of Torque at Clutch Signals” shows the effects of this signal on the torque at clutch signals.
    TrsmTqCluReqForShiftIntv: interface=TrsmTqCluReqForShiftIntv1  # Transmission: Request for Torque at Clutch for Shift Intervention | Torque at clutch requested by transmission for shift intervention. | This signal is closely related to the signals for "implementation type" and “intervention mode” of request: “Transmission: Implementation Type of Request for Torque at Clutch for Shift Intervention”, “Transmission: Intervention Mode Request for Torque at Clutch for Shift Intervention”. Usually used for shift interventions, but permitted for all purposes. As long as there is no torque request, the signal "Transmission: Implementation Type of Request for Torque at Clutch for Shift Intervention", is “0h = no request” and signal “Transmission: Request for Torque at Clutch for Shift Intervention” is “FFEh = Init”. In parallel hybrid projects, the transmission transmits the summarized torque request of the combustion engine and the electric machine. References to other signals: TrsmNrTypOfTqCluReqForShiftIntv TrsmIntvModReqForTqCluReqForShiftIntv Data format for typical network representation for series projects: Uint12 Unit: Nm Type: linear Resolution: 1 Offset: -2048 Physically used range: Hex Lower/Upper Limit: 0h / FFDh Physical Lower/Upper Limit: -2048 / 2045 Special values outside the physically used range: FFEh = Init FFFh = Error, Signal content invalid Cycle Time: 10 ms (max.) for internal calculation and bus communication. Typical Provider: Transmission Typical Receiver: Powertrain Example for “Transmission Requirement for Response” in a typical series project, one figure for “torque decrease request” and one figure for “torque increase request”: The image “Detailed signal content of Torque at Clutch Signals” shows the effects of this signal on the torque at clutch signals.
    TrsmTqCluResvReq: interface=TrsmTqCluResvReq1  # Transmission: Request for Torque Reserve at Clutch | Request to increase torque on slow path without affecting torque at clutch. Reference for increase is defined by the corresponding status signal. | This signal is closely related to "Transmission: Implementation Type of Request for Torque Reserve at Clutch". The engine must compensate for the increased air mass by ignition retard and/or injection cutoff. The engine is not permitted to increase the air mass more than can be compensated for. This prevents unintended acceleration of the car. This torque reserve prepares the engine to implement torque increase requests as quickly as it is required. References to other signals: TrsmNrTypOfTqCluResvReq Data format for typical network representation for series projects: Uint12 Unit: Nm Type: linear Resolution: 1 Offset: -2048 Physically used range: Hex Lower/Upper Limit: 0h / FFDh Physical Lower/Upper Limit: -2048 / 2045 Special values outside the physically used range: FFEh = Init FFFh = Error, Signal content invalid Cycle Time: 10 ms (max.) for internal calculation and bus communication. Typical Provider: Transmission Typical Receiver: Powertrain Two examples for the consideration of the “torque reserve” in a typical series project:
    TrsmTqCluStandStillPred: interface=TrsmTqCluStandStillPred1  # Transmission: Predicted Transmission Torque at Clutch in Standstill | Predicted transmission torque at clutch in vehicle motion state “Standstill”. | Predicted value of torque at clutch consumed by the transmission in standstill. It includes the torque losses caused by the transmission oil pump and the slipping drive-off element such as converter and drive-off clutch. It is calculated continuously, depending on the gear lever position and the targeted state of power transmission. The transmission calculates this signal by using the engine speed setpoint. The signal is to be used as a prediction in the idle speed controller at vehicle standstill. Data format for typical network representation for series projects: Uint12 Unit: Nm Type: linear Resolution: 1 Offset: -2048 Physically used range: Hex Lower/Upper Limit: 0h / FFDh Physical Lower/Upper Limit: -2048 / 2045 Special values outside the physically used range: FFEh = Init FFFh = Error, Signal content invalid Cycle Time: 10 ms (max.) for internal calculation and bus communication. Typical Provider: Transmission Typical Receiver: Powertrain
    TrsmTqDftlAxleFrntAct: interface=TrsmTqDftlAxleFrntAct1  # Transmission: Actual Differential Torque at Front Axle | Actual theoretical maximum transfer torque at the differential on the front axle as realised by the actuator. | Sign convention: Positive to the right or front.
    TrsmTqDftlAxleFrntConsold: interface=TrsmTqDftlAxleFrntConsold1  # Transmission: Consolidated Differential Torque at Front Axle | Actual theoretical maximum transfer torque at the differential on the front axle as realised by the actuator. | Sign convention: Positive to the right or front.
    TrsmTqDftlAxleFrntMax: interface=TrsmTqDftlAxleFrntMax1  # Transmission: Maximum Differential Torque at Front Axle | Absolute value of the maximum torque at the differential on the front axle. | Sign convention: Positive to the right or front or from faster to slower shaft depending on the available device.
    TrsmTqDftlAxleReAct: interface=TrsmTqDftlAxleReAct1  # Transmission: Actual Differential Torque at Rear Axle | Actual theoretical maximum transfer torque at the differential at the rear axle as realised by the actuator. | Sign convention: Positive to the right or front or from faster to slower shaft depending on the available device.
    TrsmTqDftlAxleReConsold: interface=TrsmTqDftlAxleReConsold1  # Transmission: Consolidated Differential Torque at Rear Axle | Actual theoretical maximum transfer torque at the differential at the rear axle as realised by the actuator. | Sign convention: Positive to the right or front or from faster to slower shaft depending on the available device.
    TrsmTqDftlAxleReMax: interface=TrsmTqDftlAxleReMax1  # Transmission: Maximum Differential Torque at Rear Axle | Absolute value of the maximum torque at the differential at the rear axle | Sign convention: Positive to the right or front or from faster to slower shaft depending on the available device.
    TrsmTqDftlTrfAct: interface=TrsmTqDftlTrfAct1  # Transmission: Actual Differential Transfer Torque | Actual theoretical maximum transfer torque at the differential as realised by the actuator. | Sign convention: Positive to the right or front or from faster to slower shaft depending on the available device.
    TrsmTqDftlTrfConsold: interface=TrsmTqDftlTrfConsold1  # Transmission: Consolidated Differential Transfer Torque | Actual theoretical maximum transfer torque at the differential as realised by the actuator. | Sign convention: Positive to the right or front or from faster to slower shaft depending on the available device.
    TrsmTqDftlTrfMax: interface=TrsmTqDftlTrfMax1  # Transmission: Maximum Differential Transfer Torque | Absolute value of the maximum torque at the Transfer Case Differential | Sign convention: Positive to the right or front or from faster to slower shaft depending on the available device.
    TrsmTqOilPmp: interface=TrsmTqOilPmp1  # Transmission: Transmission Oil Pump Load | Transmission oil pump load at clutch level. | The torque consumption of the transmission oil pump especially depends on the gearbox temperature, rotational speed and system pressure of the transmission hydraulic system. Typically, the values are from test bench measurements. Used to distinguish between gearbox core losses and gearbox oil pump torque losses, which can only be measured together. The signal can be used by the propulsion unit to calculate torque at clutch with higher precision, especially for transmissions with a permanently connected transmission oil pump. If the pump is an electric oil pump, then the value should be zero Nm, because the load is included in the alternator load. The value of this signal is converted to clutch torque by the provider. The value sent on the network is the absolute value of the transmission torque losses. The value on the application level must consider the sign. The Application Data Type must cover negative values. Data format for typical network representation for series projects: Uint8 Unit: Nm Type: linear Resolution: 1 Offset: -253 Physically used range: Hex Lower/Upper Limit: 0h / FDh Physical Lower/Upper Limit: -253 / 0 Special values outside the physically used range: FEh = Init FFh = Error, Signal content invalid Cycle Time: 10 ms (max.) for internal calculation and bus communication. Typical Provider: Transmission Typical Receiver: Powertrain
    TrsmTqWhlIndDistbn: interface=TrsmTqWhlIndDistbn1  # Individual Torque at Wheel Distribution as Realized by Transmission System | Individual Torque at Wheel Distribution as realized by Transmission System. Vector of 4 signals. The DTD (drivetrain torque distribution) component in the transmission system realizes the torque distribution request and powertrain coordinator sends the coordinated actual wheel torques as feedback to the chassis. This interface only considers the torque which can be distributed from one or more central torque producers to the wheels by the transmission system. It does not consider additional torque producers located e.g. at the individual wheels. Where no torque is distributed to the wheels by the transmission system (e.g. one axle not driven or directly driven by an electric machine), the respective values are zero. | In case of actor/sensor failures or if there is no possibility to determine the correct distribution an rough estimation is done. Additionally a qualifier has to be set, to inform about invalid or backup values.
    VehBodyAVertEstimd: interface=VehBodyAVert1  # Vehicle Body Acceleration Vertical Estimated | Vector of estimated vehicle vertical body accelerations. Vector of 4 scalars in the order front left, front right, rear left, rear right. Refer to ISO 8855. Location could differ depending on the number of sensors (2,3,4).
    VehBodyAVertMeasd: interface=VehBodyAVert1  # Vehicle Body Acceleration Vertical Measured | Vector of measured vehicle's vertical body accelerations. Vector of 4 scalars in the order front left, front right, rear left, rear right. Refer to ISO 8855. Location of the sensors could differ depending on the number of sensors (2,3,4) (Filtered and offset compensated).
    VehBodyAVertMeasdBas: interface=VehBodyAVert1  # Vehicle Body Acceleration Vertical Measured Base | Vector of measured vehicle's vertical body accelerations. Vector of 4 scalars in the order front left, front right, rear left, rear right. Refer to ISO 8855. Location of the sensors could differ depending on the number of sensors (2,3,4).
    VehBodyAVertMeasdRaw: interface=VehBodyAVert1  # Vehicle Body Acceleration Vertical Measured Raw | Vector of measured vehicle's vertical body accelerations. Vector of 4 scalars in the order front left, front right, rear left, rear right. Refer to ISO 8855. Location of the sensors could differ depending on the number of sensors (2,3,4).
    VehBodyAVertMeasdStd: interface=VehBodyAVert1  # Vehicle Body Acceleration Vertical Measured Standard | Vector of measured vehicle's vertical body accelerations. Vector of 4 scalars in the order front left, front right, rear left, rear right. Refer to ISO 8855. Location of the sensors could differ depending on the number of sensors (2,3,4) (Filtered and offset compensated).
    VehBrkTqApplyReq: interface=VehBrkTqApplyReq1  # Vehicle Brake Torque Apply Request | Request from Vehicle Longitudinal Control to Electronic Stability Control to apply a desired vehicle global brake torque. | Belongs to VehBrkTqReq.
    VehBrkTqGrdtReqToEpb: interface=VehBrkTqGrdtReq1  # Vehicle Brake Torque Gradient Request to EPB | Time derivative of the requested total vehicle brake torque from Stand Still Manager (SSM) to Electric Parking Brake (EPB).
    VehBrkTqGrdtReqToEsc: interface=VehBrkTqGrdtReq1  # Vehicle Brake Torque Gradient Request to ESC | Time Derivative of the requested total vehicle brake torque from Stand Still Manager (SSM) to Electronic Stability Control (ESC)
    VehBrkTqIntd: interface=VehBrkTqIntd1  # Vehicle Brake Torque Intended | Sum of 4 wheel intended brake torques. Result of arbitration between driver and other chassis functions.
    VehBrkTqReq: interface=VehBrkTqReq1  # Vehicle Brake Torque Request | Requested longitudinal total vehicle brake torque regarding Vehicle Longitudinal Control.
    VehBrkTqReqToEpb: interface=VehBrkTqReq1  # Vehicle Brake Torque Request to EPB | Requested longitudinal total vehicle brake torque regarding Electric Parking Brake.
    VehBrkTqReqToEsc: interface=VehBrkTqReq1  # Vehicle Brake Torque Request to ESC | Requested longitudinal total vehicle brake torque regarding hydraulic brake.
    VehCourseCrvtCorrd: interface=VehCourseCrvtCorrd1  # Vehicle Course Curvature Corrected | Curvature of predicted vehicle course which is calculated from vehicle information and environmental information.
    VehCourseCrvtPred: interface=VehCourseCrvtPred1  # Vehicle Course Curvature Predicted | Curvature of predicted vehicle course which is calculated with vehicle speed and yaw rate.
    VehCrashPitchovrDetd: interface=VehPitchovrMod1  # Vehicle Pitchover Crash Detected | Pitchover event detected
    VehCrashRollovrDetd: interface=VehRollovrMod1  # Vehicle Rollover Crash Detected | Rollover event detected
    VehCrashSevCalcdAtFrnt: interface=CrashSev1  # Vehicle Crash Severity Calculated at Front | Calculated crash severity of vehicle to vehicle or vehicle to object front impacts - used to protect occupants
    VehCrashSevCalcdAtLe: interface=CrashSev1  # Vehicle Crash Severity Calculated at Left | Calculated crash severity of vehicle to vehicle or vehicle to object left side impacts - used to protect occupants
    VehCrashSevCalcdAtRe: interface=CrashSev1  # Vehicle Crash Severity Calculated at Rear | Calculated crash severity of vehicle to vehicle or vehicle to object rear impacts - used to protect occupants
    VehCrashSevCalcdAtRi: interface=CrashSev1  # Vehicle Crash Severity Calculated at Right | Calculated crash severity of vehicle to vehicle or vehicle to object right side impacts - used to protect occupants
    VehDetdByFolwCtrl: interface=VehDetdByFolwCtrl1  # Vehicle Detected by Follow Control | Target vehicle for Follow Control in Adaptive Cruise Control is detected. This information is used as input to Adaptive Cruise Control state machine.
    VehHldReq: interface=VehHldReq1  # Vehicle Hold Request | Vehicle hold request from Vehicle Longitudinal Control (VLC) to Stand Still Manager (SSM).
    VehHldSt: interface=VehHldSt1  # Vehicle Hold Status | Status of Stand Still Manager (SSM) to Vehicle Longitudinal Control (VLC) that indicates whether a vehicle is held or not.
    VehHldSts: interface=VehHldSts1  # Vehicle Hold Status | Status of Stand Still Manager (SSM) to Vehicle Longitudinal Control (VLC) that indicates whether a vehicle is held or not.
    VehMEstimdFromSusp: interface=VehMEstimd1  # Vehicle Mass Estimated from Suspension | Estimation of the vehicle mass provided by the suspension systems.
    VehMEstimdFromSusp1: interface=VehM1  # Vehicle Mass Estimated from Suspension | Estimation of the vehicle mass provided by the suspension systems.
    VehMEstimdFromVlc: interface=VehMEstimd1  # Vehicle Mass Estimated from Vehicle Longitudinal Control (VLC) | Estimation of the vehicle mass provided by the Vehicle Longitudinal Control (VLC) based on the longitudinal dynamics of the vehicle.
    VehMEstimdFromVlc1: interface=VehM1  # Vehicle Mass Estimated from Vehicle Longitudinal Control (VLC) | Estimation of the vehicle mass provided by the Vehicle Longitudinal Control (VLC) based on the longitudinal dynamics of the vehicle.
    VehModSt: interface=VehMod1  # Vehicle Mode Status | Information related to the multiple states of the vehicle such as the factory mode, the show room mode, the customer mode.
    VehModSts: interface=VehMod1  # Vehicle Mode Status | Information related to the multiple states of the vehicle such as the factory mode, the show room mode, the customer mode.
    VehMtnSt: interface=VehMtnSt1  # Vehicle Motion State | Vehicle motion state whether vehicle is moving forward, backward or it is in standstill.
    VehSpdDispd: interface=VehSpdDispd1  # Vehicle Speed Displayed | Vehicle speed shown on speedometer.
    VehSpdLgt: interface=VehSpdLgt1  # Vehicle Speed Longitudinal | Vehicle longitudinal speed based on individual wheel speeds, possibly extended by acceleration sensor. Coordinate system according to ISO 8855. The vehicle speed refers to Center Of Gravity (COG). | During brake intervention the accuracy of vehicle speed may be reduced, e.g. for the measured value only 2 wheel speed sensors are used as the other ones are locked.
    VehStOper: interface=OperModSt1  # Vehicle Operating State | Vehicle operation state. | It can be seen as an abstraction and extension of the normal ignition switch position (also called "clamp position") which is traditionally used to guide functional operation of the vehicle. It also includes information about what state the engine is in, i.e. running or not. This signal should be used to control which functionalities / components are active in the vehicle. All states have to be implemented in all cars, but not necessarily used.
    VehTqWhlMaxSftyLimn: interface=VehTqWhlMaxSftyLimn1  # Safety Torque Limit Calculated from the Vehicle's Maximum Speed | Torque limit calculated from the vehicle's maximum speed limit. This speed limit is not the "comfort" speed limit; it is the safety or vehicle protection limit, not normally selectable by the driver.
    VehVLgt: interface=VehSpdLgt1  # Vehicle Speed (Longitudinal) | Consolidated Vehicle Speed (Longitudinal). For example based on wheel speeds, possibly extended by acceleration sensor. | Coordinate system according to ISO 8855. Refers to Center of Gravity (COG).
    VlcA: interface=ALgt2  # Vehicle Longitudinal Control Acceleration | Actual vehicle acceleration realized either by acceleration control or by driver override which is used as reference for vehicle longitudinal control.
    VlcReqOvrdnByDrvrReq: interface=PtFlgDrvOvrdVlc1  # Vehicle Longitudinal Control (VLC) Request Overridden by Driver Request | Flag is set to 1 if driver request overrides Vehicle Longitudinal Control (VLC), otherwise the flag is set to 0
    VlcStShiftPrevnCmft: interface=GearShiftPrevn1  # Vehicle Longitudinal Control (VLC): State of Shift Prevention for Comfort Reasons | Avoid change of gear for comfort reasons: request to avoid shifting request includes aspects from traffic point of view. Final decision remains in the actuator control. Acceleration request tolerance band has higher priority than the gear shift prevention comfort.
    VlcTqWhlPtMax: interface=PtTqTotAtWhls1  # Maximum Torque at Wheel by Vehicle Longitudinal Control (VLC) | Requested wheel torque (to all the driven wheels) after coordination among several vehicle longitudinal control systems (e.g. cruise control, adaptive cruise control, collision mitigation) to be generated by the powertrain. This is the maximum torque to be delivered by the powertrain, e.g. a torque limit request [absolute] (vehicle speed limitation). If the maximum request is less than the minimum request the priority is the Maximum Request (which in the case is the lower value!). If no request is active, the value of this interface will be the upper limit of the chosen data type. | Must be initialised to the upper limit of the chosen data type.
    VlcTqWhlPtMin: interface=PtTqTotAtWhls1  # Minimum Torque at Wheel by Vehicle Longitudinal Control (VLC) | Requested wheel torque (to all the driven wheels) after coordination among several vehicle longitudinal control systems (e.g. cruise control, adaptive cruise control, collision mitigation) to be generated by the powertrain. This is the minimum torque to be delivered by the powertrain, e.g. a torque request [absolute] for CC/ACC (Cruise Control, Adaptive Cruise Control). If the maximum request is less than the minimum request the priority must be clearly defined. If no request is active, the value of this interface will be the lower limit of the chosen data type. | Must be initialised to the lower limit of the chosen data type.
    WhlAAgrMeasd: interface=WhlAAgr1  # Wheel Acceleration Angular Measured | Angular acceleration of the four individual wheels.
    WhlAAgrStd: interface=WhlAAgr1  # Wheel Acceleration Angular Standard | Angular acceleration of the four individual wheels.
    WhlAVertBas: interface=WhlAVert1  # Wheel Acceleration Vertical Base | Measured vehicle vertical wheel accelerations
    WhlAVertEstimd: interface=WhlAVert1  # Wheel Acceleration Vertical Estimated | Estimated vehicle vertical wheel acceleration
    WhlAVertMeasd: interface=WhlAVert1  # Wheel Acceleration Vertical Measured | Measured vehicle vertical wheel accelerations. Refer to ISO 8855.
    WhlAVertRaw: interface=WhlAVert1  # Wheel Acceleration Vertical Raw | Measured vehicle vertical wheel accelerations
    WhlAVertStd: interface=WhlAVert1  # Wheel Acceleration Vertical Standard | Calculated vehicle vertical wheel accelerations. Refer to ISO 8855.
    WhlBrkOvrheatd: interface=WhlBrkOvrheatd1  # Wheel Brake Overheated | Wheel brake overheating Indication that at least one wheel brake (caliper, disc, pad) temperature is high.
    WhlBrkSlipMaxReqByRsc: interface=WhlBrkSlip1  # Wheel Brake Slip Maximum Request by RSC | Requested maximum wheel brake slip from Roll Stability Control (RSC) to Electronic Stability Control (ESC) for individual wheels. Antilock Braking System (ABS) is expected to limit the wheel slips to these maximum values.
    WhlBrkTq: interface=WhlBrkTq1  # Wheel Brake Torque | Brake torques acting on the wheels. Parking brake torque not included. | Based on nominal brake parameters (constant pads friction) and (estimated or measured) brake pressures (clamp forces).
    WhlBrkTqApplyReqByRsc: interface=WhlBrkTqApplyReq1  # Wheel Brake Torque Apply Request by RSC | Request from Roll Stability Control to Electronic Stability Control to apply a desired vehicle wheel brake torque. | Belongs to WhlBrkTqReqByRsc.
    WhlBrkTqReqByRsc: interface=WhlBrkTq1  # Wheel Brake Torque Request by RSC | Requested brake torques from Roll Stability Control to be acting on the wheels. Absolute values requested. | Based on nominal brake parameters (constant pads friction) and (estimated or measured) brake pressures (clamp forces).
    WhlDirRotlMeasd: interface=WhlDirRotl1  # Wheel Direction Rotational Measured | Vector of 4 scalars assigned to the individual wheels in the order front left, front right, rear left, rear right. Each scalar indicates if the wheel is moving ahead or in reverse.
    WhlDirRotlStd: interface=WhlDirRotl1  # Wheel Direction Rotational Standard | Vector of 4 scalars assigned to the individual wheels in the order front left, front right, rear left, rear right. Each scalar indicates if the wheel is moving ahead or in reverse.
    WhlFVertEstimd: interface=WhlFVert1  # Wheel Force Vertical Estimated | Estimation of the actual vertical wheel forces provided by the suspension systems.
    WhlLoadDifEstimdFrnt: interface=WhlLoadDif1  # Wheel Load Difference Estimated Front | Estimated wheel load difference on the front axle defined as the total front axle load applied to the left wheel (100%: Total axle load on left wheel, 0%: Total axle load on right wheel)
    WhlLoadDifEstimdRe: interface=WhlLoadDif1  # Wheel Load Difference Estimated Rear | Estimated wheel load difference on the rear axle defined as the total rear axle load applied to the left wheel (100%: Total axle load on left wheel, 0%: Total axle load on right wheel)
    WhlRdTolrCoeff: interface=WhlRdTolrCoeff1  # Wheel Radius Tolerance Coefficient | Vector of 4 estimated scalars assigned to the individual wheels in the order front left, front right, rear left, rear right. The product of each scalar with its corresponding circumferential wheel speed allows getting a better estimation of the linear velocity of the contact patch of the wheel over ground. These scalars do not compensate for the possible wheel slip.
    WhlSpdCircumlMeasd: interface=WhlSpdCircuml1  # Wheel Speed Circumferential Measured | Vector of 4 scalars in the order front left, front right, rear left, rear right. These scalars are the product of the individual angular velocities with the nominal (or static) rolling radius. The nominal (or static) rolling radius is representative of each vehicle, and is a value which is very close to the longitudinal speed of the vehicle. If signal is not provided (optional) the radius must be available as a parameter.
    WhlSpdCircumlStd: interface=WhlSpdCircuml1  # Wheel Speed Circumferential Standard | Vector of 4 scalars in the order front left, front right, rear left, rear right. These scalars are the product of the individual angular velocities with the nominal (or static) rolling radius. The nominal (or static) rolling radius is representative of each vehicle, and is a value which is very close to the longitudinal speed of the vehicle. If signal is not provided (optional) the radius must be available as a parameter.
    WhlSpdWarnIndcn: interface=WhlSpdWarnIndcn1  # Wheel Speed Warning Indication | Warning indication, that the maximum speed allowed for the configured tires and/or actual pressure has been exceeded.
    WhlSteerReBascSt: interface=SteerSt1  # Wheel Steering Rear Basic Status | Status of Basic Rear Wheel Steering.
    WhlSteerReBascSts: interface=SteerSts1  # Wheel Steering Rear Basic Status | Status of Basic Rear Wheel Steering.
    WhlVAgrMeasd: interface=WhlVAgr1  # Wheel Velocity Angular Measured | Measured Angular velocity of individual wheels in the order front left, front right, rear left, rear right.
    WhlVAgrRaw: interface=WhlVAgrRaw1  # Wheel Velocity Angular Raw | Set of raw values of wheel speed sensors of individual wheels.
    WhlVAgrStd: interface=WhlVAgr1  # Wheel Velocity Angular Standard | Standard Angular velocity of individual wheels in the order front left, front right, rear left, rear right.
    WinHeatrSt: interface=WinHeatrSt1  # Window Heater Status | Activation status of window heater
    WinHeatrSts: interface=WinHeatrSts1  # Window Heater Status | Activation status of window heater
    WipgAutFrntReq: interface=WipgAutReq1  # Wiping Automatic Front Request | Request to activate/deactivate the automatic mode for the front wiping
    WipgCmd: interface=WinWipgCmd1  # Wiping Command | Rear: Activates rear wiping. Also used to move wiper to park position outside the window area for opening rear lid windows. Front: Sets speed and interval of front wiper. Sets several positions (e.g. service, park, winter).
    WipgCmdForWiprFrnt: interface=WinWipgCmd1  # Command for Wiper | Rear: Activates rear wiping. Also used to move wiper to park position outside the window area for opening rear lid windows. Front: Sets speed and interval of front wiper. Sets several positions (e.g. service, park, winter).
    WipgCmdForWiprRe: interface=WinWipgCmd1  # Command for Wiper | Rear: Activates rear wiping. Also used to move wiper to park position outside the window area for opening rear lid windows. Front: Sets speed and interval of front wiper. Sets several positions (e.g. service, park, winter).
    WipgDiFrnt: interface=WiprWshrDiReq1  # Wiping Disable Front | Request to enable or disable the front wiping
    WipgDiRe: interface=WiprWshrDiReq1  # Wiping Disable Rear | Request to enable or disable the rear wiping
    WipgFrntFromHmi: interface=WipgReq1  # Wiping Front from HMI | Represents user's demand to activate / deactivate front wiping. This demand is given by the Human Machine Interface (HMI) of the vehicle.
    WipgReFromHmi: interface=WipgReq1  # Wiping Rear from HMI | Represents user's demand to activate / deactivate rear wiping. This demand is given by the Human Machine Interface (HMI) of the vehicle.
    WipgSpdIntlFromHmi: interface=WipgSpdIntlReq1  # Wiping Speed Interval from HMI | This information precises the user's demand on the speed of front wiping. This demand is given by the Human Machine Interface (HMI) of the vehicle.
    WiprFrnt: interface=WiprSt1  # Front Wiper Status | Feedback on the status of the front wiper. It indicates whether the front wiper is active or not. This information is used to switch on the exterior light in case of bad weather conditions
    WiprPosnReqFromHmi: interface=WiprPosnCmd1  # Wiper Position Request from HMI | Request to move the wipers to reach a predefined position.
    WiprPosng: interface=WiprPosnCmd1  # Wiper Positioning | Rear: To open rear window move wiper to park position outside of the window area. Front: Sets several wiper positions, e.g. service, park, winter.
    WiprPosngForWiprFrnt: interface=WiprPosnCmd1  # Positioning for Wiper | Rear: To open rear window move wiper to park position outside of the window area. Front: Sets several wiper positions, e.g. service, park, winter.
    WiprPosngForWiprRe: interface=WiprPosnCmd1  # Positioning for Wiper | Rear: To open rear window move wiper to park position outside of the window area. Front: Sets several wiper positions, e.g. service, park, winter.
    WiprSt: interface=WiprSt1  # Wiper Status | Feedback on the status of the wiper. It indicates whether the wiper is active or not. This information is used to switch on the exterior light in case of bad weather conditions
    WiprStFrnt: interface=WiprSt1  # Front Wiper Status | Feedback on the status of the front wiper. It indicates whether the front wiper is active or not. This information is used to switch on the exterior light in case of bad weather conditions
    WiprStOfWiprFrnt: interface=WiprSt1  # Status of Wiper | Front: Feedback on the status of the front wiper. It indicates whether the front wiper is active or not. This information is used to switch on the exterior light in case of bad weather conditions. Rear: Feedback on the status of the rear wiper. It indicates whether the rear wiper is active or not. This information is used to switch on the exterior light in case of bad weather conditions.
    WiprStOfWiprRe: interface=WiprSt1  # Status of Wiper | Front: Feedback on the status of the front wiper. It indicates whether the front wiper is active or not. This information is used to switch on the exterior light in case of bad weather conditions. Rear: Feedback on the status of the rear wiper. It indicates whether the rear wiper is active or not. This information is used to switch on the exterior light in case of bad weather conditions.
    WiprSts: interface=WiprSts1  # Wiper Status | Feedback on the status of the wiper. It indicates whether the wiper is active or not. This information is used to switch on the exterior light in case of bad weather conditions
    WiprStsFrnt: interface=WiprSts1  # Front Wiper Status | Feedback on the status of the front wiper. It indicates whether the front wiper is active or not. This information is used to switch on the exterior light in case of bad weather conditions
    WiprStsOfWiprFrnt: interface=WiprSts1  # Status of Wiper | Front: Feedback on the status of the front wiper. It indicates whether the front wiper is active or not. This information is used to switch on the exterior light in case of bad weather conditions. Rear: Feedback on the status of the rear wiper. It indicates whether the rear wiper is active or not. This information is used to switch on the exterior light in case of bad weather conditions.
    WiprStsOfWiprRe: interface=WiprSts1  # Status of Wiper | Front: Feedback on the status of the front wiper. It indicates whether the front wiper is active or not. This information is used to switch on the exterior light in case of bad weather conditions. Rear: Feedback on the status of the rear wiper. It indicates whether the rear wiper is active or not. This information is used to switch on the exterior light in case of bad weather conditions.
    WshngDiFrnt: interface=WiprWshrDiReq1  # Washing Disable Front | Request to enable or disable the front washing
    WshngDiRe: interface=WiprWshrDiReq1  # Washing Disable Rear | Request to enable or disable the rear washing
    WshngFrntFromHmi: interface=WshngReq1  # Washing Front from HMI | Carries a user request to activate the washing of front windows. This demand is provided by the Human Machine Interface (HMI) of the vehicle
    WshngReFromHmi: interface=WshngReq1  # Washing Rear from HMI | Carries a user request to activate the washing of rear windows. This demand is provided by the Human Machine Interface (HMI) of the vehicle
    WshrFldSt: interface=WshrFldSt1  # Washer Fluid Status | Provides the current fluid level contained within this washer tank.
    WshrFldStOfWshrFldTankFrnt: interface=WshrFldSt1  # Status of Washer Fluid Tank | Provides the current fluid level contained within this washer tank.
    WshrFldStOfWshrFldTankRe: interface=WshrFldSt1  # Status of Washer Fluid Tank | Provides the current fluid level contained within this washer tank.
    WshrFldSts: interface=WshrFldSts1  # Washer Fluid Status | Provides the current fluid level contained within this washer tank.
    WshrFldStsOfWshrFldTankFrnt: interface=WshrFldSts1  # Status of Washer Fluid Tank | Provides the current fluid level contained within this washer tank.
    WshrFldStsOfWshrFldTankRe: interface=WshrFldSts1  # Status of Washer Fluid Tank | Provides the current fluid level contained within this washer tank.
    WshrFrnt: interface=WshngCmd1  # Activation Of Washer Front | Users demand for front window washing on/off
    WshrSt: interface=WshrSt1  # Washer Status | Provide information about the washer actuator: fault detected, no fault.
    WshrStFrnt: interface=WshrSt1  # Washer Status Front | Provide information about the washer actuator: fault detected, no fault.
    WshrStOfWshrFrnt: interface=WshrSt1  # Status of Washer Front | Front: Status feedback. Failure feedback. In some implementations, a user wash request results also in a fixed number of wipe-cycles. If washer is defective, these wipe cycles should be suppressed.
    WshrStOfWshrHdlamp: interface=WshrSt1  # Status of Washer Head Lamp | Headlamp: Status feedback. Failure feedback. In some implementations, a user wash request results also in a fixed number of wipe-cycles. If washer is defective, these wipe cycles should be suppressed.
    WshrStOfWshrRe: interface=WshrSt1  # Status of Washer Rear | Rear: Status feedback. Failure feedback. In some implementations, a user wash request results also in a fixed number of wipe-cycles. If washer is defective, these wipe cycles should be suppressed.
    WshrSts: interface=WshrSts1  # Washer Status | Provide information about the washer actuator: fault detected, no fault.
    WshrStsFrnt: interface=WshrSts1  # Washer Status Front | Provide information about the washer actuator: fault detected, no fault.
    WshrStsOfWshrFrnt: interface=WshrSts1  # Status of Washer Front | Front: Status feedback. Failure feedback. In some implementations, a user wash request results also in a fixed number of wipe-cycles. If washer is defective, these wipe cycles should be suppressed.
    WshrStsOfWshrHdlamp: interface=WshrSts1  # Status of Washer Head Lamp | Headlamp: Status feedback. Failure feedback. In some implementations, a user wash request results also in a fixed number of wipe-cycles. If washer is defective, these wipe cycles should be suppressed.
    WshrStsOfWshrRe: interface=WshrSts1  # Status of Washer Rear | Rear: Status feedback. Failure feedback. In some implementations, a user wash request results also in a fixed number of wipe-cycles. If washer is defective, these wipe cycles should be suppressed.
    YawCtrlOvrdnByRsc: interface=CtrlOvrdnByRsc1  # Yaw Control Overridden by RSC | Flag indicating Roll Stability Control (RSC) brake torque overrides yaw control. This enables RSC to win over Active Yaw Control (AYC) also if RSC requests less braking. To avoid conflict between Electronic Stability Control (ESC), Understeering Control and RSC. (Vector of 4)
    YawRateBas: interface=YawRate1  # Yaw Rate Base | Yaw rate base measured along vehicle z-axis (i.e. compensated for orientation). Coordinate system according to ISO 8855.
    YawRateGrdtMeasdByEsc: interface=YawRateGrdt1  # Yaw Rate Gradient Measured by ESC | Time-derivative of Yaw Rate Measured provided by Electronic Stability Control (ESC)
    YawRateGrdtStdByEsc: interface=YawRateGrdt1  # Yaw Rate Gradient Standard by ESC | Time-derivative of Yaw Rate Standard provided by Electronic Stability Control (ESC)
    YawRateMeasdByEsc: interface=YawRate1  # Yaw Rate Measured by ESC | Yaw rate provided by Electronic Stability Control (ESC)
    YawRateOffsMeasdByEsc: interface=YawRate1  # Yaw Rate Offset Measured by ESC | Yaw rate offset provided by Electronic Stability Control (ESC)
    YawRateOffsStdByEsc: interface=YawRate1  # Yaw Rate Offset Standard by ESC | Yaw rate offset provided by Electronic Stability Control (ESC)
    YawRateRaw: interface=YawRate1  # Yaw Rate Raw | Yaw rate base measured along vehicle z-axis (i.e. compensated for orientation). Coordinate system according to ISO 8855.
    YawRateRefValByEsc: interface=YawRate1  # Yaw Rate Reference Value by ESC | Target yaw rate of the Yaw Stability Control feature provided by Electronic Stability Control (ESC)
    YawRateStdByEsc: interface=YawRate1  # Yaw Rate Standard by ESC | Yaw rate provided by Electronic Stability Control (ESC)
    YawStabyCtrlIntvg: interface=YawStabyCtrlIntvg1  # Yaw Stability Control Intervening | Yaw stability control intervention status. | Intervention by any actuators.
    YawStabyInfoByEsc: interface=YawStabyInfo1  # Yaw Stability Information by ESC | Yaw stability information provided by Electronic Stability Control (ESC)
