AUTOSAR XML (schema 00051)
standard types defined: SInt8
