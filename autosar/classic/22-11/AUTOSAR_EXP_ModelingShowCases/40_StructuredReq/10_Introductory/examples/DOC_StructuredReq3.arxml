AUTOSAR XML (schema 00051)
package /OEM/Documentation
  documentation DecompositionExample  # Decomposition Example
    documentation-content:
      4 x structured req, all with category=REQUIREMENT_ITEM, date=2019-07-19, issued-by=OEM, type=valid, importance=High:
        A
        B
          dependencies:
            trace DECOMPB1: category=DECOMPOSITION  # Decomposition element 1
            trace DECOMPB2: category=DECOMPOSITION  # Decomposition element 2
        B1
        B2
