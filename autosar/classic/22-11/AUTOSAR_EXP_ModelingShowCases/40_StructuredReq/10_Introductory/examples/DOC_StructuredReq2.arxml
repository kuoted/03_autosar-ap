AUTOSAR XML (schema 00051)
package /OEM/Documentation
  documentation AdditionalReq  # Additional Requirements AUTOSAR 4.x
    documentation-content:
      chapter CAN
        chapter CanGeneral
          structured req CAN_00001:  # CanDevErrorDetect
            category=REQUIREMENT_ITEM
            date=2018-03-19
            issued-by=OEM
            type=valid
            importance=High
            description=list=[p=l-1=Switches the development error detection and notification on or off. true: detection and notification is enabled. false: detection and notification is disabled., p=l-1=FALSE, [l-1=4.2.2, l-1=4.3.0, l-1=4.4.0], p=l-1=xref=Range_Boolean]
            rationale=p=l-1=The feature development error detection shall be disabled for production code else it has to be ensured that there will be no side effects from this code.
            use-case=p=l-1=preconfigured/default
package /OEM/ImplementationDataTypes/DataConstrs
  range Range_Boolean: phys TRUE..FALSE
