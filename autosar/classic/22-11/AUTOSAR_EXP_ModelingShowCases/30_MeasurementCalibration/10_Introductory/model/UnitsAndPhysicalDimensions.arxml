AUTOSAR XML (schema 00051)
package /McInt/Units
  9 x unit:
    DegreeCelsius: display-name=°C, factor-si-to-unit=1.0, offset-si-to-unit=-273.15, physical-dimension=Temperature
    Kelvin: display-name=K, factor-si-to-unit=1.0, offset-si-to-unit=0.0, physical-dimension=Temperature
    Joule: display-name=J, factor-si-to-unit=1.0, offset-si-to-unit=0.0, physical-dimension=Energy
    MilliAmpere: display-name=mA, factor-si-to-unit=1000.0, offset-si-to-unit=0.0, physical-dimension=Current
    KelvinSecond: display-name=Ks, factor-si-to-unit=1.0, offset-si-to-unit=0.0, physical-dimension=TemperatureTime
    JoulePerKelvinSecond: display-name=J/Ks, factor-si-to-unit=1.0, offset-si-to-unit=0.0, physical-dimension=EnergyPerTemperatureTime
    JoulePerMilliAmpereSecond: display-name=J/mAs, factor-si-to-unit=0.001, offset-si-to-unit=0.0, physical-dimension=EnergyPerCurrentTime
    MilliAmperePerKelvinSecond: display-name=mA/Ks, factor-si-to-unit=1000.0, offset-si-to-unit=0.0, physical-dimension=CurrentPerTemperatureTime
    Second: display-name=s, factor-si-to-unit=1.0, offset-si-to-unit=0.0, physical-dimension=Time
package /McInt/PhysicalDimensions
  8 x physical dimension, all with molar-amount-exp=0, luminous-intensity-exp=0:
    Energy: length-exp=2, mass-exp=1, time-exp=-2, current-exp=0, temperature-exp=0
    Current: length-exp=0, mass-exp=0, time-exp=0, current-exp=1, temperature-exp=0
    CurrentPerTemperatureTime: length-exp=0, mass-exp=0, time-exp=-1, current-exp=1, temperature-exp=-1
    EnergyPerCurrentTime: length-exp=2, mass-exp=1, time-exp=-3, current-exp=-1, temperature-exp=0
    EnergyPerTemperatureTime: length-exp=2, mass-exp=1, time-exp=-3, current-exp=0, temperature-exp=-1
    Time: length-exp=0, mass-exp=0, time-exp=1, current-exp=0, temperature-exp=0
    Temperature: length-exp=0, mass-exp=0, time-exp=0, current-exp=0, temperature-exp=1
    TemperatureTime: length-exp=0, mass-exp=0, time-exp=1, current-exp=0, temperature-exp=1
