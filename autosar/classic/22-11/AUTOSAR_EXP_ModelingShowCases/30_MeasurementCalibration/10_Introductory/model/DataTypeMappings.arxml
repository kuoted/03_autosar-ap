AUTOSAR XML (schema 00051)
package /McInt/DataTypeMappings
  data type mapping set DataTypeMappingSet  # For the sake of an easy implementation, all application data types are mapped to float32.
    data-type-maps:
      application-data-type=Temperature_C, implementation-data-type=float32
      application-data-type=Current, implementation-data-type=float32
      application-data-type=Temperature_K, implementation-data-type=float32
      application-data-type=EnvFactor, implementation-data-type=float32
      application-data-type=Amplification, implementation-data-type=float32
      application-data-type=ESum, implementation-data-type=float32
      application-data-type=Energy, implementation-data-type=float32
      application-data-type=HeaterFactor, implementation-data-type=float32
      application-data-type=Time, implementation-data-type=float32
