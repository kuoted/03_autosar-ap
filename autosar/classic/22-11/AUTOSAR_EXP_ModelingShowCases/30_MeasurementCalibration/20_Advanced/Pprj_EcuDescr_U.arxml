AUTOSAR XML (schema 00051)
package /Tier1/ARPlatform1/System/CompositionSwComponentTypes
  composition sw component type SystemURootComposition_EcuDescr
    component CMscC: type=Pcpt_CMscC
