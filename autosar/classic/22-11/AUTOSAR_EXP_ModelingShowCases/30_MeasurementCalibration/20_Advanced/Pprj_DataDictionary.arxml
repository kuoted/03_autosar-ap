AUTOSAR XML (schema 00051)
package /Tier1/ARPlatform1/DataDictionary/Units/K_Celsius
  unit Celsius: display-name=°C, factor-si-to-unit=1.0, offset-si-to-unit=-273.15, physical-dimension=PD_K  # Degrees Celsius
  unit K: display-name=K, factor-si-to-unit=1.0, offset-si-to-unit=0.0, physical-dimension=PD_K  # Temperature
  physical dimension PD_K: length-exp=0, mass-exp=0, time-exp=0, current-exp=0, temperature-exp=1, molar-amount-exp=0, luminous-intensity-exp=0
package /Tier1/ARPlatform1/DataDictionary/Units/kg
  unit kg: display-name=kg, factor-si-to-unit=1.0, offset-si-to-unit=0.0, physical-dimension=PD_kg  # Mass
  physical dimension PD_kg: length-exp=0, mass-exp=1, time-exp=0, current-exp=0, temperature-exp=0, molar-amount-exp=0, luminous-intensity-exp=0
package /Tier1/ARPlatform1/DataDictionary/Units/NoUnit
  unit NoUnit: display-name=-, factor-si-to-unit=1.0, offset-si-to-unit=0.0, physical-dimension=PD_NoUnit  # No Unit
  physical dimension PD_NoUnit: length-exp=0, mass-exp=0, time-exp=0, current-exp=0, temperature-exp=0, molar-amount-exp=0, luminous-intensity-exp=0
package /Tier1/ARPlatform1/DataDictionary/Units/s
  physical dimension PD_s: length-exp=0, mass-exp=0, time-exp=1, current-exp=0, temperature-exp=0, molar-amount-exp=0, luminous-intensity-exp=0
  unit s: display-name=s, factor-si-to-unit=1.0, offset-si-to-unit=0.0, physical-dimension=PD_s  # Time
package /Tier1/ARPlatform1/DataDictionary/DataTypeMappings
  data type mapping set DefaultDataTypeMapping: mode-request-type-map{implementation-data-type=uint8, mode-group=Direction}
    data-type-maps:
      application-data-type=ComAxis_Temp_Lin_K_uint16_ScNoOfWheels, implementation-data-type=uint16_ScNoOfWheels_7_RL20_ME_Axis
      application-data-type=K_Celsius_Lnr_0_511d9921875_0_FFFF_uint16_ScNoOfWheels, implementation-data-type=uint16_ScNoOfWheels
      application-data-type=Curve_Mass_Lnr_Kg_uint8, implementation-data-type=uint8_4_RL20_ME_1DimMap
      application-data-type=Map_Time_Lnr_s_uint16, implementation-data-type=uint16_6_4_RL20_ME_2DimMap
      application-data-type=ComAxis_Temp_Lin_K_uint16, implementation-data-type=uint16_7_RL20_ME_Axis
      application-data-type=Map_Time_Lnr_s_uint16_ScNoOfWheels, implementation-data-type=uint16_ScNoOfWheels_6_4_RL20_ME_2DimMap
      application-data-type=ComAxis_Steps_Txt_sint8, implementation-data-type=sint8_5_RL20_ME_Axis
      application-data-type=ComAxis_Mass_Lnr_Kg_uint8, implementation-data-type=uint8_5_RL20_ME_Axis
      application-data-type=CMscC_nvm_NvBlockATyp, implementation-data-type=CMscC_nvm_NvBlockATyp
      application-data-type=DataValidityType, implementation-data-type=boolean
      application-data-type=K_Celsius_Lnr_0_511d9921875_0_FFFF_uint16, implementation-data-type=uint16
      application-data-type=kg_Lnr_0_0d25_0_C8_uint8, implementation-data-type=uint8
      application-data-type=NoUnit_Lnr_1_4_1_4_uint8, implementation-data-type=uint8
      application-data-type=NoUnit_Lnr_1_65535_1_FFFF_uint16, implementation-data-type=uint16
      application-data-type=s_Lnr_0_8191d875_0_FFFF_uint16, implementation-data-type=uint16
      application-data-type=speedSteps, implementation-data-type=sint8
      application-data-type=TxWheelNames, implementation-data-type=uint8
package /Tier1/ARPlatform1/DataDictionary/SwRecordLayout/RE20_ME
  sw record layout RL20_ME_1DimMap: category=CURVE, sw-record-layout-group={category=FNC_VALUES:COLUMN_DIR, sw-record-layout-group-axis=1, sw-record-layout-group-index=X, sw-record-layout-group-from=1, sw-record-layout-group-to=-1, sw-record-layout-v={sw-record-layout-v-axis=0, sw-record-layout-v-prop=VALUE, sw-record-layout-v-index=X}}  # Record Layout for an 1dim Map according 20_ME
  sw record layout RL20_ME_2DimMap: category=MAP, sw-record-layout-group={category=FNC_VALUES:COLUMN_DIR, sw-record-layout-group-axis=1, sw-record-layout-group-index=X, sw-record-layout-group-from=1, sw-record-layout-group-to=-1, sw-record-layout-group={sw-record-layout-group-axis=2, sw-record-layout-group-index=Y, sw-record-layout-group-from=1, sw-record-layout-group-to=-1, sw-record-layout-v={sw-record-layout-v-axis=0, sw-record-layout-v-prop=VALUE, sw-record-layout-v-index=X Y}}}  # Record Layout for an 2dim Map according 20_ME
  sw record layout RL20_ME_Axis: category=COM_AXIS, sw-record-layout-group={sw-record-layout-v={short-label=noOfAxisPoints, sw-record-layout-v-prop=COUNT, sw-record-layout-v-index=1}, sw-record-layout-group={short-label=xAxis, category=AXIS_PTS_X:INDEX_INCR, sw-record-layout-group-axis=1, sw-record-layout-group-index=x, sw-record-layout-group-from=1, sw-record-layout-group-to=-1, sw-record-layout-v={sw-record-layout-v-prop=VALUE, sw-record-layout-v-index=x}}}  # This is a record layout for shared axis
package /Tier1/ARPlatform1/DataDictionary/SwSystemConsts/V1_0_0
  sw systemconst ScNoOfWheels: compu {phys=raw}, range phys 1..4, display-format=%1.0f, unit=-  # Scalling the number of wheels plugged at the vehicle.
package /Tier1/ARPlatform1/DataDictionary/PortInterfaces/V1_0_0
  parameter interface Arr1dComAxis_Temp_Lin_K_uint16  # Array of shared axis for temperature
    parameter data prototype Arr1dComAxis_Temp_Lin_K_uint16: sw-addr-method=CAL, sw-calibration-access=READ-WRITE, type=ComAxis_Temp_Lin_K_uint16_ScNoOfWheels  # Array of shared axis for temperature
  parameter interface Arr1dMap_Time_Lnr_s_uint16  # Map to get time dependent on temperature and mass.
    parameter data prototype Arr1dMap_Time_Lnr_s_uint16: sw-addr-method=CAL, sw-calibration-access=READ-WRITE, type=Map_Time_Lnr_s_uint16_ScNoOfWheels  # Map to get time dependent on temperature and mass.
  sender receiver interface Arr1dPrimData_Temperature_Lin_K_C_uint16  # Temperature 1 in Kelvin but displayed as degree Celsius
    data Arr1dPrimData_Temperature_Lin_K_C_uint16: sw-addr-method=DATA, sw-calibration-access=READ-ONLY, type=K_Celsius_Lnr_0_511d9921875_0_FFFF_uint16_ScNoOfWheels  # Temperature 1 in Kelvin but displayed as degree Celsius
  5 x parameter interface:
    ComAxis_Mass_Lnr_Kg_uint8  # Shared axis for mass
      parameter data prototype ComAxis_Mass_Lnr_Kg_uint8: sw-addr-method=CAL, sw-calibration-access=READ-WRITE, type=ComAxis_Mass_Lnr_Kg_uint8  # Shared axis for mass
    ComAxis_Steps_Txt_sint8  # Shared axis for speed steps
      parameter data prototype ComAxis_Steps_Txt_sint8: sw-addr-method=CAL, sw-calibration-access=READ-WRITE, type=ComAxis_Steps_Txt_sint8  # Shared axis for speed steps
    ComAxis_Temp_Lin_K_uint16  # Shared axis for temperature
      parameter data prototype ComAxis_Temp_Lin_K_uint16: sw-addr-method=CAL, sw-calibration-access=READ-WRITE, type=ComAxis_Temp_Lin_K_uint16  # Shared axis for temperature
    Curve_Mass_Lnr_Kg_uint8  # Curve to get mass according differnt speed steps.
      parameter data prototype Curve_Mass_Lnr_Kg_uint8: sw-addr-method=CAL, sw-calibration-access=READ-WRITE, type=Curve_Mass_Lnr_Kg_uint8  # Curve to get mass according differnt speed steps.
    Map_Time_Lnr_s_uint16  # Map to get time dependent on temperature and mass.
      parameter data prototype Map_Time_Lnr_s_uint16: sw-addr-method=CAL, sw-calibration-access=READ-WRITE, type=Map_Time_Lnr_s_uint16  # Map to get time dependent on temperature and mass.
  mode switch interface ModeDirection  # Mode to indicate a direction
    mode group ModeDirection: sw-calibration-access=READ-ONLY, type=Direction
  parameter interface PrimCal_Mass_Lnr_Kg  # Primitive calibration parameter for minimum egg mass.
    parameter data prototype PrimCal_Mass_Lnr_Kg: sw-addr-method=CAL, sw-calibration-access=READ-WRITE, type=kg_Lnr_0_0d25_0_C8_uint8  # Primitive calibration parameter for minimum egg mass.
  sender receiver interface PrimData_Mass_Lnr_Kg_uint8  # Mass in kilogram
    data PrimData_Mass_Lnr_Kg_uint8: sw-addr-method=DATA, sw-calibration-access=READ-ONLY, type=kg_Lnr_0_0d25_0_C8_uint8  # Mass in kilogram
  sender receiver interface PrimData_MassCorrected_Lnr_Kg_uint8  # Primitve data for the corrected mass in kg.
    data PrimData_MassCorrected_Lnr_Kg_uint8: sw-addr-method=DATA, sw-calibration-access=READ-ONLY, type=kg_Lnr_0_0d25_0_C8_uint8  # Primitve data for the corrected mass in kg.
  nv data interface PrimData_StepsSpeed_Txt_sint8  # Stepwise speed indication
    nv-datas:
      data PrimData_StepsSpeed_Txt_sint8: sw-addr-method=DATA_NVDAT, sw-calibration-access=READ-ONLY, type=speedSteps  # Stepwise speed indication
  sender receiver interface PrimData_Temperature_Lin_K_C_uint16  # Temperature 1 in Kelvin but displayed as degree Celsius
    data PrimData_Temperature_Lin_K_C_uint16: sw-addr-method=DATA, sw-calibration-access=READ-ONLY, type=K_Celsius_Lnr_0_511d9921875_0_FFFF_uint16  # Temperature 1 in Kelvin but displayed as degree Celsius
  sender receiver interface PrimData_Time_Lnr_s_uint16  # Primitve data holding a time value.
    data PrimData_Time_Lnr_s_uint16: sw-addr-method=DATA, sw-calibration-access=READ-ONLY, type=s_Lnr_0_8191d875_0_FFFF_uint16  # Primitve data holding a time value.
  sender receiver interface PrimData_ValidState_Txt_noUnit_boolean  # Boolean representing the data validity
    data PrimData_ValidState_Txt_noUnit_boolean: sw-addr-method=DATA, sw-calibration-access=READ-ONLY, type=DataValidityType  # Boolean representing the data validity
package /Tier1/ARPlatform1/DataDictionary/ApplicationDataTypes
  application array data type ComAxis_Temp_Lin_K_uint16_ScNoOfWheels: category=ARRAY
    element ComAxis_Temp_Lin_K_uint16_ScNoOfWheels: category=COM_AXIS, type=ComAxis_Temp_Lin_K_uint16, array-size-semantics=FIXED-SIZE, max-number-of-elements=ScNoOfWheels
  application array data type K_Celsius_Lnr_0_511d9921875_0_FFFF_uint16_ScNoOfWheels: category=ARRAY
    element K_Celsius_Lnr_0_511d9921875_0_FFFF_uint16_ScNoOfWheels: category=VALUE, type=K_Celsius_Lnr_0_511d9921875_0_FFFF_uint16, array-size-semantics=FIXED-SIZE, max-number-of-elements=ScNoOfWheels
  app type Curve_Mass_Lnr_Kg_uint8: category=CURVE, sw-calprm-axis-set={sw-axis-index=1, category=COM_AXIS, sw-axis-grouped=ComAxis_Steps_Txt_sint8}, sw-record-layout=RL20_ME_1DimMap, value-axis-data-type=kg_Lnr_0_0d25_0_C8_uint8
  app type Map_Time_Lnr_s_uint16: category=MAP, sw-calprm-axis-set=[{sw-axis-index=1, category=COM_AXIS, sw-axis-grouped=ComAxis_Temp_Lin_K_uint16}, {sw-axis-index=2, category=COM_AXIS, sw-axis-grouped=ComAxis_Mass_Lnr_Kg_uint8}], sw-record-layout=RL20_ME_2DimMap, value-axis-data-type=s_Lnr_0_8191d875_0_FFFF_uint16
  app type ComAxis_Temp_Lin_K_uint16: category=COM_AXIS, sw-calprm-axis-set={sw-axis-index=1, category=COM_AXIS, sw-axis-individual={input-variable-type=K_Celsius_Lnr_0_511d9921875_0_FFFF_uint16, sw-max-axis-points=6, sw-min-axis-points=6}}, sw-record-layout=RL20_ME_Axis
  application array data type Map_Time_Lnr_s_uint16_ScNoOfWheels: category=ARRAY
    element Map_Time_Lnr_s_uint16_ScNoOfWheels: category=MAP, type=Map_Time_Lnr_s_uint16, array-size-semantics=FIXED-SIZE, max-number-of-elements=ScNoOfWheels
  app type ComAxis_Steps_Txt_sint8: category=COM_AXIS, sw-calprm-axis-set={sw-axis-index=1, category=COM_AXIS, sw-axis-individual={input-variable-type=speedSteps, sw-max-axis-points=4, sw-min-axis-points=4}}, sw-record-layout=RL20_ME_Axis
  app type ComAxis_Mass_Lnr_Kg_uint8: category=COM_AXIS, sw-calprm-axis-set={sw-axis-index=1, category=COM_AXIS, sw-axis-individual={input-variable-type=kg_Lnr_0_0d25_0_C8_uint8, sw-max-axis-points=4, sw-min-axis-points=4}}, sw-record-layout=RL20_ME_Axis
  application record data type CMscC_nvm_NvBlockATyp: category=STRUCTURE
    application record element PrimData_StepsSpeed_Txt_sint8: category=VALUE, type=speedSteps
  8 x app type:
    DataValidityType: category=BOOLEAN, compu {0=Invalid, 1=Valid}, range phys 0..1, display-format=%s, unit=-  # Boolean to represent the data validity
    K_Celsius_Lnr_0_511d9921875_0_FFFF_uint16: category=VALUE, compu {phys=raw/128; unit K}, range phys 0..511.9921875 K, display-format=%8.3f, unit=K  # Temperature
    kg_Lnr_0_0d25_0_C8_uint8: category=VALUE, compu {phys=raw/800; unit kg}, range phys 0..0.25 kg, display-format=%5.3f, unit=kg  # Mass
    NoUnit_Lnr_1_4_1_4_uint8: category=VALUE, compu {phys=raw}, range phys 1..4, display-format=%1.0f, unit=-
    NoUnit_Lnr_1_65535_1_FFFF_uint16: category=VALUE, compu {phys=raw}, range phys 1..65535, display-format=%1.0f, unit=-
    s_Lnr_0_8191d875_0_FFFF_uint16: category=VALUE, compu {phys=raw*0.125; unit s}, range phys 0..8191.875 s, display-format=%6.1f, unit=s  # cooking time in seconds
    speedSteps: category=VALUE, compu {-1=Stop, 0=LightSpeed, 1=RidiculousSpeed, 2=LudicrousSpeed}, range phys -1..2, display-format=%s, unit=-  # Possible speed steps
    TxWheelNames: category=VALUE, compu {0=FrontLeft, 1=FrontRight, 2=RearLeft, 3=RearRight}, range phys 0..3, display-format=%s, unit=-  # Wheel names
package /Tier1/ARPlatform1/DataDictionary/ImplementationDataTypes
  9 x impl type:
    CMscC_nvm_NvBlockATyp: category=STRUCTURE
      element PrimData_StepsSpeed_Txt_sint8: implementation-data-type=sint8
    sint8_5_RL20_ME_Axis: category=ARRAY
      element DimX: array-size=5, array-size-semantics=FIXED-SIZE, implementation-data-type=sint8
    uint16_6_4_RL20_ME_2DimMap: category=ARRAY
      element DimX: category=ARRAY, array-size=6, array-size-semantics=FIXED-SIZE
        element DimY: array-size=4, array-size-semantics=FIXED-SIZE, implementation-data-type=uint16
    uint16_7_RL20_ME_Axis: category=ARRAY
      element DimX: array-size=7, array-size-semantics=FIXED-SIZE, implementation-data-type=uint16
    uint16_ScNoOfWheels: category=ARRAY
      element DimX: array-size=ScNoOfWheels, array-size-semantics=FIXED-SIZE, implementation-data-type=uint16
    uint16_ScNoOfWheels_6_4_RL20_ME_2DimMap: category=ARRAY
      element DimX: category=ARRAY, array-size=ScNoOfWheels, array-size-semantics=FIXED-SIZE
        element DimY: category=ARRAY, array-size=6, array-size-semantics=FIXED-SIZE
          element DimZ: array-size=4, array-size-semantics=FIXED-SIZE, implementation-data-type=uint16
    uint16_ScNoOfWheels_7_RL20_ME_Axis: category=ARRAY
      element DimX: category=ARRAY, array-size=ScNoOfWheels, array-size-semantics=FIXED-SIZE
        element DimY: array-size=7, array-size-semantics=FIXED-SIZE, implementation-data-type=uint16
    uint8_4_RL20_ME_1DimMap: category=ARRAY
      element DimX: array-size=4, array-size-semantics=FIXED-SIZE, implementation-data-type=uint8
    uint8_5_RL20_ME_Axis: category=ARRAY
      element DimX: array-size=5, array-size-semantics=FIXED-SIZE, implementation-data-type=uint8
package /Tier1/ARPlatform1/DataDictionary/ModeDeclarationGroups
  mode declaration group Direction: category=EXPLICIT_ORDER, initial-mode=Halt, on-transition-value=255
    mode Backward: value=2  # Backward direction
    mode Forward: value=1  # Forward direction
    mode Halt: value=0  # Standstill
package /Tier1/ARPlatform1/DataDictionary/UnitGroups
  unit group CalculationUnits: category=COUNTRY, unit=[K, kg, NoUnit, s]
  unit group DisplayUnits: category=COUNTRY, unit=[Celsius, kg, NoUnit, s]
