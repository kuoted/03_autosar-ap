[part 1 of 2: package /AUTOSAR/AISpecification/PortInterfaces_Blueprint]
AUTOSAR XML (schema 00051)
package /AUTOSAR/AISpecification/PortInterfaces_Blueprint
  609 x sender receiver interface:
    AArbnRes1  # Acceleration Arbitration Result 1 | Feedback from Vehicle Longitudinal Control to driver assistant systems (e.g. Adaptive Cruise Control) and other systems: information about which acceleration value is output from arbitration of Vehicle Longitudinal Control.
      data AArbnRes: type=A1
    ACenForOccptPedSfty1  # Acceleration Central for Occupant Pedestrian Safety | High-g acceleration, measured in center by different acceleration measurement sensors
      data A: type=A8
    ACenForOccptPedSfty2  # Acceleration Central for Occupant Pedestrian Safety | High-g acceleration, measured in center by different acceleration measurement sensors
      data A: type=A13
    AExtForOccptPedSfty1  # Acceleration External for Occupant Pedestrian Safety | High-g acceleration, measured by different acceleration measurement satellite sensors
      data A: type=A9
    AExtForOccptPedSfty2  # Acceleration External for Occupant Pedestrian Safety | High-g acceleration, measured by different acceleration measurement satellite sensors
      data A: type=A14
    AFbForCmft1  # Acceleration Feedback for Comfort | Cluster of information regarding acceleration and acceleration saturation feedbacks from Vehicle Longitudinal Control (VLC) to Adaptive Cruise Control (ACC). This information is used for comfort reasons.
      data AFbForCmft: type=AFbForCmft1
    ALat1  # Acceleration Lateral 1 | Generic interface for Lateral acceleration
      data ALat: type=A4
    ALgt1  # Acceleration Longitudinal 1 | Generic interface for Longitudinal acceleration
      data ALgt: type=A4
    ALgt2  # Acceleration Longitudinal 2 | Control value for acceleration control. This value has to be calculated also when SW-C "Follow control and acceleration arbitration" is not in control, i.e. also in driver override situations.
      data AConsol: type=A1
    ALoForOccptPedSfty1  # Acceleration Low Range Central for Occupant Pedestrian Safety | Low-Range-g acceleration, measured in center by different acceleration measurement sensors
      data A: type=A11
    AMidForOccptPedSfty1  # Acceleration Middle Range Central for Occupant Pedestrian Safety | Mid-Range-g acceleration, measured in center by different acceleration measurement sensors
      data A: type=A12
    AReqForCmft1  # Acceleration Request for Comfort | Cluster of information regarding acceleration and jerk requests, e.g. from Adaptive Cruise Control (ACC) to Vehicle Longitudinal Control (VLC). This information is used for comfort reasons.
      data AReqForCmft: type=AReqForCmft1
    AbsCtrlActvForWhl1  # ABS Control Active for Wheel | Antilock Braking System (ABS) control is active (e.g. information for Roll Stability System (RSC)).
      data AbsCtrlActvForWhl  # 0 = Wheel is not in Antilock Braking System (ABS) control, 1 = Wheel is in Antilock Braking System (ABS) control
    AbsCtrlIndcn1  # ABS Control Indication | Antilock braking system (ABS) control active for other domains (e.g. for Human Machine Interface (HMI))
      data AbsCtrlIndcn: type=DevSt4
    AbsCtrlIntvg1  # ABS Control Intervening 1 | Antilock braking system (ABS) control is active (at least one wheel)
      data AbsCtrlIntvg: type=CtrlSt1  # 0 = No wheel has Antilock Braking System (ABS) intervening 1 = At least one wheel has Antilock Braking System (ABS) intervening
    AcTq1  # Actual Mechanical Torque for A/C Compressor | Actual mechanical torque for Air Conditioning (A/C) compressor
    AcTqReq1  # Requested Mechanical Torque for A/C Compressor | Requested mechanical torque for Air Conditioning (A/C) compressor. This value represents the torque consumption in a predicted future state. It is converted to engine crankshaft torque by the provider. Examples of realization: Before activation of the Air Conditioning (A/C) compressor this interface could contain either - the predicted highest torque consumption during the activation process. - the predicted torque consumption in steady state after the activation is finished. | Default value after reset is zero.
    AccActv1  # Adaptive Cruise Control Active 1 | Switch operated by driver to set Adaptive Cruise Control stand-by mode on.
      data St: type=OnOff1  # 0: off 1: on
    AccCtrlActv1  # Adaptive Cruise Control Control Active 1 | Adaptive Cruise Control is engaged and active. This information is used for display feedback for driver as well.
      data AccCtrlActv: type=DevSt4
    AccVehDetd1  # Adaptive Cruise Control Vehicle Detected 1 | Target vehicle for Adaptive Cruise Control is detected. This information is used for display feedback for driver.
      data St: type=DetnSt1  # 0: not detected 1: detected
    AccrPedlGrdt1  # Accelerator Pedal Gradient | time-derivative of the position of the accelerator pedal
    AccrPedlMeasd1  # Accelerator Pedal Measured Value | Position of the accelerator pedal, not "estimated" value. Evaluated signal jitter free without time filtering, including plausibility check, monitoring and replacement value. 0% is driver off the pedal, offsets are removed. 100% must be ensured at end point of the pedal. Shall cover the 100% as well. REMARK: signal is sent with initialisation
      data AccrPedlMeasd: type=Perc1
    AccrPedlRat1  # Accelerator Pedal Ratio | Position of the accelerator pedal, not "simulated" value for e.g. Adaptive Cruise Control (ACC) driver. Evaluated signal jitter free without time filtering, including plausibility check, monitoring and replacement value. 0% is driver off the pedal, offsets are removed. 100% must be ensured at end point of the pedal. Shall cover the 100% as well | signal is sent with initialisation
      data AccrPedlRat: type=Perc1
    AccrPedlRatFild1  # Filtered Accelerator Pedal Ratio | shaped / time filtered value based on accelerator pedal ratio. (e.g. PT1 with calibratable time constant) Calibration shall make it sure that the signal range is 0 - 100%. 0% is driver off the pedal, offsets are removed. 100% must be ensured at end point of the pedal. Shall cover the 100% as well;
      data AccrPedlRatFild: type=Perc1
    AccrPedlRatGrdt1  # Accelerator Pedal Ratio Gradient | time-derivative of the position of the accelerator pedal
      data AccrPedlRatGrdt: type=PercGrdt1
    ActrBodyLvlSt1  # Actuator Body Level Status 1 | Status provided by body level actuator system
      data ActrBodyLvlSt: type=DevSt4
    ActrBodyLvlSts1  # Actuator Body Level Status 1 | Status provided by body level actuator system
      data ActrBodyLvlSts: type=DevSts4
    ActrTqDbnd1  # Actuator Torque Deadband 1 | Generic interface for minimum and maximum increase of the requested torque (relative to the current actual value) which will lead to a change in the current torque
      data Uppr: type=Tq3  # upper value
      data Lowr: type=Tq3  # lower value
    ActrYawCpbyExt1  # Actuator Yaw Capability External | Indicates yaw torque capability of the external yaw rate controller using additional actuators (steering, suspension, ...)
      data ActrYawCpbyExt: type=Tq2
    ActvSuspMod1  # Active Suspension Mode 1 | Full active suspension tuning mode displayed to the driver and provided to other systems
      data ActvSuspMod: type=SuspMod1
    ActvSuspSt1  # Active Suspension Status 1 | Status provided by full active suspension system.
      data ActvSuspSt: type=DevSt4
    ActvSuspSts1  # Active Suspension Status 1 | Status provided by full active suspension system.
      data ActvSuspSts: type=DevSts4
    ActvnOfActrForOccptPedSfty1  # Activation of Actuator for Occupant Pedestrian Safety | Request to activate actuators of pedestrian protection or occupant restraint system
      data Actvt: type=ReqSt1  # 0: keep actuator in position (normal operation mode) 1: activate actuator for protection position
    ActvtWipgAutReq1  # Activate Wiping Automatic Request | Represents user's demand to activate/ deactivate automatic front wiping. Supersedes off and interval modes of normal Wiping Request. As long as automatic front wiping is requested, the value is on.
      data Req: type=OnOff1
    AlrmAcoustCmd1  # Alarm Acoustic Command | request to start/stop alarm sequence by audible device like alarm horn/vehicle horn/Battery backed sounder (BBS)
      data Cmd: type=OnOff1  # OFF - acoustic alarm not requested ON - acoustic alarm requested
    AlrmSt1  # Alarm Status | Alarm global status
      data St: type=AlrmSt1
    AlrmSts1  # Alarm Status | Alarm global status
      data Sts: type=AlrmSts1
    AlrmVisCmd1  # Visual Alarm Command | Visual alarm activation request
      data Cmd: type=OnOff1  # OFF - visual alarm not requested ON - visual alarm requested
    AltTq1  # Alternator Load | Consolidated Alternator Load | This value must take into account all relevant dynamic effects. It is converted to engine crankshaft torque by the provider.Default value after reset is zero.
      data AltTq: type=Tq6
    AltTqReq1  # Requested Mechanical Torque for Alternator (Generator) at Engine Crank Shaft | Requested mechanical load for alternator (generator) at engine crank shaft.
      data AltTqReq: type=Tq6
    AmbAirT1  # Ambient Air Temperature | Current ambient air temperature outside the vehicle, also called environment temperature. | Ambient air temperature close to the vehicle.
      data AmbAirT: type=T7  # Ambient Air Temperature
    AntithftPasSt1  # Key Authentification Status | Status of Passive Antitheft System (PATS) - Immobilizer - key identification
      data St: type=DevSt6
    AntithftPasSts1  # Key Authentification Status | Status of Passive Antitheft System (PATS) - Immobilizer - key identification
      data Sts: type=DevSts6
    Authn1  # Authorization | Generic interface for authorization request or status | It contains the immobilizer identifier, the engine identifier or the fob identifier for its validation.
      data AuthnData
    BattU1  # Battery Voltage | This interface provides the actual voltage level as measured at the battery.
      data BattU: type=U1
    BltLockChgInfo1  # Belt Lock Change Information | Information of belt lock changed
      data Info: type=ChgInfo1  # 0: state of belt locks not changed 1: state of belt lock changed
    BltLockSt1  # Belt Lock State | Belt lock state for seat position
      data BltLockSt: type=BltLockSt1
    BmpT1  # Bumper Temperature | Temperature measured at/in bumper
      data T: type=T3
    BodyLvlCtrl1  # Body Level Control 1 | Activity of the body level control
      data BodyLvlCtrl: type=BodyLvlCtrl1
    BodyLvlMod1  # Body Level Mode 1 | Actual body level displayed to the driver and provided to other systems
      data BodyLvlMod: type=BodyLvlMod1
    BodyLvlModReq1  # Requested Body Level Mode | Height level request by the driver from suspension system/-s
      data BodyLvlModReq: type=BodyLvlMod1
    BodyPitchAg1  # Body Pitch Angle 1 | Generic interface for body pitch angle
      data BodyPitchAg: type=Ag1
    BodyRollAg1  # Body Roll Angle 1 | Generic interface for body roll angle
      data BodyRollAg: type=Ag1
    BodyRollAg2  # Body Roll Angle 2 | Generic interface for body roll angle
      data BodyRollAg: type=Ag2
    BriCmd1  # Brightness Command | Requests the brightness of a light source or the control panel. The percentage value (independent of light actuator type and environment e.g. voltage of electrical system) depends on the functionality that the light source shall be switched on for. A ramp to change the brightness might be chosen. | 100 percent means full power of the light actuator. Invalidation (in-band) might be chosen for emergency illumination in case of jammed network.
      data Cmd: type=BriCmd1
    BriReq1  # Brightness Request | Requests the brightness of a light source or the control panel. The percentage value (independent of light actuator type and environment e.g. voltage of electrical system) depends on the functionality that the light source shall be switched on for. | 100 percent means full power of the light actuator. Invalid is chosen for emergency illumination in case of jammed network.
      data Req: type=Perc2
    BrkActrFailrForBrkOnDmd1  # Brake Actuator Failure for Brake on Demand 1 | Brake actuator failure status with respect to brake-on-demand functions
      data BrkActrFailrForBrkOnDmd: type=DevErrSt2  # 0: no failure 1: failure
    BrkActrIntvg1  # Brake Actuator Intervening 1 | Brake actuator is used to slow down the vehicle (either due to brake pedal being applied or external brake request, e.g. from Adaptive Cruise Control (ACC))
      data BrkActrIntvg: type=OnOff1  # 0: off 1: on
    BrkActrMod1  # Brake Actuator Mode 1 | Brake actuator action or status, with regards to parking brake functionality.
      data BrkActrMod: type=BrkActrMod1
    BrkActrOvrheatd1  # Brake Actuator Overheated 1 | One flag indicating that temperature of at least one actuator component is high, e.g. valves overheated. If this flag is set the actuator is in a critical condition. The external function, e.g. Roll Stability Controller can decide whether to use the brake or not.
      data BrkActrOvrheatd: type=TSt1  # 0: normal brake temperature 1: brake overheated
    BrkActrSatn1  # Brake Actuator Saturation 1 | Brake actuator saturation status. This is a not wheel individual but global information.
      data BrkActrSatn: type=BrkActrSatn1  # 0:No saturation 1:Saturation due to actuator limitation
    BrkActrSatnForWhl1  # Brake Actuator Saturation for Wheel 1 | Indicates which brake actuator is in saturation mode for the individual wheels in the order front left, front right, rear left, rear right.
      data BrkActrSatnForWhl: type=BrkActrSatnPerWhl1
    BrkAssiReq1  # Brake Assist Request 1 | Indicates that the brake system should modify its brake assist mode for hazard situations.
      data BrkAssiReq: type=ReqSt1  # 0: no brake assist request 1: brake assist request
    BrkLiInten1  # Brake Light Intensity 1 | Requested intensity of brake lights.
      data BrkLiInten: type=Perc2  # 0: no brake light activation 100: full intensity
    BrkLiOnReq1  # Brake Light On Request 1 | Request to illuminate brake lights. | Electronic Stability Control (ESC) intervention does not illuminate brake lights (e.g. active booster).
      data BrkLiOnReq: type=ReqSt1  # 0: brake lights off 1: if brake lights are to be illuminated (driver braking or active controlled deceleration (e.g. Adaptive Cruise Control brakes slowly));
    BrkModReq1  # Brake Mode Request 1 | Indicates whether the brake request is comfort or safety related.
      data BrkReqMod: type=BrkMod1  # 0 : comfort relevant 1 : safety relevant
    BrkPedlOvrd1  # Brake Pedal Override 1 | Information that driver overrides SW-C "Follow control and acceleration arbitration" with brake pedal as a result of brake torque arbitration
      data BrkPedlOvrd: type=OvrdnSt1  # 0: no override 1: override
    BrkPedlPsd1  # Brake Pedal Pressed 1 | Information that the brake pedal is pressed. | When other brake system elements (an active booster for example) are in use, a combination of the state of the brake light switch (on) and the brake hydraulic pressure (above a threshold) do not necessarily indicate that the brake pedal is pressed.
      data BrkPedlPsd: type=PsdNotPsd1  # 0: not pressed 1: pressed
    BrkPedlVal1  # Brake Pedal Value 1 | position of the brake pedal physical lower limit: no pedal activation physical upper limit: full pedal stroke
      data BrkPedlVal: type=Perc1  # 0 to 100 %
    BrkPrevn1  # Brake Prevention 1 | Request to avoid braking, e.g. for Adaptive Cruise Control and Vehicle Longitudinal Control. Request includes aspects from traffic point of view. Final decision remains in the actuator control. | Allowed acceleration offset has higher priority than this request.
      data BrkPrevn: type=ReqSt1  # 0: No request 1: Inhibit brake
    BrkRdyReq1  # Brake Ready Request 1 | Indicates that the brake system has to be prepared for braking (e.g. air gap elimination)
      data BrkRdyReq: type=ReqSt1  # 0: no brake ready request 1: brake ready request
    BrkReqTyp1  # Brake Request Type 1 | Type of vehicle deceleration force requested by e.g. Stand Still Manager to Electric Parking Brake.
      data BrkReqTyp: type=BrkReqTyp1
    BrkReqTyp2  # Brake Request Type 2 | Type of vehicle deceleration force requested by e.g. Stand Still Manager to Electronic Stability Control
      data BrkReqTyp: type=BrkReqTyp2
    BrkTracCtrlIntvg1  # Brake Traction Control Intervening 1 | Brake traction control intervention status. True if intervening at at least one wheel.
      data BrkTracCtrlIntvg: type=CtrlSt1  # 0 = Traction Control is off or Traction Control does not use the brakes 1 = At least one wheel has traction brake control intervening
    BrkYawCtrlIntvgPerWhl1  # Brake Yaw Control Intervening for Wheel | Wheel with yaw stability brake control intervention. Wheel individual. (E.g. information for Roll Stability Control (Rsc) and Suspension (Susp))
      data BrkYawCtrlIntvgPerWhl  # 0 = No brake intervention from yaw control 1 = Wheel has yaw stability brake control intervening
    BtnMplSt256  # Multi State Button 256 States | user input to system: Information which of the 256 states of the user interface device (button, switch, knob, slider, ...) is selected
      data St: type=Nr2
    BtnMplSt4  # Multi State Button 4 States | user input to system: Information which of the four states of the user interface device (button, switch, knob, slider, ...) is selected
      data St: type=Nr7
    BtnMplSt8  # Multi State Button 8 States | user input to system: Information which of the eight states of the user interface device (button, switch, knob, slider, ...) is selected
      data St: type=Nr5
    BtnSimple1  # Button Simple | user input to system: Information if the button was pressed or not pressed.
      data St: type=PsdNotPsd1
    BypSlipCtrlReq1  # Bypass Slip Control Request 1 | Request from Roll Stability Control (RSC) only to inhibit internal Electronic Stability Control (ESC) slip control. | To be able to brake beyond pressure corresponding to slip control (e.g. for wheel lift detection).
      data BypSlipCtrlReqPerWhl  # 0 = Slip Control shall not be bypassed 1 = Slip Control shall be bypassed
    CarFindrReq1  # Car Finder Request | Demand to activate / deactivate car finder functionality. The request can be set e.g. manually by the user or via user settings in the Man Machine Interface (MMI).
      data Req: type=OnOff1
    CarHeiSt1  # Car Height Status | Information on the height of the vehicle
      data St: type=Perc2  # value greater than 100% means invalid; initial value = value greater than 100%
    CarHeiSts1  # Car Height Status | Information on the height of the vehicle
      data Sts: type=Perc2  # value greater than 100% means invalid; initial value = value greater than 100%
    ChdProtnCmd1  # Child Protection Command | This is the functional command to the actuator component to execute activation or deactivation of child lock.
      data Cmd: type=ChdProtnCmd1
    ChdProtnSt1  # Child Protection Status | Status if child protection is activated or not.
      data Cmd: type=OnOff1
    ChdProtnSts1  # Child Protection Status | Status if child protection is activated or not.
      data Cmd: type=OnOff1
    ChimerCmd1  # Chimer Command | Command to turn On/Off the chimer in the cluster. The type of the chimer sequence is up to the driver implementation in the cluster.
      data Cmd: type=OnOff1  # OFF - chimer driver activation not requested ON - chimer driver activation requested.
    CluPedlRat1  # Clutch Pedal Ratio | Position of the clutch pedal | Evaluated signal jitter free without time filtering, plausibility check, monitored, including replacement value. 0% is driver off the pedal, offsets are removed. 100% must be ensured at end point of the pedal. Shall cover the 100% as well;signal is sent with initialisation
      data CluPedlRat: type=Perc1
    CmdForSnsr1  # Command for Sensor | Command for the sensor adapters
      data Cmd
    CogPosn1  # Cog Position | Center of gravity relative to the center of front axle referring to ISO standard.
      data CogPosn: type=Len5
    CogPosnEstimd1  # Cog Position Estimated | Estimation of the center of gravity relative to the center of front axle referring to ISO standard.
      data CogPosnEstimd: type=Len5
    CornrMkrReq1  # Corner Marker Request | Request to activate the corner markers.
      data Req: type=CornrMkr1
    CrashSev1  # Crash Severity | Crash severity - calculated (after t0 = time of first contact of involved objects in crash situations) or estimated (before t0) | Each algorithm must be able to provide the maximum '100%', even if only binary decision is possible.
      data Sev: type=Perc2  # 0% means no crash (default) 100% means maximum detectable crash severity (e.g. in case of binary detectable severity 100% is to give in case of detected crash) | increasing crash severity results in increasing value
    CrashSt1  # Crash Status | This interface provides the actual crash status pre-crash and post-crash
      data St: type=CrashSt1
    CrashSts1  # Crash Status | This interface provides the actual crash status pre-crash and post-crash
      data Sts: type=CrashSts1
    CrashYpos1  # Crash Ypos | Y position of crash event - measured or estimated
      data Locn: type=Perc6  # -100%: most right hand side of vehicle front 0%: geometric middle front position 100%: most left hand side of vehicle front
    CrsCtrlActv1  # Cruise Control Active 1 | Switch operated by driver to set stand-by mode of Cruise Control to on.
      data St: type=OnOff1  # 0: off 1: on
    CrsCtrlAndAccDrvrOvrd1  # Cruise Control and Adaptive Cruise Control Driver Override 1 | Adaptive Cruise Control or Cruise Control is overridden by driver.
      data St: type=OvrdnSt1  # 0: not overridden 1: overridden
    CrsCtrlAndAccSwtStEngd1  # Cruise Control and Adaptive Cruise Control Switch Status Engaged 1 | Status of the switch to engage, disengage, or resume Adaptive Cruise Control or Cruise Control.
      data CrsCtrlAndAccSwtStEngd: type=CrsCtrlAndAccSwtSt1
    CrsCtrlAndAccSwtStsEngd1  # Cruise Control and Adaptive Cruise Control Switch Status Engaged 1 | Status of the switch to engage, disengage, or resume Adaptive Cruise Control or Cruise Control.
      data CrsCtrlAndAccSwtStsEngd: type=CrsCtrlAndAccSwtSts1
    CrsCtrlAndAccVehSpdLgt1  # Cruise Control and Adaptive Cruise Control Vehicle Longitudinal Speed 1 | Based on vehicle longitudinal speed. Filtered for Cruise Control or Adaptive Cruise Control specific purpose.
      data CrsCtrlAndAccVehSpdLgt: type=Spd1
    CrsCtrlCtrlActv1  # Cruise Control Control Active | Cruise Control is engaged and active. This information is used for display feedback for driver as well.
      data CrsCtrlCtrlActv: type=DevSt4
    CtrlOfActrForOccptPedSfty1  # Control of Actuator for Occupant Pedestrian Safety | Special adjustment control interface for occupant and pedestrian safety actuators, e.g. belt load limiters at predefined force levels or airbag inflation control based on volume or stiffness target values
      data Ppty: type=Perc2  # - 0% means lowest possible control property of actuator - 100% means highest possible control property of actuator
    CtrlOvrdnByRsc1  # Control Overridden by RSC 1 | Generic interface for a control of a system that is overridden by Roll Stability Control (RSC)
      data CtrlOvrdnByRsc
    DamprCoeff1  # Damper Coefficient | Actual damper coefficient provided by the damper system. Vector of 4 scalars in the order front left, front right, rear left, rear right. Refer to ISO 8855.
      data DamprCoeff: type=DamprCoeffPerWhl1
    DamprCoeffEstimd1  # Damper Coefficient Estimated | Estimation of the actual damper coefficient provided by the damper system. Vector of 4 scalars in the order front left, front right, rear left, rear right. Refer to ISO 8855.
      data DamprCoeffEstimd: type=DamprCoeffPerWhl1
    DamprCtrlMod1  # Damper Control Mode 1 | Damper tuning mode displayed to the driver
      data DamprCtrlMod: type=SuspMod1
    DamprCtrlTunReq1  # Requested Damper Control Tuning | Damper control tuning mode request by the driver
      data DamprCtrlTunReq: type=SuspMod1
    DamprF1  # Damper Force | Actual damper forces provided by the damper system. Vector of 4 scalars in the order front left, front right, rear left, rear right. Refer to ISO 8855.
      data DamprF: type=DamprFPerWhl1
    DamprFEstimd1  # Damper Force Estimated | Estimation of the actual damper forces provided by the damper system. Vector of 4 scalars in the order front left, front right, rear left, rear right. Refer to ISO 8855.
      data DamprFEstimd: type=DamprFPerWhl1
    DamprRate1  # Damper Rate | Damper rate for active damper systems. 0% = maximal soft, 100% = maximal hard
      data DamprRatePerWhl: type=DamprRatePerWhl1
    DamprSt1  # Damper Status 1 | Status provided by the semi-active or switchable damper
      data DamprSt: type=DevSt4
    DamprSts1  # Damper Status 1 | Status provided by the semi-active or switchable damper
      data DamprSts: type=DevSts4
    DateTiStamp1  # Date Time Stamp | Represents the current date and the current time. | Example for realization: Transmitted cyclically with a cycle time of one second.
      data Stamp: type=DateTi1
    DefrstReq1  # Defrost Request | Request for Defrost activation
      data Req: type=OnOff1
    DefrstSt1  # Defrost Status | Status of Defrost (Actuator or Telltale)
      data St: type=OnOff1
    DefrstSts1  # Defrost Status | Status of Defrost (Actuator or Telltale)
      data Sts: type=OnOff1
    DftlCoorrSt1  # Differential Coordinator Status 1 | Status of a differential Coordinator
      data DftlCoorrSt: type=DevErrSt3
    DftlCoorrSts1  # Differential Coordinator Status 1 | Status of a differential Coordinator
      data DftlCoorrSts: type=DevErrSts3
    DftlTqReq1  # Diiferential Torque Request 1 | Requested Torque at a Differential | Sign convention: positive to the right or front or from faster to slower shaft depending on the available device.
      data DftlTqReq: type=Tq13
    DiagcBri1  # Diagnostic Brightness | Request the brightness of a light source for diagnostic purposes. The percentage value specifies a value 0..100%, where 100 percent means full power of the light actuator. It purely depends on the functionality of the light source (e.g. low beam lamp). Any adaption to other items influencing the brightness indirectly (like voltage of electrical system) has to be made by use of other interfaces.
      data Cmd: type=DiagcBri1
    DiagcChdProtn1  # Diagnostic Child Protection | Diagnostic request to the actuator component to unconditional activation or deactivation of child lock (disable opening of the rear door from inside)
      data Cmd: type=DiagcChdProtn1
    DiagcHtlMod1  # Diagnostic Hotel Mode | Diagnostic request to the sensor component to activate hotel mode of the central door locking system
      data Cmd: type=DiagcSt1
    DiagcLock1  # Diagnostic Lock | Diagnostic request to manipulate an actuator component of a door or the rear lid to unconditionally unlock, lock or safe at the latch
      data Cmd: type=DiagcLock1
    DiagcLtchRels1  # Diagnostic Latch Release | Diagnostic request to the sensor component to release/unlock the latch of rear lid or tank flap or backlite window
      data Cmd: type=DiagcSt1
    DiagcPullAid1  # Diagnostic Pull Aid | Diagnostic request to the actuator component to unconditional activation or deactivation of the pull aid.
      data Cmd: type=DiagcPullAid1
    DiagcTog1  # Diagnostic Toggle | Diagnostic request to the sensor component to request a "Toggle-Function"
      data Cmd: type=DiagcSt1
    DispBltLockAck1  # Display Belt Lock Acknowledge | Acknowledge of driver for switch off belt lock state display
      data Ack: type=ReqSt1  # 0: keep display request unchanged according to its internal rules 1: user has acknowledged the belt state display
    DispBltLockReq1  # Display Belt Lock Request | Request to display the belt lock state of seats not under occupant detection control
      data Req: type=ReqSt1  # 0: switch off display 1: switch on display
    DispBltLockSt1  # Display Belt Lock State | Belt lock state of seat position to display (position not under control of occupant detection)
      data St: type=BltLockSt2  # belt lock state to display
    DispBucdStOfOccpt1  # Display Buckled State of Occupant | Buckled state of occupant (under control of occupant detection) at seat position to display
      data St: type=BucdSt1  # buckled state of seat position
    DispDfct1  # Display Defect | Display an error on Human Machine Interface (HMI)
      data Disp: type=OnOff1
    DispPaseDfct1  # Display Passive Entry Defect | Display of number of Passive Entry (PASE) defects
      data DispPaseDfct: type=Nr2
    DispRainSnsr1  # Display Rain Sensor | Informs driver, if rain sensor is currently active.
      data DispRainSnsr: type=OnOff1
    DoorHndlSenSt1  # Door Handle Sensor Status | Information given by a touched sensor implemented on the door handle
      data St: type=DoorHndlSt1
    DoorHndlSenSts1  # Door Handle Sensor Status | Information given by a touched sensor implemented on the door handle
      data Sts: type=DoorHndlSts1
    DoorHndlSt1  # Door Handle Status | Information given by a pull detector implemented on the door handle
      data St: type=DoorHndlSt1
    DoorHndlSts1  # Door Handle Status | Information given by a pull detector implemented on the door handle
      data Sts: type=DoorHndlSts1
    DoorSt1  # Door Status | Provides information whether a door or a lid is open or closed. As long as the status is valid, the value should be provided.
      data St: type=DoorSt1
    DoorSts1  # Door Status | Provides information whether a door or a lid is open or closed. As long as the status is valid, the value should be provided.
      data Sts: type=DoorSts1
    DrvReqTqCluSlow1  # Driver Request of Clutch Torque (Slow Torque Path) | Torque at clutch requested by the driver to be generated by the powertrain (slow path).
      data DrvReqTqCluSlow: type=Tq5
    DrvReqTqWhlFast1  # Driver Request of Wheel Torque (Fast Torque Path) | Wheel torque (to all the driven wheels) requested by the driver to be generated by the powertrain.
      data DrvReqTqWhlFast: type=Tq7
    DrvReqTqWhlSlow1  # Driver Request of Wheel Torque (Slow Torque Path) | Anticipated wheel torque (to all the driven wheels) requested by the driver to be generated by the powertrain.
      data DrvReqTqWhlSlow: type=Tq7
    DrvgSide1  # Driving Side | Information on the position of the driver in the car. For instance, in England, the driver is on the right side of the car and in France or Germany the driver is on the left
      data St: type=LeRi1  # - Left Side - Right Side
    DrvrSteerTq1  # Driver Steering Torque 1 | Measured driver steer torque at the column (does not include the wheel inertia effect, some friction between the sensor and the steering wheel, the steering kinematics...) (includes pinion torque sensor for rack drive system and ONLY denotes the driver torque)
      data DrvrSteerTq: type=Tq1
    DstTrvld1  # Distance Travelled | Travelled distance since last engine start
      data Dst: type=Len6
    DtTqDistbnStIndcn1  # DTD Status Indication 1 | Indication of Drivetrain torque distribution functional status.
      data DtTqDistbnStIndcn: type=DevSt4
    DtTqDistbnStsIndcn1  # DTD Status Indication 1 | Indication of Drivetrain torque distribution functional status.
      data DtTqDistbnStsIndcn: type=DevSts4
    EgyMngtSt1  # Energy Management Status | This interface is used to optimize the energy available in the vehicle. This interface provides the information whether all, basic or only keep-alive components/functionalities are allowed to run.
      data St: type=EgyMngtSt1
    EgyMngtSts1  # Energy Management Status | This interface is used to optimize the energy available in the vehicle. This interface provides the information whether all, basic or only keep-alive components/functionalities are allowed to run.
      data Sts: type=EgyMngtSts1
    EmTqDynJ1  # Electric Machine Dynamic Moment of Inertia | Inertia torque of the electric machine at clutch level. Definition of the sign: Increasing speed creates a negative sign, decreasing speed creates a positive sign. | The signal contains the dynamic torque created by the inertia of the electric machine which, on parallel hybrid projects, increases or decreases the torque at clutch.
      data EmTqDynJ: type=Tq5  # Electric Machine Dynamic Moment of Inertia
    EngHoodSt1  # Engine Hood Status | Provides information whether the engine hood is open or closed. As long as the status is valid the corresponding value should be provided.
      data St: type=OpendClsd1
    EngHoodSts1  # Engine Hood Status | Provides information whether the engine hood is open or closed. As long as the status is valid the corresponding value should be provided.
      data Sts: type=OpendClsd1
    EngN1  # Engine Speed | The consolidated rotational speed of the engine crankshaft. | E.g. evaluated from a segment synchronous source.
      data EngN: type=N1
    EngNGearTar1  # Engine Speed at Target Gear | Used for Dual Clutch Transmission (DCT) to provide the transmission with a predicted engine torque. The transmission precalculates this speed.
      data EngNGearTar: type=N1
    EngNGrdt1  # Engine Speed Gradient | Actual Engine Speed Gradient
      data EngNGrdt: type=NGrdt1
    EngNMax1  # Maximum Permitted Engine Speed | Maximum permitted engine speed for engine protection, must not be exceeded by shifting | default value after reset: max value
      data EngNMax: type=N1
    EngNMin1  # Minimum Engine Speed Setpoint | Minimum engine speed from engine control point of view. | E.g. engine idle speed to be arbitrated by Powertrain Coordinator (PTC) with all other requested engine speeds (Air Conditioner (A/C), alternator, transmission, ...).Signal is sent with initialisation
      data EngNMin: type=N1
    EngPAmbAir1  # Engine Ambient Air Pressure | measured or model based ambient air pressure | signal is sent with initialisation
      data EngPAmbAir: type=P4
    EngRunngDirSt1  # Engine: Engine Running Direction State | Engine running direction state. | Rotation direction of the combustion engine. Used, for example, for engine stop/start systems. Sign of the engine running direction: If the vehicle is moving in the forward direction, and the drivetrain is closed, and a forward gear is engaged, then the engine running direction is positive. During initialization, the engine sends the value "0". 0 = undefined running direction, no direction information available 1 = positive running direction 2 = negative running direction 3 = invalid running direction due to error
      data EngRunngDirSt: type=EngRunngDir1  # Engine: Engine Running Direction State
    EngStrtRemReq1  # Remote Engine Start Request 1 | Information to start the engine from a remote control
      data EngStrtReq: type=EngStrtRemReq1
    EngT1  # Engine: Engine Temperature | Consolidated engine temperature. | For engines with water cooling systems, the signal shows the coolant temperature. Example for the accuracy requirement on this signal in a typical series project: ±5 K. The accuracy requirement is a „goal“. Project-specific requirements must be defined in close cooperation with transmission and engine engineering.
      data EngT: type=T4  # Engine: Engine Temperature
    EngTqCluMin1  # Minimum Engine Torque at Clutch | Minimum engine torque at clutch level of not fired engine at current engine speed. | Minimum engine torque at clutch considers following contributors if present 1) internal engine torque losses like friction, pumping, mechanical driven water pump etc. 2) losses with influence on torque at clutch caused by alternator, airconditioning, power steering etc. Loss differences from engine to engine and variable torque losses over life cycle have to be considered. Usually this signal corresponds to the drag torque of the combustion engine at current speed.
      data EngTqCluMin: type=Tq5  # Minimum Engine Torque at Clutch
    EngTqCluStrtPred1  # Engine: Predicted Clutch Torque to Start the Engine | Predicted torque necessary to start the combustion engine by slipstart. | This signal must be provided from engine start until a project-dependent combustion engine speed. The calculation of this signal must consider the influences on this start torque, for example: Additionally, from standstill until the first expansion stroke, the signal must include the predicted maximum torque that is necessary to overcome the first compression stroke. The calculation of this signal by the provider is not permitted to consider the inertia, which has an effect on the torque at clutch. This means that the signal must be calculated as if the inertia is 0 kg*(m^2). sticking friction and sliding friction, compression effects depending on crankshaft angle, auxiliaries and ancillaries/PTO, combustion engine temperature, coolant temperature.
      data EngTqCluStrtPred: type=Tq5  # Engine: Predicted Clutch Torque to Start the Engine
    EngTqCrksft1  # Engine: Torque at Crankshaft | Indicated torque of combustion engine plus internal engine torque losses. The effect of inertia on the torque is not considered. | Torque at crankshaft considers the following contributors, if present: 1) Indicated torque of combustion engine, calculated based on injection timing and injected fuel, ignition angle and air mass. 2) Internal engine torque losses such as friction, pumping, mechanically driven water pump, etc. Ancillary torque losses caused by the alternator, air conditioning, power steering, etc., are not considered. The calculation of this signal by the provider is not permitted to consider the inertia, which has an effect on the torque at clutch. This means that the signal must be calculated as if the inertia is 0 kg*(m^2). Loss differences from engine to engine and variable torque losses over the life cycle must be considered. The signal includes all torque requests from the accelerator pedal, cruise control, speed limiter, etc., and all interventions, e.g., torque and speed interventions. Example of implementation: The torque is a cylinder average, not a time average, via two crankshaft revolutions of all cylinders, in consideration of the current operating parameters. The operating parameters include the engine temperature, ignition timing and air mass measured or calculated, lambda, fuel cut level, fuel quantity, injection timing, knock control adaption, geographic altitude and others.
      data EngTqCrksft: type=Tq5  # Engine: Torque at Crankshaft
    EngTqCrksftMax1  # Maximum Available Engine Torque at Crankshaft | The maximum torque at crankshaft at the current engine speed and actual air mass (both gasoline and diesel), including the static power limitation of the engine (e.g. calibrated restrictions for engine protection) | Example of realization: The maximum torque is realized by fast and slow path [e.g. with the earliest possible ignition angle at current lambda (gasoline in homogeneous mode) or the maximum fuel mass and injection timing (diesel)] including average knocking (average of cylinders), smoke limitation.'''''' The signal is valid if the engine speed is higher than a certain engine speed threshold. This threshold depends on the engine (e.g. about 500 rpm for four cylinder engines). Below this limit the accuracy of this value may decrease significantly. For hybrid stop/start strategy the engine speed of the fired engine should always be above the speed threshold. Default value after reset is zero
      data EngTqCrksftMax: type=Tq5
    EngTqCrksftMaxEngNCur1  # Engine: Maximum Torque at Crankshaft at Current Engine Speed | Maximum possible torque at crankshaft at current speed with maximum possible air mass at current ambient pressure and air temperature, including static power limitation of the engine. | Theoretical full load engine torque at crankshaft at current engine speed. Maximally charged for turbo systems. The static power limitation contains, e.g., restrictions for protection and static soot limitation. Permanent knock limitation is considered, knock control is not considered.
      data EngTqCrksftMaxEngNCur: type=Tq5  # Engine: Maximum Torque at Crankshaft at Current Engine Speed
    EngTqCrksftMaxFast1  # Maximum Engine Torque at Crankshaft Fast Path | Maximum engine torque at crankshaft fast path including current engine speed, the actual air mass (both gasoline and diesel) and the static power limitation of the engine (e.g. calibrated restrictions for engine protection). This signal is relevant for torque requests realized by fast path. | Example of realization: The maximum torque is realized by fast path [e.g. with the earliest possible ignition angle at current lambda (gasoline in homogeneous mode) or the maximum fuel mass and optimum injection timing concerning torque (diesel)], including average knocking (average of cylinders), smoke limitation.
      data EngTqCrksftMaxFast: type=Tq5
    EngTqCrksftMaxOptmCdn1  # Maximum Engine Torque at Crankshaft at Optimum Conditions | The maximum torque at crankshaft at the current engine speed, maximum air mass, current ambient pressure and air temperature (both gasoline and diesel), including the static power limitation of the engine (e.g. calibrated restrictions for engine protection). It is calculated for ideal conditions. | Example of Realization: The maximum torque is realized by fast and slow path [e.g. with the earliest possible ignition angle at optimum lambda concerning torque (gasoline) or the maximum fuel mass and injection timing (diesel)]. Smoke limitation is included in the signal. Average knocking is not considered (without knock control), but the precalibrated knocking limitation.'''''' The signal is valid if the engine speed is higher than a certain engine speed threshold. This threshold depends on the engine (e.g. about 500 rpm for four cylinder engines). Below this limit the accuracy of this value may decrease significantly. For hybrid stop/start strategy the engine speed of the fired engine should always be above the speed threshold. Default value after reset is zero
      data EngTqCrksftMaxOptmCdn: type=Tq5
    EngTqCrksftMaxProtn1  # Maximum Allowed Torque at Crankshaft for Engine Protection | Maximum crankshaft torque including engine protection. If no protection function is active, the value of this interface will be the upper limit of the chosen data type. | Example of realization: Including catalyst protection, over heating, intake air system protection and fail safe etc.signal is sent with initialisation
      data EngTqCrksftMaxProtn: type=Tq5
    EngTqCrksftMaxSpdCur1  # Engine: Maximum Torque at Crankshaft at Current Speed | Maximum possible torque at crankshaft at current speed with maximum possible air mass at current ambient pressure and air temperature, including static power limitation of the engine. | Theoretical full load engine torque at crankshaft at actual engine speed. Maximally charged for turbo systems. Static power limitation contains e.g. restrictions for protection and static smoke limitation. Permanent knock limitation is considered, knock control not.
      data EngTqCrksftMaxSpdCur: type=Tq5  # Engine: Maximum Torque at Crankshaft at Current Speed
    EngTqCrksftMin1  # Engine: Minimum Engine Torque at Crankshaft Considering Engine Internal Torque Losses | Minimum engine torque at crankshaft level of not fired engine at current engine speed. | The minimum engine torque at crankshaft considers the internal engine torque losses such as friction, pumping, mechanically driven water pump, etc. Loss differences from engine to engine and variable torque losses over the life cycle must be considered. Usually, this signal corresponds to the drag torque of the combustion engine at current speed.
      data EngTqCrksftMin: type=Tq5  # Engine: Minimum Engine Torque at Crankshaft Considering Engine Internal Torque Losses
    EngTqCrksftMinBasc1  # Minimum Engine Torque at Crankshaft for Powertrain Realized by Slow Path | The minimum torque at crankshaft at the current engine speed and the minimum air mass (both gasoline and diesel) not including spark retard (gasoline) and fuel cut off. | Example of realization: The minimum torque is realized by slow path [e.g. normal ignition timing for the minimum mass air at current lambda (gasoline homogeneous) or the minimum fuel mass and injection timing (diesel)]. For diesel engines this interface is possibly equivalent to the torque losses, because minimum fuel mass could be zero. Otherwise minimum torque for fired engine.'''''' The signal is valid if the engine speed is higher than a certain engine speed threshold. This threshold depends on the engine (e.g. about 500 rpm for four cylinder engines). Below this limit the accuracy of this value may decrease significantly. For hybrid stop/start strategy the engine speed of the fired engine should always be above the speed threshold. Default value after reset is zero
      data EngTqCrksftMinBasc: type=Tq5
    EngTqCrksftMinFast1  # Engine: Minimum Torque at Crankshaft Fast Path | Minimum torque at crankshaft of combustion engine at latest possible ignition angle. Calculated at current engine speed with current air mass, current ambient pressure and current air temperature. | Signal is relevant for gasoline engines only. The latest possible ignition angle, also called "max. ignition retard", depends on exhaust temperature, catalyst protection, etc. A torque decrease request from the transmission down to this torque level should only be implemented by ignition retard and not by cylinder cut off. For diesel engines, this signal depends on the minimum fuel mass, which is usually zero. In parallel hybrid projects, this is the minimum torque the combustion engine can implement.
      data EngTqCrksftMinFast: type=Tq5  # Engine: Minimum Torque at Crankshaft Fast Path
    EngTqCrksftMinWoCutOff1  # Minimum Engine Torque at Crankshaft for Powertrain Realized by Slow and Fast Path | The minimum torque at crankshaft at the current engine speed and the minimum air mass (both gasoline and diesel) including spark retard (gasoline), not including fuel cut off. | Example of realization: The minimum torque is realized by slow and fast path [e.g. considering a certain spark retard for the minimum air mass at current lambda (gasoline homogeneous) or the minimum fuel mass and injection timing (diesel)]. The possible amount of spark retard can be defined depending on the application, e.g. according to drive ability criteria. For diesel engines this interface is possibly equivalent to the torque losses, because minimum fuel mass could be zero. Otherwise minimum torque for fired engine.'''''' cylinder engines). Below this limit the accuracy of this value may decrease significantly. The signal is valid if the engine speed is higher than a certain engine speed threshold. This threshold depends on the engine (e.g. about 500 rpm for four For hybrid stop/start strategy the engine speed of the fired engine should always be above the speed threshold. Default value after reset is zero
      data EngTqCrksftMinWoCutOff: type=Tq5
    EngTqCrksftRedByAncllryLoss1  # Engine: Torque at Crankshaft Reduced by Ancillary Losses | Torque at crankshaft reduced by ancillary losses. | Indicated engine torque calculated based on injection timing and injected fuel, ignition angle and air mass, plus 1) Internal engine torque losses such as friction, pumping, mechanically driven water pump, etc. 2) Ancillary torque losses with an effect on torque at crankshaft caused by i.a., alternator, air conditioning, power steering. The calculation of this signal by the provider is not permitted to consider the inertia, which has an effect on the torque at clutch. This means that the signal must be calculated as if the inertia is 0 kg*(m^2). In series, loss differences from engine to engine and variable torque losses over the life cycle must be considered.
      data EngTqCrksftRedByAncllryLoss: type=Tq5  # Engine: Torque at Crankshaft Reduced by Ancillary Losses
    EngTqCrksftRedByAncllryLossMin1  # Engine: Minimum Torque at Crankshaft Reduced by Ancillary Losses | Minimum engine torque at crankshaft of not fired engine at current engine speed decreased by ancillary losses. | The minimum engine torque at crankshaft considers the following contributors, if present: 1) Internal engine torque losses such as friction, pumping, mechanically driven water pump, etc. 2) Ancillary torque losses with an effect on torque at crankshaft caused by i.a., alternator, air conditioning, power steering. In series, loss differences from engine to engine and variable torque losses over the life cycle must be considered. Usually, this signal corresponds to the drag torque of the combustion engine at current speed. Example for timing and accuracy requirements in a typical series project: Max. 40 ms delay time, accuracy: ±7 % or ±5 Nm (max. selection), max. deviation ±20 Nm.
      data EngTqCrksftRedByAncllryLossMin: type=Tq5  # Engine: Minimum Torque at Crankshaft Reduced by Ancillary Losses
    EngTqDecAtCluReqByEscFast1  # Engine Torque Decrease at Clutch Request by ESC Fast | Decreased engine torque at clutch requested by Electronic stability control below the driver input torque including virtual driver request. Fast refers to the immediate / instant torque request, typically achieved by ignition timing.
      data EngTqDecAtCluReqByEscFast: type=Tq5
    EngTqDecAtCluReqByEscSlow1  # Engine Torque Decrease at Clutch Request by ESC Slow | Decreased engine torque at clutch requested by Electronic stability control below the driver input torque including virtual driver request. Slow refers to the longer term or torque reserve request, usually the input to throttle control.
      data EngTqDecAtCluReqByEscSlow: type=Tq5
    EngTqIncAtCluReqByEsc1  # Engine Torque Increase at Clutch Request by ESC | Increased engine torque at clutch requested by Electronic stability control over the driver input torque including virtual driver request.
      data EngTqIncAtCluReqByEsc: type=Tq5
    EngTqJCrksft1  # Engine: Engine Torque of Inertia at Crankshaft | Inertia torque of combustion engine at clutch level. Definition of the sign: An increasing speed produces a negative sign; a decreasing speed produces a positive sign. | The signal contains the dynamic torque caused by the inertia, which increases or decreases the torque at clutch. The engine internal inertia and the inertia of the ancillaries up to the clutch must be considered.
      data EngTqJCrksft: type=Tq5  # Engine: Engine Torque of Inertia at Crankshaft
    EngTqResvPt1  # Torque Reserve Request from Engine to Powertrain | Reserved torque request to be coordinated by the Powertrain Coordinator (PTC). This reserved torque could be realized either by the combustion engine or by another torque source (e.g. electric motor in a hybrid system). It does not include reserved torque requests which will be coordinated inside the combustion engine, e.g. torque reserve for catalyst heating or torque reserve to realize a change in the engine operation mode. | Default value after reset is zero
      data EngTqResvPt: type=Tq5
    EngTqResvReqPt1  # Torque Reserve Request from Engine to Powertrain | Reserved torque request to be coordinated by the Powertrain Coordinator (PTC). This reserved torque could be realized either by the combustion engine or by another torque source (e.g. electric motor in a hybrid system). It does not include reserved torque requests which will be coordinated inside the combustion engine, e.g. torque reserve for catalyst heating or torque reserve to realize a change in the engine operation mode. | Default value after reset is zero.
      data EngTqResvReqPt: type=Tq5
    EngTracCtrlIntvg1  # Engine Traction Control Intervening 1 | Traction control is intervening when a torque reduction at the wheels is requested. Traction control is not intervening when a torque reduction at the wheels is not requested.
      data EngTracCtrlIntvg: type=CtrlSt1  # 0: not intervening 1: intervening
    EntryReq1  # Entry Request | Request to move the seat to a certain position for easy-entry functionality.
      data Req: type=EntryEasy1
    EpbActrFltSt1  # EPB Actuator Fault Status 1 | Failure state of the parking brake actuators
      data EpbActrFltSt: type=DevErrSt2
    EpbActrFltSts1  # EPB Actuator Fault Status 1 | Failure state of the parking brake actuators
      data EpbActrFltSts: type=DevErrSts2
    EpbActrMod1  # EPB Actuator Mode 1 | Indication of the action executed by the parking brake actuator or its status.
      data EpbActrMod: type=BrkActrMod1
    EpbActrTq1  # EPB Actuator Torque 1 | Brake torque applied by Electric Parking Brake actuator, e.g. based on nominal brake parameters (e.g. constant pads friction) and (estimated or measured) brake clamp forces.
      data EpbActrTq: type=Tq4
    EpbActvn1  # EPB Activation | Activation or deactivation of the Electric Parking Brake
      data EpbActvn: type=DevSt4
    EpbBtnCtrlSt1  # EPB Button Control Status 1 | Status of Electric Parking Brake (EPB) control button. NOTE: Depending on implementation: - Case 1: push only type will use values 0,3,4 - Case 2: push/pull type will use values 0,1,2,4
      data EpbBtnCtrlSt: type=EpbBtnCtrlSt1
    EpbBtnCtrlSts1  # EPB Button Control Status 1 | Status of Electric Parking Brake (EPB) control button. NOTE: Depending on implementation: - Case 1: push only type will use values 0,3,4 - Case 2: push/pull type will use values 0,1,2,4
      data EpbBtnCtrlSts: type=EpbBtnCtrlSts1
    EpbDrvrActvnIndcn1  # EPB Driver Activation Indication | Indication to the cockpit (HMI) that the driver has applied/released the parking brake.
      data EpbDrvrActvnIndcn: type=DevSt4
    EscCtrlIndcn1  # ESC Control Indication | Electronic stability control (ESC) controller is intervening
      data EscCtrlIndcn: type=DevSt4
    EscReqPasMod1  # ESC Request Passive Mode 1 | Request to switch the Electronic Stability Control (ESC) system to a passive mode
      data EscReqPasMod: type=DevSt4
    EscSt1  # ESC Status 1 | Status of activation/ deactivation of Electronic Stability Control (ESC)
      data EscSt: type=DevSt7
    EscStIndcn1  # ESC Status Indication | Electronic stability control is turned on.
      data EscStIndcn: type=DevSt4
    EscSts1  # ESC Status 1 | Status of activation/ deactivation of Electronic Stability Control (ESC)
      data EscSts: type=DevSts7
    EscStsIndcn1  # ESC Status Indication | Electronic stability control is turned on.
      data EscStsIndcn: type=DevSts4
    ExtrLiBriCmd1  # Exterior Light Brightness Command | Brightness command for light actuators.
      data Cmd: type=Perc2
    ExtrLiDisp1  # Exterior Light Display | Provides the information whether a certain exterior light function is on or off. As long as the function is on (activated), the value "on" should be provided. This interface can be used e.g. to provide feedback to the driver via Man Machine Interface (MMI). This is considered as a status signal, which carries continuously a certain value as long as its semantic condition is present.
      data Disp: type=OnOff1
    FanSt1  # Fan State | Activation state of climatization or ventilation
      data FanSt: type=DevSt4
    FltStOfSeatClima1  # Fault Status of Seat Climatization | Fault information from seat climatization actuator
      data FltSt: type=DevErrSt2  # 0: Not Present; the seat climatization actuator is working properly with no fault 1: Present; the seat climatization actuator has a fault present and is not working properly
    FltStsOfSeatClima1  # Fault Status of Seat Climatization | Fault information from seat climatization actuator
      data FltSts: type=DevErrSts2  # 0: Not Present; the seat climatization actuator is working properly with no fault 1: Present; the seat climatization actuator has a fault present and is not working properly
    FricCoeff1  # Friction Coefficient | Used road friction coefficient
      data FricCoeff: type=FricCoeff1
    FricCoeffEstimd1  # Estimated Friction Coefficient | Estimated used road friction coefficient
      data FricCoeffEstimd: type=FricCoeff1
    GearParkReq1  # Gear Park Request 1 | Parking lock request from Stand Still Manager to automatic transmission to set parking position
      data GearParkReq: type=ReqSt1  # 0 : No request 1 : Request active
    GearShiftDwnReqFromDrvr1  # Driver Flag Gear Shift Down Request | Activation from gear lever or steering wheel to shift down (pushed = 1, not pushed = 0) This signal does not indicate that a gear shift is actually performed.
      data GearShiftDwnReqFromDrvr: type=PsdNotPsd1
    GearShiftPrevn1  # Gear Shift Prevention 1 | generic interface for gear shift prevention
      data GearShiftPrevn: type=GearShiftPrevn1
    GearShiftUpReqFromDrvr1  # Driver Flag Gear Shift Up Request | Activation from gear lever or steering wheel to shift up (pushed = 1, not pushed = 0). This signal does not indicate that a gear shift is actually performed.
      data GearShiftUpReqFromDrvr: type=PsdNotPsd1
    HldOnDmdSt1  # Hold on Demand Status 1 | Failure status of the Hold on Demand function
      data HldOnDmdSt: type=HldOnDmdSt1
    HldOnDmdSts1  # Hold on Demand Status 1 | Failure status of the Hold on Demand function
      data HldOnDmdSts: type=HldOnDmdSt1
    HmiBtn1  # Hmi Button | Button on Human Machine Interface (HMI) for activation
      data HmiBtn: type=OnOff1  # Activation/Deactivation
    HndbrkSwt1  # Handbrake Switch 1 | Binary information whether the handbrake is applied or not. Measured signal from the handbrake switch.
      data HndbrkSwt: type=OnOff1  # 0: not applied 1: applied
    HndlgBalCoeff1  # Handling Balance Coefficient 1 | (Estimated) handling balance coefficient defined as deviation from defined understeering characteristics. | Ranging from maximum applicable understeering to maximum applicable oversteering. (-100% understeering, 100% oversteering)
      data HndlgBalCoeff: type=Perc6
    HomeCmngAndHomeLvngReq1  # Home Coming and Home Leaving Request | Demand to activate/ deactivate coming home/ leaving home functionalities. The request can be set e.g. manually by the user or via user settings in the Man Machine Interface (MMI).
      data Req: type=HomeCmngAndHomeLvngReq1
    HoopRollCmd1  # Hoop Roll Command | Command for roll hoop
      data Cmd: type=OnOff1
    HoopRollSt1  # Hoop Roll Status | Status of roll hoop actuator
      data St: type=DevErrSt2
    HoopRollSts1  # Hoop Roll Status | Status of roll hoop actuator
      data Sts: type=DevErrSts2
    HornCmd1  # Horn Activation Command | Command to the horn actuator
      data Cmd: type=OnOff1
    HornReq1  # Horn Request | Request for horn
      data Req: type=OnOff1
    HornSt1  # Horn Status | Status of the horn actuator
      data St: type=DevErrSt2
    HornSts1  # Horn Status | Status of the horn actuator
      data Sts: type=DevErrSts2
    HtlModReq1  # Hotel Mode Request | User request to activate hotel mode of the central door locking system. This feature allows to keep just the driver door open, while the rest (including glove box to secure private goods) of the car is locked. "On" means hotel mode.
      data Req: type=OnOff1
    HtlModSt1  # Hotel Mode Status | Status if hotel mode is activated or not. "on" means hotel mode activated.
      data St: type=OnOff1
    HtlModSts1  # Hotel Mode Status | Status if hotel mode is activated or not. "on" means hotel mode activated.
      data Sts: type=OnOff1
    HvacTq1  # Actual Mechanical Torque for A/C Compressor | Actual mechanical torque for Air Conditioning (A/C) compressor
      data HvacTq: type=Tq6
    HvacTqReq1  # Requested Mechanical Torque for A/C Compressor | Requested mechanical torque for Air Conditioning (A/C) compressor. This value represents the torque consumption in a predicted future state. It is converted to engine crankshaft torque by the provider. Examples of realization: Before activation of the Air Conditioning (A/C) compressor this interface could contain either - the predicted highest torque consumption during the activation process. - the predicted torque consumption in steady state after the activation is finished. | Default value after reset is zero.
      data HvacTqReq: type=Tq6
    IdCfmdSt1  # Identifier Comfirmed Status | This information is needed to confirm to other functionalities that the Passive Entry (PASE) emitter is known
      data IdCfmdSt: type=OnOff1
    IdCfmdSts1  # Identifier Comfirmed Status | This information is needed to confirm to other functionalities that the Passive Entry (PASE) emitter is known
      data IdCfmdSts: type=OnOff1
    ImobSt1  # Immobilizer Status | Status of the Immobilizer
      data ImobSt: type=ImobSt1
    ImobSts1  # Immobilizer Status | Status of the Immobilizer
      data ImobSts: type=ImobSts1
    ImobnWirelsReq1  # Wireless Immobilizer Request | Immobilization of the vehicle by a phone call
      data ImobnWirels: type=ImobnWirelsReq1
    InclnSt1  # Inclination Status | Information given to know the inclination of the vehicle in order to adapt the beam of the exterior lights
      data St: type=Perc2  # value greater than 100% means invalid; initial value = value greater than 100%
    InclnSts1  # Inclination Status | Information given to know the inclination of the vehicle in order to adapt the beam of the exterior lights
      data Sts: type=Perc2  # value greater than 100% means invalid; initial value = value greater than 100%
    IndcrDisp1  # Indicator Display | Turn indicator activation status on cluster
      data St: type=IndcrSt1
    IndcrPatCmd1  # Indicator Pattern Command | Definition of indicator pattern number and on/off time
      data Cmd: type=IndcrPatCmd1
    IndcrTurnCmd1  # Indicator Turn Command | Command to turn on or off the turn indicators according to a requested pattern.
      data Cmd
    IndcrTurnReq1  # Indicator Turn Request | Demand to activate / deactivate left or right indicator blinking or temporary blinking left / right. As long as direction indication is requested, the corresponding value should be set. The temporary information can be generated by the sensor component due to special switches or by an adapter component generating it due to timing calculations.
      data Req: type=IndcrTypExt1
    IntrLiReq1  # Interior Light Request | Request to activate / deactivate an interior light actuator or a virtual interior light group. Faulty switch requires (in-band) invalidation. Also there might be a separate value required for initialization. | This interface is not necessary for each interior light actuator; it is not intended for hardwired interior lights.
      data Req: type=IntrLiReq1
    KeyInsertSt1  # Key Insert Status | state whether the key is inserted into key cylinder or not
      data KeyInsertSt: type=KeyInsertSt1
    KeyInsertSts1  # Key Insert Status | state whether the key is inserted into key cylinder or not
      data KeyInsertSts: type=KeyInsertSts1
    KnobRotyBndlsStep15  # Boundless Rotary Knob 15 Steps | user input to system: The value represents the relative number of steps/positions (out of 15 values) the knob has been moved since the last reported movement. Positive values denote clockwise, negative counter clockwise rotation.
      data Step: type=Nr1
    KnobRotyBndlsStep7  # Boundless Rotary Knob 7 Steps | user input to system: The value represents the relative number of steps/positions (out of 7 values) the knob has been moved since the last reported movement. Positive values denote clockwise, negative counter clockwise rotation.
      data Step: type=Nr9
    LedCmd1  # Led Command | Command to activate the Antitheft Warning System (ATWS) Light Emitting Diode (LED) on board
      data Cmd: type=OnOff1  # OFF - LED not requested by alarm ON - LED requested by alarm
    LiDimGlbCmd1  # Light Dim Global Command | This is the command of light master to give a global exterior and interior light dimming information based on the outside brightness level. It is used e. g. to dim the exterior light depending on outside brightness. | 0% means full darkness 100% means maximum brightness This interface gives the information of the actual outside brightness. E.g. exterior or interior light can use this information to adapt their own dimming calculation.
      data Cmd: type=Perc2
    LiExtCmd1  # Exterior Light Command | Generic command from light manager to light adapter components to turn on/off selected lights.
      data Cmd: type=OnOff1  # Turning On or OFF
    LiExtReq1  # Light External Request | Generic exterior lights request
      data Req: type=OnOff1  # Turning On or OFF
    LiFltSt1  # Light Fault Status | Used as feedback from an actuator component to indicate that the light source is broken or not. | Note that no details of the fault are transmitted, but just an operational / defective fault indication. This enables a control component to decide whether a broken light has to be replaced by another light source.The interface is not used for detailed diagnostics. If the light source contains more than one e. g. bulb, it shall be defined how many actuators have to be broken to reach the state defective. The decision to give the status defective is done by the actuator component
      data St: type=DevErrSt2
    LiFltSts1  # Light Fault Status | Used as feedback from an actuator component to indicate that the light source is broken or not. | Note that no details of the fault are transmitted, but just an operational / defective fault indication. This enables a control component to decide whether a broken light has to be replaced by another light source.The interface is not used for detailed diagnostics. If the light source contains more than one e. g. bulb, it shall be defined how many actuators have to be broken to reach the state defective. The decision to give the status defective is done by the actuator component
      data Sts: type=DevErrSts2
    LiOnWarnReq1  # Light On Warning Request | Request for acoustic signaling of "forgotten" lights turned on status.
      data Disp: type=LiOnWarn1
    ListOfObjData1  # List of Object Data | List of object attributes detected, e.g. by forward looking sensor. This information is used for Adaptive Cruise Control (ACC), but not limited for Adaptive Cruise Control (ACC).
      data Id: type=Nr2  # Unique number identifying the source surrounding sensor.
      data List: type=ListOfObjData1  # List of object attributes detected, e.g. by forward looking sensor.
    LockCmd1  # Lock Command | This is the functional command to the actuator component to execute the command unlock, lock or safe (double lock) at the latch.
      data Cmd: type=LockActvn1
    LockSt1  # Lock Status | Status of the latch. This interface provides the information about the current locking state of the latch. It does not distinguish between the source through which it was operated (mechanical key, the internal motor or the internal knob). This Status is provided to the central locking in order to unlock/lock/save the other latches of the vehicle.
      data St: type=LockSt1
    LockStOfSteerCol1  # Steering Column Lock Status | Indication about the locking status of the steering column
      data LockStOfSteerCol: type=LockStOfSteerCol1
    LockSts1  # Lock Status | Status of the latch. This interface provides the information about the current locking state of the latch. It does not distinguish between the source through which it was operated (mechanical key, the internal motor or the internal knob). This Status is provided to the central locking in order to unlock/lock/save the other latches of the vehicle.
      data Sts: type=LockSts1
    LockStsOfSteerCol1  # Steering Column Lock Status | Indication about the locking status of the steering column
      data LockStsOfSteerCol: type=LockStsOfSteerCol1
    LockUnlckReq1  # Lock Unlock Request | User request for emergency locking in case of danger.
      data St: type=LockUnlckReq1
    LockgCenReq1  # Central Locking Request | Request for locking or unlocking the car
      data Req: type=LockgCenInfoReq1
    LockgCenSt1  # Locking Central Status | Provides the information which status the central door locking currently has.
      data St: type=LockgCenSt1
    LockgCenSts1  # Locking Central Status | Provides the information which status the central door locking currently has.
      data Sts: type=LockgCenSts1
    LockgFbReq1  # Locking Feedback Request | Request special blinking for feedback that the locking system was unlocked, locked or safed by user request. The blink sequence is represented by a separate interface.
      data St: type=LockActvn1
    LocnOfImpctAtCrash1  # Location of Impact at Crash | Gives the detected location of an impact in crash by setting bits in an array. Bit value '0' is default value / no impact Bit value '1' is impact detected If algorithm is only able to detect a rough impact location, then all bits on this side should be set
      data Locn: type=LocnOfImpctAtCrash1
    LtchRelsReq1  # Latch Release Request | User request to release/unlock the latch of rear lid or tank flap or backlite window. "On" means latch release to unlock or open a lid or backlite window
      data Req: type=OnOff1
    LvlDefrstCmd1  # Level Defrost Command | Command the defrost actuator level
      data Cmd: type=Perc2
    LvlDefrstReq1  # Level Defrost Request | Request for defrost activation with a desired percentage
      data Req: type=Perc2
    LvlDefrstSt1  # Level Defrost Status | Status of defrost activation with feedback on percentage value
      data St: type=Perc2
    LvlDefrstSts1  # Level Defrost Status | Status of defrost activation with feedback on percentage value
      data Sts: type=Perc2
    LvlgCmd1  # Leveling Command | Command the position of a headlamp leveling actuator. 100% means most upward position (of the headlamps). 0% means most downward position (e.g. low beam adjusted maximum down to the road).101% means invalid. Initial value = Invalid
      data Cmd: type=Perc2
    LvlgReq1  # Leveling Request | Request the position of a headlamp leveling actuator. 100% means most upward position (of the headlamps). 0% means most downward position (e.g. low beam adjusted maximum down to the road).101% means invalid. Initial value = Invalid
      data Req: type=Perc2
    MassgAdjReq1  # Massage Adjust Request | Request to activate different massage programs. One or more different programs at the same time are possible.
      data Req: type=SeatMassgProg1
    MassgAdjSt1  # Massage Adjust Status | Feedback of the seat manager indicating which kind of massage program is currently running. This information may be used by a seat's massage control panel to switch status LEDs
      data St: type=SeatMassgProg1
    MassgAdjSts1  # Massage Adjust Status | Feedback of the seat manager indicating which kind of massage program is currently running. This information may be used by a seat's massage control panel to switch status LEDs
      data Sts: type=SeatMassgProg1
    MemOfMirrPosn1  # Memory of Mirror Position | Memory position data from storage memory for the current profile of a certain mirror and axis.
      data St: type=MemOfMirrPosn1
    Milg1  # Mileage 1 | Travelled total distance (in km) of the vehicle.
      data Milg: type=Len6
    MirrActnSt1  # Mirror Actuator Status | Feedback from the mirror manager about the kind of action that is currently running (mirror moving or mirror stopped). It might be necessary to immediately stop automatic positioning if the driver hits any key (panic-stop).
      data St: type=MirrActnSt1
    MirrActnSts1  # Mirror Actuator Status | Feedback from the mirror manager about the kind of action that is currently running (mirror moving or mirror stopped). It might be necessary to immediately stop automatic positioning if the driver hits any key (panic-stop).
      data Sts: type=MirrActnSts1
    MirrFltSt1  # Mirror Fault Status | Used as feedback from an actuator component to indicate that the mirror is broken or not. Note that no details of the fault are transmitted, but just an operational / defective fault indication. This enables a control component to decide whether a mirror is broken and should not be actuated. | The interface is not used for detailed diagnostics.
      data St: type=DevErrSt2
    MirrFltSts1  # Mirror Fault Status | Used as feedback from an actuator component to indicate that the mirror is broken or not. Note that no details of the fault are transmitted, but just an operational / defective fault indication. This enables a control component to decide whether a mirror is broken and should not be actuated. | The interface is not used for detailed diagnostics.
      data Sts: type=DevErrSts2
    MirrMoveAutReq1  # Mirror Move Automatic Request | Request to move the mirror automatically to a certain position. This position could be determined by a user request from the mirror panel, an access from the remote key, a keyless access or if reverse gear was detected, to down outer mirror angle to provide the best view to the curb.
      data Req
    MirrMoveCmd1  # Mirror Move Command | Command to move the axis in a certain direction.
      data Req: type=MirrAxisMovmt1
    MirrMoveReq1  # Mirror Move Request | Request to move the axis of the mentioned mirror to the indicated position.
      data Req: type=MirrAxisMovmt1
    MirrMoveSt1  # Mirror Move Status | Status of movement of a mirror on an axis in a certain direction.
      data Req: type=MirrAxisMovmt1
    MirrMoveSts1  # Mirror Move Status | Status of movement of a mirror on an axis in a certain direction.
      data Req: type=MirrAxisMovmt1
    MirrPanAdjAutReq1  # Mirror Panel Adjust Automatic Request | User request to move the mirror automatically or to store the mirror position to the given profile.
      data Req: type=MirrPanAdjAutReq1
    MirrPosnSt1  # Mirror Position Status | Actual mirror position
      data Req: type=MirrAxisPosn1
    MirrPosnStoreReq1  # Mirror Position Store Request | Request to store the position of a certain mirror to the corresponding profile number.
      data Req
    MirrPosnStoreToMemReq1  # Mirror Position Store to Memory Request | Request to store the position of a certain mirror and axis to the memory position 'profile'.
      data Req
    MirrPosnSts1  # Mirror Position Status | Actual mirror position
      data Req: type=MirrAxisPosn1
    MirrTintgCmd1  # Mirror Tinting Command | Command for mirror tinting to the actuator component.
      data Req: type=MirrTintgCmd1
    MirrTintgSt1  # Tinting Status | Current status of mirror tinting as feedback in order to control the tinting command to the actuator component.
      data St: type=DevSt4
    MirrTintgSts1  # Tinting Status | Current status of mirror tinting as feedback in order to control the tinting command to the actuator component.
      data Sts: type=DevSts4
    MonrPReqForTirePMon1  # Monitored Pressure Request for Tire Pressure Monitoring | For direct measuring Tire Pressure Monitoring systems: Indication that the current measured tire pressure values have to be monitored by Tire Pressure Monitoring.
      data MonrPConsolReqForTirePMon: type=ReqSt1
    MonrPTarReqForTirePMon1  # TPMS Monitored Target Pressure Request | For direct measuring Tire Pressure Monitoring systems: Indication that the transmitted target tire pressure values have to be monitored by Tire Pressure Monitoring.
      data MonrPTarReqForTirePMon: type=ReqSt1
    NightPanReq1  # Night Panel Request | This interface provides the information about the "Night-Panel-Switch" (e.g. switch for dimming down all interior lights except for speedometer)
      data Req: type=OnOff1
    NoFuCutOffReq1  # No Fuel Cut Off Request 1 | suppress engine fuel cut off
      data NoFuCutOffReq: type=ReqSt1  # 0: no suppression of fuel cut off 1: suppression of fuel cut off
    NozHeatrCmd1  # Nozzle Heater Command | Command to turn on or off the heating element within a washer nozzle
      data Cmd: type=OnOff1
    NozHeatrSt1  # Nozzle Heater Status | Status of the heating element of a nozzle
      data Failr: type=DevErrSt2
      data St: type=OnOff1
    NozHeatrSts1  # Nozzle Heater Status | Status of the heating element of a nozzle
      data Failr: type=DevErrSts2
      data Sts: type=OnOff1
    ObjTarSelnForFolwCtrl1  # Object Target Selection for Follow Control | List of relevant object attributes and prioritization of objects for Follow Control.
      data List: type=ObjTarSelnForFolwCtrl1
    ObstclDstInPrkgSeg1  # Obstacle Distance Park Segment | Distance to obstacle detected in a park segment measured by ultrasonic sensors.
      data ObstclDstInPrkgSeg: type=ObstclDstInPrkgSeg1
    OccptClass1  # Occupant Class | Classification of occupant
      data Class: type=OccptClass1
    OccptOutOfPos1  # Occpant Out of Position | Out of position of occupant
      data OutOfPos: type=OccptOutOfPos1
    OccptWght1  # Occupant Weight | Weight of occupant
      data Wght: type=M2
    OpendClsdSt1  # Opened Closed Status | Provides information about opened or closed status.
      data St: type=OpendClsd1
    OpendClsdSts1  # Opened Closed Status | Provides information about opened or closed status.
      data Sts: type=OpendClsd1
    OperModSt1  # Operation Mode Status | This interface provides the vehicle operation states. It can be seen as an abstraction and extension of the normal ignition switch position (also called "clamp position") which is traditionally used to guide functional operation of the vehicle. It also includes information about what state the engine is in, i.e. running or not. This interface should be used to control which functionalities / components are active in the vehicle. All states have to be implemented in all vehicles, but not necessarily used.
      data St: type=OperModSt1
    OperModSts1  # Operation Mode Status | This interface provides the vehicle operation states. It can be seen as an abstraction and extension of the normal ignition switch position (also called "clamp position") which is traditionally used to guide functional operation of the vehicle. It also includes information about what state the engine is in, i.e. running or not. This interface should be used to control which functionalities / components are active in the vehicle. All states have to be implemented in all vehicles, but not necessarily used.
      data Sts: type=OperModSts1
    OutdBriSt1  # Outside Brightness Status | This is the outside brightness quantized in some levels. It is e.g. used by exterior light master to provide a global exterior and interior dimming information based on the outside brightness
      data St: type=OutdBriSt1
    OutdBriSts1  # Outside Brightness Status | This is the outside brightness quantized in some levels. It is e.g. used by exterior light master to provide a global exterior and interior dimming information based on the outside brightness
      data Sts: type=OutdBriSts1
    OutpMplSt256  # Multi State Output 256 States | System output to user: The value is used to generate feedback to the user about the system's current state. The value represents one of 256 states, mutually excluding each other, the system can be in or has changed to.
      data St: type=Nr2
    OutpMplSt4  # Multi State Output 4 States | System output to user: The value is used to generate feedback to the user about the system's current state. The value represents one of four states, mutually excluding each other, the system can be in or has changed to.
      data St: type=Nr7
    OutpMplSt8  # Multi State Output 8 States | System output to user: The value is used to generate feedback to the user about the system's current state. The value represents one of eight states, mutually excluding each other, the system can be in or has changed to.
      data St: type=Nr5
    PExtForOccptPedSfty1  # Pressure External for Occupant Pedestrian Safety | Differential pressure to detect impacts, typically measured in doors
      data P: type=Perc8
    PanAdjmtManReq1  # Panel Adjust Manual Request | User request to move the axis of the mirror manually in a certain direction.
      data Req: type=MirrAxisMovmt1
    PanicAlrmAcoustCmd1  # Panic Alarm Acoustic Command | Request to start/stop panic alarm sequence by audible device like alarm horn/vehicle horn/Battery Backed Sounder (BBS)
      data Cmd: type=OnOff1  # OFF - acoustic alarm not requested ON - acoustic alarm requested
    PanicAlrmSt1  # Panic Alarm Status | Status of panic alarm information about panic alarm for usage of the other components: management of priorities between alarm and panic horn sequences
      data St: type=OnOff1  # Off - inactive On - active
    PanicAlrmSts1  # Panic Alarm Status | Status of panic alarm information about panic alarm for usage of the other components: management of priorities between alarm and panic horn sequences
      data Sts: type=OnOff1  # Off - inactive On - active
    PanicAlrmVisCmd1  # Panic Alarm Visual Command | Visual panic alarm activation request
      data Cmd: type=OnOff1  # OFF - visual alarm not requested ON - visual alarm requested
    PanicTog1  # Panic Toggle | Toggle switch for panic alarm activation
      data Req: type=OnOff1
    PaseActvnSt1  # Pase Activation Status | Activate or deactivate the Passive Entry (PASE) system considering vehicle mode information
      data St: type=OnOff1  # - Not Activated - Activated
    PaseActvnSts1  # Pase Activation Status | Activate or deactivate the Passive Entry (PASE) system considering vehicle mode information
      data Sts: type=OnOff1  # - Not Activated - Activated
    PaseKeylsInvldSt1  # Pase Keyless Invalid Status | Information to know if the Passive Entry (PASE) key is valid or not
      data St: type=InvldVld1  # - Invalid -Valid
    PaseKeylsInvldSts1  # Pase Keyless Invalid Status | Information to know if the Passive Entry (PASE) key is valid or not
      data Sts: type=InvldVld1  # - Invalid -Valid
    PasePanicReq1  # Pase Panic Request | Request to activate panic alarm from Passive Entry (PASE)
      data Req: type=OnOff1  # OFF - no request ON - request active
    PinionSteerAg1  # Pinion Steering Angle 1 | Generic interface for Pinion Steer Angle
      data PinionSteerAg: type=Ag4
    PinionSteerAgSpd1  # Pinion Steering Angle Speed 1 | Generic interface for pinion steer angle speed
      data PinionSteerAgSpd: type=AgSpd1
    PitchRate1  # Pitch Rate 1 | Generic Pitch rate along vehicle y-axis. Coordinate system according to ISO 8855
      data PitchRate: type=AgSpd3
    PitchRate2  # Pitch Rate for Occupant and Pedestrian Safety | Pitch Rate from sensor element. Coordinate system according to ISO 8855. Extended signal range
      data PitchRate: type=AgSpd8
    PosnSt1  # Position Status | Position of the roof
      data St: type=Perc2  # Information related to the position of the roof: 0% means Roof fully opened; 100% means roof fully closed ; between 0% and 100%, information of the aperture proportion of the roof.
    PosnSts1  # Position Status | Position of the roof
      data Sts: type=Perc2  # Information related to the position of the roof: 0% means Roof fully opened; 100% means roof fully closed ; between 0% and 100%, information of the aperture proportion of the roof.
    PresStOfOccpt1  # Presence State of Occupant | Detection of occupant
      data St: type=OccptPresSt1
    PrkgBrkActv1  # Parking Brake Active 1 | Parking brake (conventional or electrical) is activated
      data PrkgBrkActv: type=OnOff1  # 0: not active 1: active
    PrkgBrkAppldIndcn1  # Parking Brake Applied Indication | Indication to Human Machine Interface (HMI) that parking brake is activated
      data PrkgBrkAppldIndcn: type=DevSt4
    PrkgLiIndcn1  # Parking Light Indication | This interface represents the indication to switch on left, right, both or no parking lights. As long as parking lights are requested by Human Machine Interface (HMI) switch, the corresponding value has to be set. It's also used to provide indication to Human Machine Interface (HMI) (feedback for cluster) and other body domain functionalities whether the left parking lights, the right parking lights or the positioning lights are active. As long as this functionality is required the value has to be set to "on".
      data PrkgLi: type=PrkgLiIndcn1
    ProfPenSt1  # Driver Profile | Status of current selected personalization profile from profile manager. It is a common profile selectable from transponder, remote key, keyless access, Human Machine Interface (HMI)...
      data Id: type=ProfPenSt1
    ProfPenSts1  # Driver Profile | Status of current selected personalization profile from profile manager. It is a common profile selectable from transponder, remote key, keyless access, Human Machine Interface (HMI)...
      data Id: type=ProfPenSts1
    PtAccrPedlPosn1  # Powertrain: Accelerator Pedal Position | Accelerator pedal position. Accelerator pedal ratio shaped and filtered. | The calibration must ensure that the used signal range is 0 – 100 %. 0 % is driver off the pedal, offsets are removed. 100 % must be ensured at end point of the pedal. Consolidated physical value, either a measured value (Measd) or a modeled value (Estimd). Final filtered and offset-corrected consolidated actuator value/physical sensor value. Virtual physical sensor value/fused sensor value that comes as close as possible to the technical signal. If it is not possible to provide a physical sensor value (e.g. failure, implausibility or other reasons), then a substitute value/default value or a frozen value is provided.
      data PtAccrPedlPosn: type=Perc1  # Powertrain: Accelerator Pedal Position
    PtAccrPedlPosnVirt1  # Powertrain: Virtual Accelerator Pedal Position | Theoretical accelerator pedal value determined using the physical pedal value and requests from Adaptive Cruise Control or Cruise Control etc. | Example of implementation: Within Adaptive Cruise Control / Cruise Control, this is based on the total requested propulsion wheel torque from the driver or the Vehicle Longitudinal Control, otherwise, this is the "Accelerator Pedal Ratio" value. Evaluated signal, jitter free, including plausibility check, monitoring and substitute value but without filtering. 0 %: (Virtual) driver is off the pedal, offsets are removed. 100 %: Must be ensured at end point of the pedal. Must cover the 100 % as well.
      data PtAccrPedlPosnVirt: type=Perc1  # Powertrain: Virtual Accelerator Pedal Position
    PtCluEngSt1  # Powertrain: State of Engine Clutch | State of engine clutch concerning transmission of power. | The signal describes the coupling state of the engine clutch. The engine clutch is implemented typically as a friction clutch. States of power transmission: 0 = open 1 = open_touch 2 = slip_controlled 3 = slip_micro 4 = closed 5 = not_determined (state of power transmission cannot be identified) 6 = hydrodynamic 14 = init 15 = signal error Values 7… 13 are undefined.
      data PtCluEngSt: type=TrsmPwrSt1  # Powertrain: State of Engine Clutch
    PtCluEngStCtrl1  # Powertrain: Control State of Engine Clutch | Current control state of the engine clutch concerning transmission of power. | The signal describes the current control state of the engine clutch. The engine clutch is implemented typically as a friction clutch. States of power transmission: 0 = open => if the engine clutch only transmits the drag torque of the engine clutch. 1 = conditioning => if the engine clutch is preparing for power transmission, for example, by prefilling. 2 = open_touch => if the air gap of the engine clutch is closed but only the drag torque is transmitted. 3 = torque_controlled => if the engine clutch is controlled to transmit a determined torque. 4 = slip_controlled => if the engine clutch is slipping and is transmitting torque, and the differential speed is greater than a calibratable threshold. 5 = slip_micro => if the engine clutch is slipping and is transmitting torque, and the differential speed is less than a calibratable threshold. 6 = closed => if the engine clutch is not slipping, but is transmitting the full torque provided by the combustion engine and can have an additional torque reserve. 7 = not_determined => state of power transmission cannot be identified. 8 = hydrodynamic => only in projects with torque converter. 14 = init => at initialization. 15 = signal error => if an internal fault is detected by the TCM, for example, if the actual physical state of the engine clutch cannot be determined. Values 9… 13 are undefined.
      data PtCluEngStCtrl: type=TrsmPwrStCtrl1  # Powertrain: Control State of Engine Clutch
    PtCluEngStCtrlTar1  # Powertrain: Target Control State of Engine Clutch | Target control state of the engine clutch concerning transmission of power. | The signal describes the target control state of the engine clutch. The engine clutch is implemented typically as a friction clutch. States of power transmission: 0 = open => if the engine clutch only transmits the drag torque of the engine clutch. 1 = conditioning => if the engine clutch is preparing for power transmission, for example, by prefilling. 2 = open_touch => if the air gap of the engine clutch is closed but only the drag torque is transmitted. 3 = torque_controlled => if the engine clutch is controlled to transmit a determined torque. 4 = slip_controlled => if the engine clutch is slipping and is transmitting torque, and the differential speed is greater than a calibratable threshold. 5 = slip_micro => if the engine clutch is slipping and is transmitting torque, and the differential speed is less than a calibratable threshold. 6 = closed => if the engine clutch is not slipping, but is transmitting the full torque provided by the combustion engine and can have an additional torque reserve. 7 = not_determined => state of power transmission cannot be identified. 8 = hydrodynamic => only in projects with torque converter. 14 = init => at initialization. 15 = signal error => if an internal fault is detected by the TCM, for example, if the actual physical state of the engine clutch cannot be determined. Values 9… 13 are undefined.
      data PtCluEngStCtrlTar: type=TrsmPwrStCtrl1  # Powertrain: Target Control State of Engine Clutch
    PtCluEngTqMaxCluPCur1  # Powertrain: Engine Clutch Maximum Torque at Current Clutch Pressure | Maximum transmittable torque of engine clutch at current pressure. | No further explanation needed.
      data PtCluEngTqMaxCluPCur: type=Tq5  # Powertrain: Engine Clutch Maximum Torque at Current Clutch Pressure
    PtCluN1  # Powertrain: Clutch Speed | Consolidated rotational speed of the clutch input shaft. | Speed of the shaft combining all driving machines in front of the gearbox. Driving machines are, e.g., electric machines and combustion engines. For conventional drivetrains, the signal is identical to the signal "Powertrain: Engine Speed Including Start Stop". For parallel hybrid projects the signal shall be provided based on the speed of the electric machine for accuracy reasons. The accuracy of the clutch speed based on the electric machine has to be defined in close cooperation between electric machine expert and transmission expert. The information about the direction of the clutch speed is also necessary for start-stop functionalities. Experience indicates that speeds of up to -500 rpm may occur. References to other signals: PtEngNInclgStrtStop
      data PtCluN: type=N2  # Powertrain: Clutch Speed
    PtCluNLimnLoReq1  # Powertrain: Request by Powertrain for Lower Limitation of Clutch Speed | Minimum clutch speed requested by powertrain. | The powertrain coordinator sends the required minimum speed needed at clutch. If there is no request, the transmission expects the neutral value 0 rpm.
      data PtCluNLimnLoReq: type=N2  # Powertrain: Request by Powertrain for Lower Limitation of Clutch Speed
    PtCluNLimnUpReq1  # Powertrain: Request by Powertrain for Upper Limitation of Clutch Speed | Maximum clutch speed requested by powertrain. | The powertrain coordinator sends the required maximum speed needed at clutch. If there is no request, a neutral value must be sent. This neutral value must be agreed on between the torque coordinator expert and the transmission expert.
      data PtCluNLimnUpReq: type=N2  # Powertrain: Request by Powertrain for Upper Limitation of Clutch Speed
    PtDrvrReqTqClu1  # Powertrain: Driver Request of Torque at Clutch | Torque at clutch requested by the driver. | Combination of all real and virtual driver requests, project specific including idle speed control. Virtual driver requests include cruise control, distance cruise control, vehicle speed limiter, etc. This signal shows the unfiltered driver requested torque and therefore it is not affected by driving comfort functions. The signal determines the earliest torque information in the torque chain architecture. Used to prepare transmission internal system functions to achieve a proper spontaneity according to the driver request. Predicted torque information, which is determined based on the driver pedal position or on driver assistance systems. Independent of whether the engine is running or not, this signal always delivers the torque information as if the engine is running. The calculation of this signal by the provider is not permitted to consider the inertia, which has an effect on the torque at clutch. This means that the signal must be calculated as if the inertia is 0 kg*(m^2). In hybrid projects, a limitation by the torque of the engine clutch is not visible. In projects with engine clutch, this signal is not permitted to be limited due to the state of the engine clutch.
      data PtDrvrReqTqClu: type=Tq5  # Powertrain: Driver Request of Torque at Clutch
    PtDrvrReqTqCluPredEngN1  # Powertrain: Predicted Driver Request of Torque at Clutch in Target Speed | Predicted driver requested torque at clutch at the engine speed reached in target gear. | Environmental conditions, such as altitude and temperature and engine internal limits, e.g., smoke limitation and full load limit, are considered. The calculation of this signal by the provider is not permitted to consider the inertia, which has an effect on the torque at clutch. This means that the signal must be calculated as if the inertia is 0 kg*(m^2). The calculation of this signal is based on signal See also: “Transmission: Predicted Virtual Clutch Speed in Target Gear”. References to other signals: TrsmCluNPredGearTarTrsmCluNVirtGearTar
      data PtDrvrReqTqCluPredEngN: type=Tq5  # Powertrain: Predicted Driver Request of Torque at Clutch in Target Speed
    PtEmNIdle1  # Powertrain: Target Idle Speed of the Electric Machine | Target speed of the electric machine idle speed controller. | Used, for example, for the internal drive-off clutch and for hybrid-specific functions. E.g. necessary for the transition from electric mode to hybrid mode. The idle speed setpoint is also known as “target idle speed”. The signal is always calculated, even if the actual electric machine speed is outside of the activation range of the idle speed controller. This means it is also calculated if the real/physical electric machine speed is e.g. 0 rpm or 5000 rpm.
      data PtEmNIdle: type=N2  # Powertrain: Target Idle Speed of the Electric Machine
    PtEmTq1  # Powertrain: Electric Machine Torque | Torque of the electric machine at clutch. | Torque output of the electric machine at clutch level. The gear ratio between the electric machine shaft and the clutch, if present, must be considered. The calculation of this signal by the provider is not permitted to consider the inertia, which has an effect on the torque at clutch. This means that the signal must be calculated as if the inertia is 0 kg*(m^2). Timing and accuracy requirements on this torque signal have to be defined in close cooperation of engine and transmission experts, especially for combined engine and electric machine operation.
      data PtEmTq: type=Tq5  # Powertrain: Electric Machine Torque
    PtEmTqJRotorShaft1  # Powertrain: Electric Machine Torque of Inertia at Rotor Shaft | Inertia torque of the electric machine at clutch level. Definition of the sign: An increasing speed produces a negative sign; a decreasing speed produces a positive sign. | The signal contains the dynamic torque caused by the inertia of the electric machine, which, in parallel hybrid projects, increases or decreases the torque at clutch.
      data PtEmTqJRotorShaft: type=Tq5  # Powertrain: Electric Machine Torque of Inertia at Rotor Shaft
    PtEmTqMaxCluNCur1  # Powertrain: Electric Machine Maximum Torque at Current Clutch Speed | Maximum possible torque of electric machine at clutch at current clutch speed and current operating point, including all system limitations. | Theoretical maximum possible torque output of the electric machine at clutch level with maximum possible inverter phase electric current. The current operating point is defined e.g., by the current DC-link voltage, the rotor temperature and the battery power. System limitations are, e.g., speed limits, temperature limits, electric current limits and voltage limits. The gear ratio between the electric machine shaft and the clutch is considered. The calculation of this signal by the provider is not permitted to consider the inertia, which has an effect on the torque at clutch. This means that the signal must be calculated as if the inertia is 0 kg*(m^2).
      data PtEmTqMaxCluNCur: type=Tq5  # Powertrain: Electric Machine Maximum Torque at Current Clutch Speed
    PtEmTqMinCluNCur1  # Powertrain: Electric Machine Minimum Torque at Current Clutch Speed | Minimum possible torque of electric machine at clutch at current clutch speed and current operating point, including all system limitations. | Theoretical minimum possible torque output of the electric machine at clutch level with maximum possible inverter phase electric current. The current operating point is defined e.g., by the current DC-link voltage, the rotor temperature and the battery power. System limitations are, e.g., speed limits, temperature limits, electric current limits and voltage limits. The gear ratio between the electric machine shaft and the clutch is considered. The calculation of this signal by the provider is not permitted to consider the inertia, which has an effect on the torque at clutch. This means that the signal must be calculated as if the inertia is 0 kg*(m^2).
      data PtEmTqMinCluNCur: type=Tq5  # Powertrain: Electric Machine Minimum Torque at Current Clutch Speed
    PtEmTqRelCluReq1  # Powertrain: Electric Machine Relative Torque at Clutch Requested by Powertrain | Electric machine relative torque at clutch requested by powertrain. | Torque to be implemented by the electric machine additional to the driver requested torque. Typically used to create the electric machine torque which is necessary to start the combustion engine via the engine clutch without influencing the implementation of the driver requested torque. As long as there is no torque request, the signal "Powertrain: Implementation Type of Electric Machine Relative Torque at Clutch Requested by Powertrain” is “0h = no request” and signal "Powertrain: Electric Machine Relative Torque at Clutch Requested by Powertrain” is “FFEh = Init”. This signal is closely related to signal “Powertrain: Implementation Type of the Electric Machine Relative Torque at Clutch Requested by Powertrain”. References to other signals: PtNrTypEmTqRelCluReq
      data PtEmTqRelCluReq: type=Tq5  # Powertrain: Electric Machine Relative Torque at Clutch Requested by Powertrain
    PtEmTqReq1  # Powertrain: Requested Electric Machine Torque | Requested electric machine torque, including all interventions, including all limitations. | The signal contains the limitations which are closely related to the electric machine or which are attributed to the electric machine by the powertrain coordinator. The content of this signal is related to the clutch level, so a possibly installed ratio between the rotor of the electric machine and the clutch is considered. The calculation of this signal by the provider is not permitted to consider the inertia, which has an effect on the torque at clutch. This means that the signal must be calculated as if the inertia is 0 kg*(m^2). The signal contains all interventions. The goal is that the torque information is sent 50 – 80 ms ahead of the desired real/physical torque.
      data PtEmTqReq: type=Tq5  # Powertrain: Requested Electric Machine Torque
    PtEmTqResvReq1  # Powertrain: Torque Reserve Electric Machine Requested by Powertrain | Torque reserve of the electric machine, might be used to start the combustion engine. | This torque reserve is the sum of “Engine: Minimum Torque at Crankshaft Reduced by Ancillary Losses” and the torque necessary to compensate for the inertia, if it is used to start the combustion engine. If no torque reserve is necessary, then the signal is set to 0 Nm. References to other signals: EngTqCrksftRedByAncllryLossMin
      data PtEmTqResvReq: type=Tq5  # Powertrain: Torque Reserve Electric Machine Requested by Powertrain
    PtEngNInclgStrtStop1  # Powertrain: Engine Speed Including Start Stop | Consolidated rotational speed of the engine crankshaft including start and stop. | Crankshaft speed of the combustion engine. Created by fading from segment synchronous source to tooth-based source during engine stop and by fading from tooth-based source to segment synchronous source during engine start. The information about the direction of the engine speed is necessary for start-stop functionalities. Experience indicates that speeds of up to -500 rpm may occur.
      data PtEngNInclgStrtStop: type=N2  # Powertrain: Engine Speed Including Start Stop
    PtEngNReq1  # Powertrain: Engine Speed Requested by Powertrain | Engine crankshaft speed requested by powertrain. | Engine crankshaft speed requested by powertrain, used, e.g., for slip start. This signal is closely related to the status signal: “Powertrain: Request to Enable Engine Speed Request”. This signal is also closely related to the following signal: “Transmission: Clutch Speed Requested by Transmission". For non-hybrid applications, this signal and signal "Transmission: Clutch Speed Requested by Transmission" are identical. Recommendation is to send only the signal set for "Transmission: Clutch Speed Requested by Transmission". For hybrid applications, the signals are identical if the engine clutch is closed. Otherwise, the signals are usually different. So, for hybrid applications, both signal sets are necessary, signal sets for "Powertrain: Engine Speed Requested by Powertrain" and "Transmission: Clutch Speed Requested by Transmission". As long as there is no speed request, the recommendation is to send the initialization value. If there is a valid speed request, then an implementation is expected as fast as possible. Timing and accuracy requirements on the speed request in a typical series project are equivalent to the timing and accuracy requirements on signal "Transmission: Clutch Speed Requested by Transmission". References to other signals: PtEngNReqEnaReq TrsmCluNReq
      data PtEngNReq: type=N2  # Powertrain: Engine Speed Requested by Powertrain
    PtEngNReqEnaReq1  # Powertrain: Request to Enable Engine Speed Request | Engine speed requested by powertrain enabled or not enabled. | This signal is closely related to the signal "Powertrain: Engine Speed Requested by Powertrain". 0 = not enabled => the request sent by signal "Powertrain: Engine Speed Requested by Powertrain" is not permitted to be implemented. 1 = enabled => the request must be implemented. If the request must be implemented, then the signal must be “1” and the signal “Powertrain: Engine Speed Requested by Powertrain” must be a value in the physically used range, different from initialization and error values. The engine stall protection must have a higher priority than the engine speed request. References to other signals: PtEngNReq
      data PtEngNReqEnaReq: type=EnagSt1  # Powertrain: Request to Enable Engine Speed Request
    PtEngNSpIdle1  # Powertrain: Engine Idle Speed Setpoint | Target speed of the engine idle speed controller. | Used, for example, for comfortable gear engagement from neutral gear at vehicle standstill. The idle speed setpoint is also known as "target idle speed". The signal is always calculated, even if the actual engine speed is outside of the activation range of the idle speed controller. This means it is also calculated if the real/physical engine speed is e.g. 0 rpm or 5000 rpm.
      data PtEngNSpIdle: type=N2  # Powertrain: Engine Idle Speed Setpoint
    PtFlgAcDeactvt1  # Powertrain: Request to Deactivate Air Conditioner (A/C) | Request to deactivate Air Conditioner (A/C) 0 = no deactivation of A/C requested 1 = deactivation of A/C requested
    PtFlgAcDeactvtReq1  # Powertrain: Request to Deactivate Air Conditioner (A/C) | Request to deactivate Air Conditioner (A/C) 0 = no deactivation of A/C requested 1 = deactivation of A/C requested.
      data PtFlgAcDeactvtReq: type=Flg1
    PtFlgAltDeactvt1  # Powertrain: Request to Deactivate Alternator (Generator) | Request to deactivate Alternator (generator) 0 = no deactivation of Alternator requested 1 = deactivation of Alternator requested
      data PtFlgAltDeactvt: type=Flg1
    PtFlgAltDeactvtReq1  # Powertrain: Request to Deactivate Alternator (Generator) | Request to deactivate Alternator (generator) 0 = no deactivation of Alternator requested 1 = deactivation of Alternator requested.
      data PtFlgAltDeactvtReq: type=Flg1
    PtFlgDrvOvrdVlc1  # Powertrain: Driver Request Overrides Vehicle Longitudinal Control (VLC) | Flag is set to 1 if driver request overrides Vehicle Longitudinal Control (VLC), otherwise the flag is set to 0
      data PtFlgDrvOvrdVlc: type=Flg1
    PtFlgEngRun1  # Powertrain: Engine Is Running | Powertrain: Cranking finished and engine is running 0 = engine not running 1 = engine running
      data PtFlgEngRun: type=Flg1
    PtFlgEngStop1  # Powertrain: Engine Is Stopped | Powertrain: Engine is stopped 0 = engine not stopped 1 = engine stopped
      data PtFlgEngStop: type=Flg1
    PtFlgEngStopReq1  # Powertrain: Engine Stop Request | Powertrain: Engine stop request 0 = no request to stop engine 1 = request to stop engine
      data PtFlgEngStopReq: type=Flg1
    PtFlgEngStopReqAllwd1  # Powertrain: Request to Stop Engine Is Allowed | Powertrain: Request to stop engine is allowed 0 = request to stop engine not allowed 1 = request to stop engine allowed
      data PtFlgEngStopReqAllwd: type=Flg1
    PtFlgEngStrtReq1  # Powertrain: Engine Start Request | Powertrain: Engine start request 0 = no request to start engine 1 = request to start engine
      data PtFlgEngStrtReq: type=Flg1
    PtFlgEngStrtReqAllwd1  # Powertrain: Request to Start Engine Is Allowed | Powertrain: Request to start engine is allowed 0 = request to start engine not allowed 1 = request to start engine allowed
      data PtFlgEngStrtReqAllwd: type=Flg1
    PtFlgHvacDeactvt1  # Powertrain: Request to Deactivate Air Conditioner (A/C) | Request to deactivate Air Conditioner (A/C) 0 = no deactivation of A/C requested 1 = deactivation of A/C requested
      data PtFlgHvacDeactvt: type=Flg1
    PtFlgNoTqWhlReq1  # Powertrain: No Torque Request for Wheel Torque | Wheel torque request below or equal a certain threshold. Torque demands considered : Driver (accelerator pedal), Cruise Control, Adaptive Cruise Control, Variable Vehicle Speed Limitation, Torque increase by Electronic Stability Control (ESC) [engine drag torque control (MSR)] | 0: Torque request above threshold 1: Torque request below or equal threshold e.g. threshold could be given by loss torques or a calibration value
      data PtFlgNoTqWhlReq: type=Flg1
    PtFlgTqDecPsbl1  # Powertrain: Torque Decrease Possible | A decrease of powertrain torque is possible (especially for Electronic Stability Control (ESC)). | If the limit of torque realization is reached during an intervention, the bit will change to false. 0 = decrease of powertrain torque is not possible 1 = decrease of powertrain torque is possible
      data PtFlgTqDecPsbl: type=Flg1  # A decrease of powertrain torque is possible (especially for Electronic Stability Control (ESC)). | If the limit of torque realization is reached during an intervention, the bit will change to false. 0 = decrease of powertrain torque is not possible 1 = decrease of powertrain torque is possible
    PtFlgTqIncPsbl1  # Powertrain: Torque Increase Possible | An increase of powertrain torque is possible (especially for Electronic Stability Control (ESC)). | If the limit of torque realization is reached during an intervention, the bit will change to false. 0 = increase of powertrain torque is not possible 1 = increase of powertrain torque is possible
      data PtFlgTqIncPsbl: type=Flg1  # An increase of powertrain torque is possible (especially for Electronic Stability Control (ESC)). | If the limit of torque realization is reached during an intervention, the bit will change to false. 0 = increase of powertrain torque is not possible 1 = increase of powertrain torque is possible
    PtFuCutCoastActv1  # Powertrain: Fuel Cut-Off in Coast Active | Fuel cut-off in coast is active. | Fuel cut-off is active for all cylinders of the combustion engine. Typically used for activating adaptation functions in the transmission controller. At initialization, "fuel cut-off inactive" is sent. 0 = Fuel cut-off is inactive 1 = Fuel cut-off is active
      data PtFuCutCoastActv: type=Flg1  # Powertrain: Fuel Cut-Off in Coast Active
    PtGearLvrLockReq1  # Powertrain: Gear Lever Lock Request | Locking the gear lever is requested by powertrain. | Locking the gear lever is requested by the powertrain. Typically used to lock the gear lever in the parking position until the driver presses the brake to prevent an unintended vehicle acceleration. The signal is also named "Shift Lock Request". 0 = not requested 1 = requested
      data PtGearLvrLockReq: type=ReqSt1  # Powertrain: Gear Lever Lock Request
    PtKdDetd1  # Powertrain: Kickdown Detected | Accelerator pedal is in a kickdown position. | The kickdown switch is pressed or the accelerator pedal position is greater than a threshold. 0 = no kickdown (Flag reset) 1 = kickdown (Flag set)
      data PtKdDetd: type=Flg1  # Powertrain: Kickdown Detected
    PtNClu1  # Speed at Clutch from Powertrain | This interface is used only for vehicles, where the engine speed can be different from the speed at converter or clutch. This signal is a combination of the engine speed and the speed of the electric machine, at the engine/electric machine side of the transmission clutch or converter. | Definition of "Clutch": Signal is sent with initialisation. for Automatic Transmission (AT), Continuously Variable Transmission (CVT) it is the converter clutch for Manual Transmission (MT), Automatic Manual Transmission (AMT) it is the clutch between the gear box and the engine drivetrain.
      data PtNClu: type=N1
    PtNEngSp1  # Powertrain: Engine Speed Setpoint | calculated engine speed setpoint e.g. idle engine speed setpoint during idle | Default value after reset: zero
      data PtNEngSp: type=N1
    PtNrTypEmTqRelCluReq1  # Powertrain: Implementation Type of Electric Machine Relative Torque at Clutch Requested by Powertrain | Defines reference point and the coordination of the relative torque at clutch request to the electric machine. | The reference point is the driver requested torque (reference point for relative requests). 0 = no request => the powertrain does not send a request. 1 = absolute maximum => the powertrain requests an absolute upper limit for the torque to be produced by the electric machine. The real electric machine torque is permitted to be lower. It may be lower due to driver request or due to interventions by other systems. This case is usually used for torque decrease requests. 2 = absolute minimum => the powertrain requests an absolute lower limit for the torque to be produced by the electric machine. The real electric machine torque is permitted to be higher. It may be higher due to driver request or due to interventions by other systems. This case is usually used for torque increase requests. 3 = absolute exact => the powertrain requests exactly the torque to be produced by the electric machine. The real electric machine torque must comply with the request. This case is usually used for exact torque requests independently of whether the request is an increase or a decrease. 4 = relative => the powertrain requests a torque relative to the reference "Powertrain: Torque at Clutch without Transmission Intervention”. The torque request to be implemented is the sum of "Powertrain: Torque at Clutch without Transmission Intervention" and "Powertrain: Electric Machine Relative Torque at Clutch Requested by Powertrain”. If the sign of the relative torque request is positive, then the sum is treated as in case "2 = absolute minimum". If the sign of the relative torque request is negative, then the sum is treated as in case "1 = absolute maximum". Advantage of the relative request: It immediately follows dynamic changes in the reference. It does not depend strongly on communication time delays. This signal does not define whether or not the intervention of stability control has priority over the intervention of the powertrain. The signal can be used in both cases. The priority of stability control versus powertrain intervention is not part of this definition. References to other signals: PtTqCluWoTrsmIntv PtEmTqRelCluReq
      data PtNrTypEmTqRelCluReq: type=TrsmTqReqTyp2  # Powertrain: Implementation Type of Electric Machine Relative Torque at Clutch Requested by Powertrain
    PtRatTqDistbnReq1  # Powertrain: Requested Percental Distribution of Torque to Wheels | This interface only considers the torque which can be distributed from one or more central torque producers to the wheels by the transmission system. It does not consider additional torque producers located e.g. at the individual wheels. Where no torque is distributed to the wheels by the transmission system (e.g. one axle not driven or directly driven by an electric machine), the respective values are zero. The sum of all 4 values must be 100%.
      4 x data, all with type=Perc1:
        PtRatTqDistbnReqFrntLe  # Front left wheel
        PtRatTqDistbnReqFrntRi  # Front right wheel
        PtRatTqDistbnReqReLe  # Rear left wheel
        PtRatTqDistbnReqReRi  # Rear right wheel
    PtTqClu1  # Powertrain: Torque at Clutch | Indicated torque of combustion engine plus torque of electric machine, if present, plus internal engine torque losses plus all losses with an effect on the torque at clutch. The effect of inertia on the torque is not considered. | Torque at clutch is a torque at the mechanical interface between engine and transmission. For manual transmissions, the mechanical interface is the primary side of the clutch, for automatic transmissions, this is the primary side of the converter. Torque at clutch considers the following contributors, if present: 1) Indicated torque of combustion engine, calculated on basis of injection timing and injected fuel, ignition angle and air mass. 2) Torque of electric machine at clutch level. 3) Internal engine torque losses such as friction, pumping, mechanically driven water pump, etc. 4) Ancillary torque losses with an effect on the torque at clutch caused by the alternator, air conditioning, power steering, etc. The calculation of this signal by the provider is not permitted to consider the inertia, which has an effect on the torque at clutch. This means that the signal must be calculated as if the inertia is 0 kg*(m^2). Loss differences from engine to engine and variable torque losses over the life cycle must be considered. In parallel hybrid projects, the combustion engine torque must be considered depending on the engine clutch state. If there is a mechanically driven transmission oil pump, then the oil pump is a consumer of the transmission, not a consumer of the engine. So the oil pump drive torque is not permitted to be subtracted by the provider of this signal. The signal can be calculated based on “Engine: Torque at Crankshaft”, so this signal includes all torque requests from accelerator pedal, cruise control, speed limiter, etc. and all interventions such as torque and speed interventions. Hint for implementation: The torque is a cylinder average, not a time average, via two crankshaft revolutions of all cylinders, in consideration of the current operating parameters. The operating parameters include engine temperature, ignition timing and air mass measured or calculated, lambda, fuel cut level, fuel quantity, injection timing, knock control adaption, geographic altitude and others. References to other signals: EngTqCrksft
      data PtTqClu: type=Tq5  # Powertrain: Torque at Clutch
    PtTqCluDyn1  # Powertrain: Dynamic Torque at Clutch | This interface has to consider all engine internal and auxiliary inertia torques, but no transmission inertia torques. | Example of usage: Used for Transmission to calculate a predictive slipping time of the clutch to prepare an ideal termination of shifting. Note the definition of "dynamic torque correction": This signal has to consider all internal inertia torques of specific components. Dynamic Torque at Clutch = Torque At Clutch + Engine dynamic moment of inertia. Default value after reset is zero.
      data PtTqCluDyn: type=Tq5
    PtTqCluEngMaxProtnReq1  # Powertrain: Maximum Torque at Engine Clutch Requested by Powertrain Coordinator for Engine Clutch Protection | Maximum torque for engine clutch protection, independent of direction/ sign of the torque. | The maximum torque is independent of the sign of the torque, i.e. of the direction of the torque flow. The actual torque at engine clutch depends on the combustion engine torque, the electric machine torque, the transmission input torque and on the torque of inertia.
      data PtTqCluEngMaxProtnReq: type=Tq5  # Powertrain: Maximum Torque at Engine Clutch Requested by Powertrain Coordinator for Engine Clutch Protection
    PtTqCluMaxCluNCurLongTerm1  # Powertrain: Maximum Torque at Clutch at Current Clutch Speed Long Term Attainable | Maximum possible torque at clutch at current clutch speed which is long term attainable. | For non-hybrid projects this signal reflects the full load engine torque at clutch at current engine speed which the engine could implement within a long time period, especially when maximally charged. It is calculated at current ambient pressure and air temperature and includes the static power limitation of the engine. In parallel hybrid projects, the signal is the sum of the maximum torque of combustion engine and electric machine, considering the engine clutch state. The static power limitation contains, e.g., restrictions for protection and static soot limitation. Permanent knock limitation is considered, knock control is not considered. The calculation of this signal by the provider is not permitted to consider the inertia, which has an effect on the torque at clutch. This means that the signal must be calculated as if the inertia is 0 kg*(m^2). Example for accuracy requirements in a typical series project: ±5 %.
      data PtTqCluMaxCluNCurLongTerm: type=Tq5  # Powertrain: Maximum Torque at Clutch at Current Clutch Speed Long Term Attainable
    PtTqCluMaxCluNCurShoTerm1  # Powertrain: Maximum Torque at Clutch at Current Clutch Speed Short Term Attainable | Maximum possible torque at clutch at current clutch speed which is short term attainable. | For non-hybrid projects this signal reflects the full load engine torque at clutch at current engine speed, which the engine could implement within a short time period, for example, 200 ms. This period must be defined in close cooperation between engine experts and transmission experts. It is calculated at current ambient pressure and air temperature and includes the static power limitation of the engine. In parallel hybrid projects, the signal is the sum of the maximum torque of combustion engine and electric machine, considering the engine clutch state. The static power limitation contains, e.g., restrictions for protection and static soot limitation. Permanent knock limitation is considered, knock control is not considered. The calculation of this signal by the provider is not permitted to consider the inertia, which has an effect on the torque at clutch. This means that the signal must be calculated as if the inertia is 0 kg*(m^2). Example for accuracy requirements in a typical series project: ±5 %.
      data PtTqCluMaxCluNCurShoTerm: type=Tq5  # Powertrain: Maximum Torque at Clutch at Current Clutch Speed Short Term Attainable
    PtTqCluMaxDrv1  # Powertrain: Maximum Available Torque at Clutch for Driver | Maximum possible torque at clutch at optimum conditions delivered by powertrain for driver. | Example of realization: Could take into account: current engine speed, ambient pressure, air temperature, static power limitation due to engine, auxiliaries (everything with impact to the torque output, e.g. power steering pump, Air Conditioner (A/C), generator or starter generator), smoke limitation, fuel quality correction. Including maximum overboost.
      data PtTqCluMaxDrv: type=Tq5
    PtTqCluMinByIgnRtd1  # Powertrain: Minimum Torque at Clutch By Ignition Retard | Minimum torque at clutch, which the powertrain can provide in the short term, e.g. on engine side by the minimum permitted ignition angle. Cylinder cut-off must NOT be considered. | This signal is needed by the transmission to determine the intensity of the torque intervention. The signal is necessary for the shift strategy to guarantee a comfortable operation of the powertrain system. The engine contribution to this signal is calculated at current engine speed with current air mass, current ambient pressure and current air temperature. In parallel hybrid projects, the torque coordinator must additionally consider the min. torque, which the electric machine(s) could implement at clutch in the current operating point. In projects with engine clutch, the current state of the engine clutch must be considered. The calculation of this signal by the provider is not permitted to consider the inertia, which has an effect on the torque at clutch. This means that the signal must be calculated as if the inertia is 0 kg*(m^2). Example for accuracy requirements in a typical series project: ±7 % or ±5 Nm (max. selection), max. deviation ±20 Nm.
      data PtTqCluMinByIgnRtd: type=Tq5  # Powertrain: Minimum Torque at Clutch By Ignition Retard
    PtTqCluMinDrv1  # Powertrain: Minimum Available Torque at Clutch for Driver | Minimum possible torque at clutch delivered by powertrain for driver. | Example of realization: Could take into account: Losses of auxiliaries, integral part of idle speed controller, indicated torque, engine friction, fuel cut off.
      data PtTqCluMinDrv: type=Tq5
    PtTqCluMinFast1  # Powertrain: Minimum Torque at Clutch Fast Path | Minimum torque at clutch, which the powertrain can provide in the short term, e.g. on engine side by the minimum permitted ignition angle and cylinder cut-off. | This signal is needed by the transmission to determine the intensity of the torque intervention. The engine contribution to this signal is calculated at current engine speed with current air mass, current ambient pressure and current air temperature. In parallel hybrid projects, the torque coordinator must additionally consider the min. torque, which the electric machine(s) could implement at clutch in the current operating point. In projects with engine clutch, the current state of the engine clutch must be considered. The calculation of this signal by the provider is not permitted to consider the inertia, which has an effect on the torque at clutch. This means that the signal must be calculated as if the inertia is 0 kg*(m^2). Example for accuracy requirements in a typical series project: ±7 % or ±5 Nm (max. selection), max. deviation ±20 Nm.
      data PtTqCluMinFast: type=Tq5  # Powertrain: Minimum Torque at Clutch Fast Path
    PtTqCluReqWoTrsmIntv1  # Powertrain: Requested Torque at Clutch without Transmission Intervention | Driver torque request including all interventions except transmission shift interventions and including all limitations. | Limitations include environmental conditions such as altitude, temperature, etc. and engine limitations such as soot limitation, full load limit, etc. The goal is that the torque information is sent 50 – 80 ms ahead of the desired real/physical torque. For further explanation see signal "Powertrain: Driver Request of Torque at Clutch". In parallel hybrid projects, the signal is the sum of the torque request to the electric machine and that part of the torque request to the combustion engine, which is transferred by the engine clutch. The sum does not consider the transmission intervention. References to other signals: PtDrvrReqTqClu
      data PtTqCluReqWoTrsmIntv: type=Tq5  # Powertrain: Requested Torque at Clutch without Transmission Intervention
    PtTqCluTarGear1  # Powertrain: Predicted Torque at Clutch at Target Gear | Used for Dual Clutch Transmission (DCT) to calculate the clutch pressure to terminate the shifting comfortably. This torque is calculated with actual pedal position and an engine speed at target gear. | Default value after reset is zero.
      data PtTqCluTarGear: type=Tq5
    PtTqCluWoTrsmIntv1  # Powertrain: Torque at Clutch without Transmission Intervention | Torque at clutch that would be implemented if no transmission shift interventions are active. | Outside of a transmission intervention, the signal should show the same value as "Powertrain: Torque at Clutch”. Highly dynamic torque contributions by anti jerk are not visible, in contrary to signal “Powertrain: Torque at Clutch”. During interventions, the signal should show the desired torque without considering the intervention, independent of implementation by ignition, air, cylinder cutoff. The effects of the transmission request for shifts on the air path or cylinder cutoff are NOT considered, not even if the fast path request can only be implemented by affecting the air path or cylinder cutoff. The calculation of this signal by the provider is not permitted to consider the inertia, which has an effect on the torque at clutch. This means that the signal must be calculated as if the inertia is 0 kg*(m^2). References to other signals: PtTqClu
      data PtTqCluWoTrsmIntv: type=Tq5  # Powertrain: Torque at Clutch without Transmission Intervention
    PtTqCrksftRedByAncllryLossReq1  # Powertrain: Requested Torque at Crankshaft Reduced by Ancillary Losses | Requested torque at crankshaft reduced by ancillary losses, including all interventions, including all limitations. | The signal contains the limitations which are closely related to the combustion engine or which are attributed to the combustion engine by the powertrain coordinator. The calculation of this signal by the provider is not permitted to consider the inertia, which has an effect on the torque at clutch. This means that the signal must be calculated as if the inertia is 0 kg*(m^2). The signal contains all interventions. The goal is that the torque information is sent 50 – 80 ms ahead of the desired real/physical torque.
      data PtTqCrksftRedByAncllryLossReq: type=Tq5  # Powertrain: Requested Torque at Crankshaft Reduced by Ancillary Losses
    PtTqCrksftReqFast1  # Crankshaft Torque Request to Be Realized by the Fast Path of Powertrain | Required crankshaft torque which should be generated by engine. The engine will restrict this request to its internal limits. | Example of realization: Including fast torque intervention from brake control, transmission control etc.
      data PtTqCrksftReqFast: type=Tq5
    PtTqCrksftReqSlow1  # Crankshaft Torque Request to Be Realized by the Slow Path of Powertrain | Crankshaft torque which should be realized by the slow path to prepare the engine for a future torque setpoint. The engine will restrict this request to its internal limits. | Example of realization: If there is no distinction between slow and fast path control within the engine management (e.g. for a Diesel engine), this signal can be ignored by the engine management. Without fast torque intervention from brake control, transmission control etc.
      data PtTqCrksftReqSlow: type=Tq5
    PtTqDistbnToWhls1  # Powertrain Torque Distribution to Wheels | Generic interface to represent the torque distribution at four wheels. The sum of all 4 values must be 100%.
      data PtTqDistbnPerWhl: type=PtTqDistbnPerWhl1
    PtTqJClu1  # Powertrain: Torque of Inertia at Clutch | Dynamic moment of inertia of all components of the drive unit on clutch level. Definition of the sign: An increasing speed produces a negative sign; a decreasing speed produces a positive sign. | The signal contains the dynamic torque caused by the inertia which increases or decreases the torque at clutch. The engine internal inertia and the inertia of the ancillaries up to the clutch must be considered. In parallel hybrid projects, the inertia of combustion engine and electric machine are considered. Additionally, the inertia of engine clutch must be considered.
      data PtTqJClu: type=Tq5  # Powertrain: Torque of Inertia at Clutch
    PtTqMaxAc1  # Powertrain: Maximum Allowed Torque for A/C Compressor | Allowable torque for Air Condition (A/C) compressor. It is an engine crankshaft torque. | Examples of realization: This interface could contain either the torque that the Air Conditioning (A/C) compressor is allowed to consume in steady state the highest torque that the Air Condition (A/C) compressor is allowed to consume at any point in time
    PtTqMaxAlt1  # Powertrain: Maximum Allowed Alternator Load | Allowed mechanical load for alternator (generator) at engine crankshaft.
      data PtTqMaxAlt: type=Tq6
    PtTqMaxHvac1  # Powertrain: Maximum Allowed Torque for A/C Compressor | Allowable torque for Air Condition (A/C) compressor. It is an engine crankshaft torque. | Examples of realization: This interface could contain either the torque that the Air Conditioning (A/C) compressor is allowed to consume in steady state the highest torque that the Air Condition (A/C) compressor is allowed to consume at any point in time
      data PtTqMaxHvac: type=Tq6
    PtTqMaxSteer1  # Powertrain: Maximum Allowed Mechanical Load for Steering at Engine Crankshaft | Allowed mechanical load for steering at engine crankshaft. | In case of electric steering, this should be zero Nm, because the load is included in alternator load.
      data PtTqMaxSteer: type=Tq6
    PtTqMaxTrsmOilPmp1  # Powertrain: Maximum Allowed Transmission Oil Pump Load | Maximum allowed transmission oil pump load at engine crank shaft. | If the oil pump is driven by the engine crank shaft then this value must take into account all relevant dynamic effects. If it is an electric oil pump, the value should be zero Nm, because the load is included in alternator load. The value of this signal is converted to engine crank shaft torque by the provider.
      data PtTqMaxTrsmOilPmp: type=Tq6
    PtTqResvEng1  # Torque Reserve Request from Powertrain to Engine | Reserved torque request coordinated in the Powertrain coordinator (PTC) to be realized by the combustion engine. The coordination can consider multiple reserved torque requirements, e.g. auxiliary loads such as Air Conditioning (A/C) compressor. | Default value after reset is zero.
      data PtTqResvEng: type=Tq5
    PtTqResvReqEng1  # Torque Reserve Request from Powertrain to Engine | Reserved torque request coordinated in the Powertrain coordinator (PTC) to be realized by the combustion engine. The coordination can consider multiple reserved torque requirements, e.g. auxiliary loads such as Air Conditioning (A/C) compressor. | Default value after reset is zero.
      data PtTqResvReqEng: type=Tq5
    PtTqTotAtWhls1  # Total Powertrain Torque at Wheels | Generic interface for total powertrain torque at wheels
      data PtTqTotAtWhls: type=Tq7
    PtTqTotAtWhls2  # Total Powertrain Torque at Wheels (Min/Max) | Generic interface for total powertrain torque at wheels with elements for minimum and maximum value
      data Max: type=Tq7  # Maximum
      data Min: type=Tq7  # Minimum
    PtTqWhl1  # Total Wheel Torque Provided by Powertrain | Total wheel torque provided by powertrain (sum of torques at wheels) | This interface contains a value that is computed from "Actual torque at clutch" and other torque losses with influence on wheel torque (e.g. converter, differential). It considers all torque interventions. It includes the actual torque ratio. Negative values indicate drag torque, independently from driving direction.Default value after reset is zero.
      data PtTqWhl: type=Tq7
    PtTqWhlInd1  # Individual Torque at Wheel delivered by Powertrain | Vector of 4 values. Consolidated torque delivered by the powertrain to the individual wheels. The sum of all 4 values must be equal to actual total powertrain torque at wheels. | In case of actuator/sensor failures or if there is no possibility to determine the correct distribution, a rough estimation is done.
      4 x data, all with type=Tq7:
        PtTqWhlIndFrntLe  # Front left wheel
        PtTqWhlIndFrntRi  # Front right wheel
        PtTqWhlIndReLe  # Rear left wheel
        PtTqWhlIndReRi  # Rear right wheel
    PtTqWhlMax1  # Powertrain: Maximum Possible Total Torque at Wheels | Maximum possible total torque at wheels. | Example of realization: Could take into account: current engine speed, ambient pressure, air temperature, static power limitation due to engine, auxiliaries (everything with impact to the torque output, e.g. power steering pump, Air Conditioner (A/C), generator or starter generator), smoke limitation, fuel quality correction. Including actual overboost (whilst temporarily active triggered by driver request). The calculation of torque at wheel could take into account the current gear, hydraulic converter and all losses in the transmission system.Must be initialised to the upper limit of the chosen data type.
      data PtTqWhlMax: type=Tq7
    PtTqWhlMaxDrv1  # Maximum Possible Total Torque at Wheels at Optimum Conditions Delivered by Powertrain for Driver | Maximum possible total torque at wheels at optimum conditions delivered by powertrain for Driver | Example of realization: Could take into account: current engine speed, ambient pressure, air temperature, static power limitation due to engine, auxiliaries (everything with impact to the torque output, e.g. power steering pump, Air Conditioner (A/C), generator or starter generator), smoke limitation, fuel quality correction. Including maximum overboost. The calculation of torque at wheel could take into account the current gear, hydraulic converter and all losses in the transmission system.Must be initialised to the upper limit of the chosen data type.
      data PtTqWhlMaxDrv: type=Tq7
    PtTqWhlMin1  # Minimum Available Total Powertrain Torque at Wheels | Minimum possible total powertrain torque at wheels "for unfired engine". Lowest possible value of the torque delivered to the wheels by the powertrain assuming that complete fuel cut off is enabled. | Example of realization: Could take into account: Losses of auxiliaries, engine friction, complete fuel cut off'Must be initialised to the lower limit of the chosen data type.'
      data PtTqWhlMin: type=Tq7
    PtTqWhlMinDrv1  # Minimum Possible Total Torque at Wheels Delivered by Powertrain for Driver | Minimum possible total torque at wheels delivered by powertrain for driver | Example of realization: Could take into account: Losses of auxiliaries, integral part of idle speed controller, indicated torque, engine friction, fuel cut off'Must be initialised to the lower limit of the chosen data type.'
      data PtTqWhlMinDrv: type=Tq7
    PtTqWhlMinWoCutOff1  # Minimum Possible Total Powertrain Torque at Wheels without Complete Fuel Cut Off | Minimum possible total powertrain torque at wheels without complete fuel cut off. | Any torque value between minimum and maximum can be requested and it is expected that the Powertrain Coordinator (PTC) will deliver that value. Example of realization: Could take into account: Losses of auxiliaries, integral part of idle speed controller, indicated torque, engine friction, fuel cut off Complete fuel cut off excluded, since these are just the complete losses. This is the minimum torque value which can be achieved without any discontinuity and/or impact on emissions.Must be initialised to the lower limit of the chosen data type.
      data PtTqWhlMinWoCutOff: type=Tq7
    PtTqWhlReq1  # Powertrain: Total Requested Propulsion Wheel Torque | Total requested propulsion wheel torque (sum of torques at wheel). Output wheel torque request from powertrain coordinator (includes wheel torque requests driver / Vehicle Longitudinal Control (VLC) / Electronic Stability Control (ESC) ). | Negative values indicate drag torque, independently from driving direction.
      data PtTqWhlReq: type=Tq7
    PtTqWhlReqDrvVlc1  # Powertrain: Total Requested Propulsion Wheel Torque by the Driver or Vehicle Longitudinal Control (VLC) | Total requested propulsion wheel torque (sum of torques at wheel) by the driver or Vehicle Longitudinal Control (VLC). Result of arbitration of driver vs. driver assistance functions in powertrain coordinator. | Negative values indicate drag torque, independently from driving direction.
      data PtTqWhlReqDrvVlc: type=Tq7
    PullAidCmd1  # Pull Aid Command | This is the functional command to the actuator component to execute activation of pull/ push aid.
      data Cmd: type=PullAidCmd1
    PwrSplySt1  # Power Supply Status | Current power supply status
      data PwrSplySt: type=TerminalPosnMod1
    PwrSplySts1  # Power Supply Status | Current power supply status
      data PwrSplySts: type=TerminalPosnMod1
    RadioFrqPanicReq1  # Radio Frequency Panic Request | Request to activate Panic alarm from Radio Frequency (RF)
      data Req: type=OnOff1  # OFF - no request ON - request active
    RadioSt1  # Radio Status | Radio presence status
      data St: type=OnOff1  # Off - not present On - present
    RadioSts1  # Radio Status | Radio presence status
      data Sts: type=OnOff1  # Off - not present On - present
    RainAmntSt1  # Rain Amount Status | amount of rain detected by the rain sensor | 0 %: no rain, 100 % maximum rain, any percentage in between could be mapped into different rain amount levels
      data Amnt: type=Perc2
    RainAmntSts1  # Rain Amount Status | amount of rain detected by the rain sensor | 0 %: no rain, 100 % maximum rain, any percentage in between could be mapped into different rain amount levels
      data Amnt: type=Perc2
    RainSenErr1  # Rain Sensing Error | Provides information if there is a rain sensor failure detected (e.g. broken or no adaptation to windscreen possible)
      data St: type=DevErrSt2
    RainSenReq1  # Rain Sensing Request | Request switching on / off rain sensing and a rain sensing sensitivity level.
      data SenReq: type=OnOff1  # Request switching on / off rain sensing. After the request the value should be kept as long as no other request is sent.
      data SenSnvtyVal: type=RainSenSnvty1  # Requests the front wiper rain sensing sensitivity. Values are typically provided by Human Machine Interface (HMI). As long as a sensitivity for automatic wipe sequence is requested, the provided value of sensitivity has to be used.
    RideHeiLvl1  # Ride Height Level 1 | Generic interface for ride height level
      data RideHeiLvl: type=Len1
    RoadBnkAEstimn1  # Road Bank Acceleration Estimation 1 | Acceleration component resulting from a banked road. Rotation about x-axis, angle between z-y-axis. Coordinate system according to ISO 8855. | Note that this signal will not be reliable and probably must be replaced by function specific signals, e.g. to prevent wrong interventions
      data RoadBnkAEstimn: type=A3
    RoadCdnSt1  # Road Condition Status | Road condition
      data RoadCdn: type=RoadSt1
    RoadCdnSts1  # Road Condition Status | Road condition
      data RoadCdn: type=RoadSts1
    RoadExct1  # Road Excitation 1 | Vertical wheel oscillation amplitude and frequency (wheel and tire) (based on acceleration or displacement)
      data RoadExct: type=RoadExct1
    RoadInclnAEstimn1  # Road Inclination Acceleration Estimation 1 | Acceleration component resulting from road inclination. Measured in vehicle coordinates. Estimated from longitudinal acceleration from wheel speeds and acceleration sensor.
      data RoadInclnAEstimn: type=A3  # the resolution of the inclination is the resolution of A3 divided by the earth gravity (9.81 m/s^2)
    RoadWhlAg1  # Road Wheel Angle 1 | Generic interface for road wheel angle
      data RoadWhlAg: type=Ag3
    RoadWhlAg2  # Road Wheel Angle 2 | Generic interface for total road wheel angle
      data RoadWhlAg: type=Ag4
    RoadWhlAgSpd1  # Road Wheel Angle Speed 1 | Generic interface for road wheel angle speed
      data RoadWhlAgSpd: type=AgSpd2
    RollCmpLvl1  # Roll Compensation Level 1 | The actual compensation level of the body roll angle. (100% = Zero roll angle, 0% = Both stabilizers decoupled)
      data RollCmpLvl: type=Perc2
    RollMomtmDistbn1  # Roll Momentum Distribution 1 | Estimated stabilizer roll torque difference front to rear defined relative to the total stabilizer torque (front and rear) (100%: Only stabilizer torque on front, 0%: Only stabilizer torque on rear)
      data RollMomtmDistbn: type=Perc2
    RollRate1  # Roll Rate 1 | Roll Rate from sensor element. Coordinate system according to ISO 8855.
      data RollRate: type=AgSpd3
    RollRate2  # Roll Rate 2 | Roll Rate from sensor element. Coordinate system according to ISO 8855. Extended signal range
      data RollRate: type=AgSpd4
    RollRate3  # Roll Rate for Occupant and Pedestrian Safety | Roll Rate from sensor element. Coordinate system according to ISO 8855. Extended signal range
      data RollRate: type=AgSpd8
    RoofCnvtbCmd1  # Roof Convertible Command | Command for convertible operation
      data Cmd: type=OnOff1
    RoofCnvtbReq1  # Roof Convertible Request | Request for convertible
      data Req: type=OnOff1
    RoofCnvtbSt1  # Roof Convertible Status | Status of the convertible roof [Opened or closed]
      data St: type=OpendClsd1
    RoofCnvtbSts1  # Roof Convertible Status | Status of the convertible roof [Opened or closed]
      data Sts: type=OpendClsd1
    RscCtrlDi1  # RSC Control Disable 1 | Roll Stability Control is disabled due to detected fault or ECU initialization
      data RscCtrlDi: type=DevErrSt2  # 0= Rsc enabled 1 = Rsc Control Disabled due to detected fault
    RscCtrlIntvgPerWhl1  # RSC Control Intervening per Wheel 1 | Confirmation that Roll Stability Control (RSC) is in control. Information of "ability type".
      data RscCtrlIntvgPerWhl: type=RscCtrlIntvgPerWhl1
    SeatAdjAut1  # Seat Adjust Automatic | Request to move the seat automatically to a stored position or to store the actual position to the memory position "profile".
      data Req: type=AdjAut1
    SeatAdjMan1  # Seat Adjust Manual | Request to move the axis of the seat manually to a certain direction.
      data Req: type=MovmtTyp1
    SeatAxisPosnSt1  # Seat Axis Position Status | Status of the seat axis
      data St: type=ActrSt1
    SeatAxisPosnSts1  # Seat Axis Position Status | Status of the seat axis
      data Sts: type=ActrSts1
    SeatBltRmnAcoustWarnReq1  # Seat Belt Reminder Acoustic Warning Request | Request to sound an acoustic warning on unbuckled occupants (only covering seat positions under control of occupant detection) dependent on optionally given adjustments
      data Req: type=ReqSt1  # 0: no acoustic warning 1: sound an acoustic warning
    SeatBltRmnFrqCtrlAcoustWarn1  # Seat Belt Reminder Frequenz Control Acoustic Warning | Control of warning frequency to sound in case of unbuckled occupants detected
      data Frq: type=Frq2
    SeatBltRmnLdnCtrlAcoustWarn1  # Seat Belt Reminder Loudness Control Acoustic Warning | Control of warning loudness to sound in case of unbuckled occupants detected
      data Vol: type=Perc2
    SeatBltRmnOpticWarnReq1  # Seat Belt Reminder Optical Warning Request | Request to display a warning on unbuckled occupants (only covering seat positions under control of occupant detection).
      data Req: type=ReqSt1  # 0: warning not active 1: warning active
    SeatBltRmnWarnSt1  # Seat Belt Reminder Warning State | Warning state of seat belt reminder control
      data WarnSt: type=SeatBltRmnWarnSt1
    SeatClimaCmd1  # Seat Climatization Command | Activation/deactivation of seat climatization actuator
      data SeatClimaCmd: type=OnOff1  # Activation/Deactivation
    SeatFixaSt1  # Seat Fixation Status | Status of seat fixation for seat position
      data St: type=Fixa1  # 0: seat position is not probably fixed (e.g. seat back) or not equipped - occupant is not able to take place on seating position 1: seat position is probably equipped and fixed - occupant is able to take place
    SeatFixaSts1  # Seat Fixation Status | Status of seat fixation for seat position
      data Sts: type=Fixa1  # 0: seat position is not probably fixed (e.g. seat back) or not equipped - occupant is not able to take place on seating position 1: seat position is probably equipped and fixed - occupant is able to take place
    SeatMove1  # Seat Move | Request or command to move the axis of the mentioned seat to the indicated position, with a certain speed.
      data Req: type=SeatMove1
    SeatMoveAutReq1  # Seat Move Automatic Request | Request to move the seat automatically in a certain position. This position could be determined by a user request from the seat panel, an access from the remote key, a keyless access, driver easy entry request or if reverse gear was detected, to move the headrest in the "down position". If it is clear, that the driver is outside the car (e.g. easy entry) it may be necessary to move the seat very fast. In this case 'high speed' indicates this situation
      data Req: type=SeatMoveAut1
    SeatMoveSt1  # Seat Move Status | feedback of the seat manager which kind of action is currently running. It might be necessary to immediately stop automatic positioning if the driver hits any key (panic-stop)
      data MoveSt: type=MoveSt1
    SeatMoveSts1  # Seat Move Status | feedback of the seat manager which kind of action is currently running. It might be necessary to immediately stop automatic positioning if the driver hits any key (panic-stop)
      data MoveSts: type=MoveSts1
    SeatStorePosnReq1  # Seat Store Position Request | Request to store the position of a certain seat and a certain axis to the memory position "profile".
      data Req: type=SeatStorgPosn1
    SeatStorePosnSt1  # Seat Store Position Status | Interface provides information about the position of a certain seat and a certain axis as previously stored in the memory position "profile".
      data St: type=SeatStorgPosn1
    SeatStorePosnSts1  # Seat Store Position Status | Interface provides information about the position of a certain seat and a certain axis as previously stored in the memory position "profile".
      data Sts: type=SeatStorgPosn1
    SeatTCmd1  # Seat Temperature Command | Command to the seat adapter with the seat temperature level required
      data SeatT: type=T1
    SeatTVal1  # Seat Temperature Value | Feedback from the seat temperature sensor about its actual temperature level
      data SeatT: type=T1
    SetSpd1  # Set Speed 1 | Actual target speed, set by the driver. This target speed is used to control the vehicle target speed in case of free driving or Cruise Control only.
      data SetSpd: type=Spd4
    SetSpdDec1  # Set Speed Decrease | Request to decrease set speed for driver assistance system, e.g. Adaptive Cruise Control (ACC) or Cruise Control (CC) by driver.
      data SetSpdDec: type=ReqSt1  # 0: nothing 1: decrease set speed
    SetSpdInc1  # Set Speed Increase | Request to increase set speed for driver assistance system, e.g. Adaptive Cruise Control (ACC) or Cruise Control (CC) by driver.
      data SetSpdInc: type=ReqSt1  # 0: nothing 1: increase set speed
    SetSpdIndcn1  # Set Speed Indication 1 | Displayed set speed of driver assistance system, e.g. Cruise Control (CC) or Adaptive Cruise Control (ACC)
      data SetSpdIndcn: type=Spd4
    SetTiGap1  # Set Time Gap 1 | Actual time gap, set by the driver. This time gap is used to control the distance in case of vehicle detected ahead.
      data SetTiGap: type=Ti2
    SnsrAlrmSimpleSt1  # Sensor Alarm Simple Status | Status of simple alarm sensors - individual status of triggering source
      data St: type=OnOff1  # On - sensor triggered Off - sensor not triggered
    SnsrAlrmSimpleSts1  # Sensor Alarm Simple Status | Status of simple alarm sensors - individual status of triggering source
      data Sts: type=OnOff1  # On - sensor triggered Off - sensor not triggered
    SnsrAlrmSt1  # Sensor Alarm Status | Status of each alarm sensor
      data St: type=SnsrAlrmSt1
    SnsrAlrmSts1  # Sensor Alarm Status | Status of each alarm sensor
      data Sts: type=SnsrAlrmSts1
    SnsrGlassBreakSt1  # Sensor Glass Break Status | Status of glass break sensor - glass OK, glass broken
      data St: type=DevErrSt2  # False - glass not broken True - glass broken
    SnsrGlassBreakSts1  # Sensor Glass Break Status | Status of glass break sensor - glass OK, glass broken
      data Sts: type=DevErrSts2  # False - glass not broken True - glass broken
    SnsrInclInhbReq1  # Sensor Inclination Inhibit Request | Inhibition request by user for the inclination sensor
      data Req: type=OnOff1
    SnsrInclnCmd1  # Sensor Inclination Command | Control command of the Inclination sensor
      data Cmd
    SnsrInclnInhbReq1  # Sensor Inclination Inhibit Request | Inhibition request by user for the inclination sensor
      data Req: type=OnOff1
    SnsrInclnSt1  # Inclination Sensor Status | Inclination sensor status
      data St: type=SnsrSt1
    SnsrInclnSts1  # Inclination Sensor Status | Inclination sensor status
      data Sts: type=SnsrSts1
    SnsrIntrScanrCmd1  # Sensor Interior Scanner Command | Control command of the Interior Scanner sensor
      data Cmd
    SnsrIntrScanrInhbReq1  # Sensor Interior Scanner Inhibit Request | Inhibition request by user for the interior scanner sensor
      data Req: type=OnOff1
    SnsrIntrScanrSt1  # Sensor Interior Scan Status | Status of interior scanner
      data St: type=SnsrSt1
    SnsrIntrScanrSts1  # Sensor Interior Scan Status | Status of interior scanner
      data Sts: type=SnsrSts1
    SnsrRoofCnvtbSt1  # Sensor Roof Convertible Status | Status of convertible sensor required for security
      data St: type=OnOff1
    SnsrRoofCnvtbSts1  # Sensor Roof Convertible Status | Status of convertible sensor required for security
      data Sts: type=OnOff1
    SnsrSoundrBattBackedCmd1  # Sensor Sounder Battery Backed Command | Command to the sensor for Battery Backed Sounder (BBS)
      data Cmd: type=SoundrBattBackedCmd1
    SnsrSoundrBattBackedSt1  # Sensor Sounder Battery Backed Status | Status of the Battery Backed Sounder (BBS)
      data St: type=SoundrBattBackedSt1
    SnsrSoundrBattBackedSts1  # Sensor Sounder Battery Backed Status | Status of the Battery Backed Sounder (BBS)
      data Sts: type=SoundrBattBackedSts1
    SpdLat1  # Speed Lateral 1 | Lateral speed component at Center of Gravity (COG) in vehicle coordinates.
      data SpdLat: type=Spd2
    SprgCoeff1  # Spring Coefficient | Actual spring coefficient provided by the spring system. Vector of 4 scalars in the order front left, front right, rear left, rear right. Refer to ISO 8855.
      data SprgCoeff: type=SprgCoeffPerWhl1
    SprgCoeffEstimd1  # Spring Coefficient Estimated | Estimation of the actual spring coefficient provided by the spring system. Vector of 4 scalars in the order front left, front right, rear left, rear right. Refer to ISO 8855.
      data SprgCoeffEstimd: type=SprgCoeffPerWhl1
    SprgCtrlTunActvReq1  # Requested Active Spring Control Tuning | Spring control tuning mode request by the driver
      data SprgCtrlTunActvReq: type=SuspMod1
    SprgCtrlTunMod1  # Spring Control Tuning Mode 1 | Spring tuning mode displayed to the driver and provided to other systems
      data SprgCtrlTunMod: type=SuspMod1
    SprgF1  # Spring Force | Actual spring forces provided by the spring system. Vector of 4 scalars in the order front left, front right, rear left, rear right. Refer to ISO 8855.
      data SprgF: type=SprgFPerWhl1
    SprgFEstimd1  # Spring Force Estimated | Estimation of the actual spring forces provided by the spring system. Vector of 4 scalars in the order front left, front right, rear left, rear right. Refer to ISO 8855.
      data SprgFEstimd: type=SprgFPerWhl1
    SprgTrvl1  # Spring Travel 1 | Spring travel continuous values at individual wheels (one for each corner)
      data SprgTrvl: type=SprgTrvlPerWhl1
    SsmSt1  # SSM Status 1 | Generic failure status of the Stand Still Manager (SSM) request
      data SsmSt: type=DevErrSt2  # Failure status of the Stand Still Manager (SSM) .
    SsmSts1  # SSM Status 1 | Generic failure status of the Stand Still Manager (SSM) request
      data SsmSts: type=DevErrSts2  # Failure status of the Stand Still Manager (SSM) .
    StabrCtrlMod1  # Stabilizer Control Mode 1 | Stabilizer tuning mode displayed to driver and provided to other systems
      data StabrCtrlMod: type=SuspMod1
    StabrCtrlTunReq1  # Requested Stabilizer Control Tuning | Stabilizer control tuning mode request by the driver
      data StabrCtrlTunReq: type=SuspMod1
    StabrRate1  # Stabilizer Rate | Stabilizer rate for active stabilizer systems. 0% = maximal soft, 100% = maximal hard
      data StabrRatePerWhl: type=StabrRatePerWhl1
    StabrSt1  # Stabilizer Status 1 | Status provided by the active or switchable stabilizer on front and rear axle.
      data AxleFrnt: type=StabrSt1  # Front axle
      data AxleRe: type=StabrSt1  # Rear Axle
    StabrSts1  # Stabilizer Status 1 | Status provided by the active or switchable stabilizer on front and rear axle.
      data AxleFrnt: type=StabrSts1  # Front axle
      data AxleRe: type=StabrSts1  # Rear Axle
    StandStillCmftReqByAcc1  # Stand Still Comfort Request by ACC | To keep standstill requested by Adaptive Cruise Control (ACC) to Vehicle Longitudinal Control (VLC).
      data StandStillCmftReq: type=ReqSt1
    SteerAgGrdtSuppsnMaxAllwd1  # Max Allowed Steering Angle Gradient Superposition | Maximum allowed superposition steering angle gradient normalized on road wheel angle (actuator potential).
      data SteerAgGrdtMaxAllwd: type=AgSpd7
    SteerCtrlTunReq1  # Steering Control Tuning Request | Driver's requested steering controller tune
      data SteerCtrlTunReq: type=SteerMod1
    SteerDrvrAsscSysModReq1  # Steering Driver Assistance System Mode Request 1 | Request from driver to Steering Driver Assistance System, which among several functional or tuning modes has to be activated.
      data SteerDrvrAsscSysModReq: type=SteerMod1
    SteerDrvrAsscSysStIndcn1  # Steering Driver Assistance System Status Indication 1 | Indication from Steering Driver Assistance System of which functional status it has.
      data SteerDrvrAsscSysStIndcn: type=DevSt4
    SteerDrvrAsscSysStsIndcn1  # Steering Driver Assistance System Status Indication 1 | Indication from Steering Driver Assistance System of which functional status it has.
      data SteerDrvrAsscSysStsIndcn: type=DevSts4
    SteerLoadHyd1  # Steering Load Hydraulic | Generic interface for hydraulic power steering load at engine crank shaft.
      data SteerLoadHyd: type=Tq6
    SteerMotAgFrnt1  # Steering Motor Angle Front 1 | Angle of the front steering device at the steer motor (for steering angle superposition systems)
      data SteerMotAgFrnt: type=Ag5
    SteerMotAgSpdFrnt1  # Steering Motor Angle Speed Front 1 | Conditioned derivative of the angular position measured at the front steering device with respect to the motor shaft.
      data SteerMotAgSpdFrnt: type=AgSpd5
    SteerSt1  # Steering Status 1 | Error status provided by steering system
      data SteerSt: type=DevErrSt1
    SteerSts1  # Steering Status 1 | Error status provided by steering system
      data SteerSts: type=DevErrSts1
    SteerTqSum1  # Sum Steering Torque | Sum of driver steering torque and delta torque by Steering Vehicle Stability Control
      data SteerTqSum: type=Tq15
    SteerTqSuppsnFrntSt1  # Steer Torque Superposition Front Status 1 | Status of the Basic Steering Torque Superposition that indicates whether it is able to apply the requested delta torque or not.
      data SteerTqSuppsnFrntSt: type=AvlSt1
    SteerTqSuppsnFrntSts1  # Steer Torque Superposition Front Status 1 | Status of the Basic Steering Torque Superposition that indicates whether it is able to apply the requested delta torque or not.
      data SteerTqSuppsnFrntSts: type=AvlSts1
    SteerVehStabyCtrlMod1  # Steering Vehicle Stability Control Mode 1 | Steering vehicle stability mode in operation.
      data SteerVehStabyCtrlMod: type=SteerVehStabyCtrlMod1
    SteerVehStabyCtrlModReq1  # Steering Vehicle Stability Control Mode Request | Driver's requested steering vehicle stability control system mode.
      data SteerVehStabyCtrlModReq: type=SteerVehStabyCtrlMod1
    SteerWhlAg1  # Steering Wheel Angle 1 | generic interface for Steering Wheel Angle
      data SteerWhlAg: type=Ag4
    SteerWhlAgSpd1  # Steering Wheel Angle Speed 1 | Conditioned (offset-compensated, filtered) steering wheel angle speed. E.g. measured by a sensor located between the steering wheel and the Steering Angle Superposition system (if available). Does not include steering kinematic effects. Derived from measured steering wheel angular position.
      data SteerWhlAgSpd: type=AgSpd1
    StgDisp1  # Display Stage | Display feedback of Stage active (cooling or heating) to Human Machine Interface (HMI)
      data StgDisp: type=StgOfSeatClima1  # Cooling/Heating
    StgReq1  # Stage Request | Indication of stage request from button adapter to request for heating or cooling the seat
      data StgReq: type=StgOfSeatClima1  # Cooling/Heating
    StorePosnCmd1  # Store Position Command | Request to store the position of a certain seat and a certain axis to the memory position "profile". This interface is mainly provided for centralized storage of memory positions (NV-RAM Manager supports only local NV-RAM)
      data Cmd: type=SeatStorgPosn1
    SuspCtrlTunReq1  # Requested Suspension Control Tuning | Request to Suspension to switch between several functional or tuning modes
      data SuspCtrlTunReq: type=SuspMod1
    SuspMod1  # Suspension Mode 1 | Suspension tuning mode displayed to the driver
      data SuspMod: type=SuspMod1
    SwilSprgSt1  # Switchable Spring Status 1 | Status provided by switchable spring.
      data SwilSprgSt: type=DevSt4
    SwilSprgSts1  # Switchable Spring Status 1 | Status provided by switchable spring.
      data SwilSprgSts: type=DevSts4
    SwtStrtSt1  # Switch Start Status | Information on push start switch
      data St: type=OnOff1
    SwtStrtSts1  # Switch Start Status | Information on push start switch
      data Sts: type=OnOff1
    TelltlDefrstCmd1  # Telltale Defrost Command | Command to the defrost telltale actuator
      data Cmd: type=OnOff1
    TerminalClmpModReq1  # Terminal Clamp Mode Request | request to change modes to power management and powertrain system
      data TerminalClmpModReq: type=TerminalPosnMod1
    TerminalPosnSt1  # Terminal Position Status | Position of mechanical key switch
      data TerminalPosnSt: type=TerminalPosnMod1
    TerminalPosnSts1  # Terminal Position Status | Position of mechanical key switch
      data TerminalPosnSts: type=TerminalPosnMod1
    TiGapDec1  # Time Gap Decrease | Request to decrease time gap for driver assistance system, e.g. Adaptive Cruise Control (ACC) by driver.
      data TiGapDec: type=ReqSt1  # 0: nothing 1: decrease time gap
    TiGapInc1  # Time Gap Increase | Request to increase time gap for driver assistance system, e.g. Adaptive Cruise Control (ACC) by driver.
      data TiGapInc: type=ReqSt1  # 0: nothing 1: increase time gap
    TintgAutReq1  # Automatic Tint Request | User request to set the mirrors tinting automatically
      data Req: type=OnOff1
    TintgAutSt1  # Automatic Tint Status | Status of the automatic tinting.
      data St: type=DevSt4
    TintgAutSts1  # Automatic Tint Status | Status of the automatic tinting.
      data Sts: type=DevSts4
    TintgValReq1  # Tinting Value Request | Delivers the desired value for mirror tinting.
      data St: type=Perc2
    TirePEstimdPerWhl1  # Tire Pressure Estimated per Wheel | Vector of 4 absolute wheel tire inflation pressure values assigned to the individual wheels, in the front left, front right, rear left, rear right
      data TireP: type=TirePPerWhl2
    TirePMeasdPerWhl1  # Tire Pressure Measured per Wheel 1 | Direct measuring Tire Pressure Monitoring systems: Vector of 5 showing the current tire pressures in the order of front left, front right, rear left, rear right, spare wheel
      data TireP: type=TirePPerWhl1
    TirePMonAcptOfWhlNewReq1  # Tire Pressure Monitoring Acceptof Wheel New Request | Indication of new wheel set to be accepted and monitored by Tire Pressure Monitoring (e.g. new sensor ID) | For direct measuring systems.
      data TirePMonAcptOfWhlNewReq: type=ReqSt1
    TirePMonCalStIndcnPerWhl1  # Tire Pressure Monitoring Calibration Status Indication per Wheel 1 | Calibration status indication of the Tire Pressure Monitoring to Human Machine Interface (HMI). Wheel individual. | For direct and indirect measuring systems
      data TirePMonCalStIndcnPerWhl: type=TirePMonCalStPerWhl1
    TirePMonCalStsIndcnPerWhl1  # Tire Pressure Monitoring Calibration Status Indication per Wheel 1 | Calibration status indication of the Tire Pressure Monitoring to Human Machine Interface (HMI). Wheel individual. | For direct and indirect measuring systems
      data TirePMonCalStsIndcnPerWhl: type=TirePMonCalStsPerWhl1
    TirePMonIndcnOfWhlNewRcnd1  # Tire Pressure Monitoring New Wheel Recognized Indication 1 | Indication that one or more new wheels with new sensor ID are fitted to the vehicle. | For direct measuring systems.
      data TirePMonIndcnOfWhlNewRcnd: type=DetnSt1
    TirePMonRstAckd1  # Tire Pressure Monitoring Reset Acknowledged 1 | Acknowledge of the Tire Pressure Monitoring that a tire pressure monitoring reset request has been received. | For direct and indirect measuring systems.
      data TirePMonRstAckd: type=AckSt1
    TirePMonRstReq1  # Tire Pressure Monitoring Reset Request 1 | Request of a reset of the tire pressure monitoring by the driver or diagnostic tool | For direct and indirect measuring systems.
      data TirePMonRstReq: type=ReqSt1
    TirePMonSt1  # Tire Pressure Monitoring Status 1 | Status of the tire pressure monitoring system | For direct and indirect measuring systems.
      data TirePMonSt: type=DevSt5
    TirePMonSts1  # Tire Pressure Monitoring Status 1 | Status of the tire pressure monitoring system | For direct and indirect measuring systems.
      data TirePMonSts: type=DevSts5
    TirePMonWarnIndcn1  # Tire Pressure Monitoring Warning Indication | Indication that at least at one tire a significant loss of tire pressure has been recognized. | For direct and indirect measuring systems.
      data TirePMonWarnIndcn: type=TirePMonWarnSt1
    TirePMonWarnIndcnPerWhl1  # Tire Pressure Monitoring Warning Indication per Wheel 1 | Indication which type of loss of tire pressure has been recognized at wheel. | For direct and indirect measuring systems. For indirect measuring Tire Pressure Monitoring probably not all states can be used.
      data TirePMonWarnIndcnPerWhl: type=TirePMonWarnIndcnStPerWhl1
    TirePPerWhl1  # Tire Pressure per Wheel | Vector of 4 absolute wheel tire inflation pressure values assigned to the individual wheels, in the front left, front right, rear left, rear right
      data TireP: type=TirePPerWhl2
    TirePThdPerAxle1  # Tire Pressure Threshold per Axle 1 | Set of tire pressure thresholds (one threshold per axle). | For direct measuring systems
      data TirePThdPerAxle: type=AxlePOfTirePMon1
    TireTEstimdPerWhl1  # Tire Temperature Estimated per Wheel | Vector of 4. Inside air tire temperature of the individual wheels in the order front left, front right, rear left, rear right
      data TireT: type=TireTPerWhl2
    TireTMeasdPerWhl1  # Tire Temperature Measured per Wheel 1 | Direct measuring Tire Pressure Monitoring systems: Vector of 5 showing the current tire temperatures in the order of front left, front right, rear left, rear right, spare wheel
      data TireT: type=TireTPerWhl1
    TireTPerWhl1  # Tire Temperature per Wheel | Vector of 4 inside air tire temperature of the individual wheels in the order front left, front right, rear left, rear right
      data TireT: type=TireTPerWhl2
    TogReq1  # Toggle Request | User request to lock / unlock e.g. the glove box ("Toggle-Function"). "on" means toggle.
      data Req: type=OnOff1
    TogSt1  # Toggle State | System output to user: The value is used to generate feedback to the user about the system's current state. The value represents one of two states, mutually excluding each other, the system can be in or has changed to.
      data St: type=OnOff1
    TracCtrlIndcn1  # Traction Control Indication | Traction control is active for Human Machine Interface (HMI)
      data TracCtrlIndcn: type=DevSt4
    TracCtrlIntvg1  # Traction Control Intervening 1 | Traction control intervention status. True if intervening at at least one wheel.
      data TracCtrlIntvg: type=CtrlSt1  # 0: Traction control is not intervening 1: At least one wheel has Traction Control intervening
    TrlrHitchSt1  # Trailer Hitch Status | Status of trailer hitch
      data St: type=OnOff1
    TrlrHitchSts1  # Trailer Hitch Status | Status of trailer hitch
      data Sts: type=OnOff1
    TrlrIndcrDisp1  # Trailer Indicator Display | Trailer indicators activation status
      data St: type=IndcrSt1
    TrlrSt1  # Trailer Status 1 | Detection of presence of a trailer by switch type detection. Information: Trailer attached 0 means 'not present' 1 means 'present'
      data TrlrSt: type=DetnSt1  # 0 means 'not present' 1 means 'present'
    TrlrSts1  # Trailer Status 1 | Detection of presence of a trailer by switch type detection. Information: Trailer attached 0 means 'not present' 1 means 'present'
      data TrlrSts: type=DetnSts1  # 0 means 'not present' 1 means 'present'
    TrsmAuthent1  # Transmission Authentication | Authentication process between transmitter and receiver
      data TrsmAuthent: type=Nr8
    TrsmAxleActrSt1  # Transmission Axle Actuator State | State of the Front/Rear Axle Actuator. This could be a Torque Vector Device, an active control differential or a locking differential.
      data TrsmAxleActrSt: type=DevErrSt4
    TrsmCluNLimnReq1  # Transmission: Limitation of Clutch Speed | Maximum speed at clutch permitted by transmission. | The timing and accuracy requirements in a typical series project are the same as for signal "Transmission: Clutch Speed Requested by Transmission". References to other signals: TrsmCluNReq
      data TrsmCluNLimnReq: type=N2  # Transmission: Limitation of Clutch Speed
    TrsmCluNMinReq1  # Transmission: Minimum Clutch Speed Requested by Transmission | Minimum clutch speed requested by transmission. | A higher speed potentially required by another system is permissible. Limitation typically implemented by the engine and/or the electric machine to e.g. 1200 rpm. Used, for example, to provide sufficient oil pressure at high temperature.
      data TrsmCluNMinReq: type=N2  # Transmission: Minimum Clutch Speed Requested by Transmission
    TrsmCluNPredGearTar1  # Transmission: Predicted Clutch Speed in Target Gear | Predicted clutch speed in target gear. | The predicted speed, calculated at the current vehicle speed, is the speed at clutch which is expected to be reached when the target gear is engaged. For transmissions without a converter: The slip of the drive-off element is supposed to be zero for the calculation of this signal. For these types of transmissions, the predicted clutch speed in target gear is identical to the predicted speed at gearbox input shaft in target gear. For transmissions with a converter: The signal is calculated with the current slip of the drive-off element, because the slip in the target gear is unknown. For these types of transmissions, the predicted clutch speed in target gear is the combination of the predicted speed at gearbox input shaft in target gear with the differential speed in the converter. This means that the current converter slip is considered.
      data TrsmCluNPredGearTar: type=N2  # Transmission: Predicted Clutch Speed in Target Gear
    TrsmCluNReq1  # Transmission: Clutch Speed Requested by Transmission | Clutch speed requested by transmission. | Used for shift intervention, coasting including sailing, start-stop and other use cases. This signal is closely related to the following two signals: “Transmission: Time to Reach Clutch Speed Requested by Transmission”, “Transmission: Request to Enable Clutch Speed Request” (status signal). As long as there is no speed request, the recommendation is to send the initialization value. If the requested time to reach target speed is below the implementation time the engine needs, then a reaction as fast as possible is expected. The lowest request implemented by the engine is the idle speed. The idle speed controller has priority. The highest request implemented by the engine is the max. admissible engine speed. The engine protection has priority. In parallel hybrid projects, this speed can be implemented by the combustion engine, the electric machine or both of them. In these projects, there are two additional signals which refer to the crankshaft of the combustion engine: “Powertrain: Engine Speed Requested by Powertrain”, “Powertrain: Request to Enable Engine Speed Request”. References to other signals: TrsmTiCluNReq TrsmCluNReqEnaReq PtEngNReq PtEngNReqEnaReq
      data TrsmCluNReq: type=N2  # Transmission: Clutch Speed Requested by Transmission
    TrsmCluNReqEnaReq1  # Transmission: Request to Enable Clutch Speed Request | Clutch speed requested by transmission enabled or not enabled. | 0 = not enabled => the request sent by the signals "Transmission: Clutch Speed Requested by Transmission" and "Transmission: Target Time to Reach Clutch Speed Requested by Transmission" is not permitted to be implemented. 1 = enabled => the request must be implemented. If the request must be implemented, then the signal must be “1” and the signal “Transmission: Clutch Speed Requested by Transmission” must be a value in the physically used range, different from initialization and error values. The engine stall protection must have a higher priority than the engine speed request. References to other signals: TrsmCluNReq TrsmTiCluNReqTar
      data TrsmCluNReqEnaReq: type=EnagSt1  # Transmission: Request to Enable Clutch Speed Request
    TrsmCluSt1  # Transmission: Clutch State | The interface informs about the current state of the clutch. | Be aware that this information is not necessarily equal with the drivetrain open information. If a torque converter clutch is open, the drivetrain can still be closed. In contrary the drivetrain is open for Manual Transmission (MT) and Automatic Manual Transmission (AMT), if the clutch is open! Default value after reset is open.
      data TrsmCluSt: type=CluSt1
    TrsmCluStAct1  # Transmission: Actual Clutch State | The interface informs about the current state of the clutch. | There exist 4 principal states: open, intermediate, near closed, hard closed (Note: The definition of intermediate and near closed has to be made for each project separately) Definition of "Clutch": Be aware that this information is not necessarily equal with the drivetrain open information. If a torque converter clutch is open, the drivetrain can still be closed. In contrary the drivetrain is open for Manual Transmission (MT) and Automatic Manual Transmission (AMT), if the clutch is open!Default value after reset is open. for Automatic Transmission (AT), Continuously Variable Transmission (CVT) it is the converter clutch for Manual Transmission (MT), Automatic Manual Transmission (AMT) it is the clutch between the gear box and the engine drivetrain
      data TrsmCluStAct: type=CluSt1
    TrsmCluStConsold1  # Transmission: Consolidated Clutch State | The interface informs about the current state of the clutch. | Be aware that this information is not necessarily equal with the drivetrain open information. If a torque converter clutch is open, the drivetrain can still be closed. In contrary the drivetrain is open for Manual Transmission (MT) and Automatic Manual Transmission (AMT), if the clutch is open!Default value after reset is open.
      data TrsmCluStConsold: type=CluSt1
    TrsmCluStTar1  # Transmission: Target State of the Clutch | The interface informs about the target state of the clutch. | There exist 4 principal states: open, intermediate, near closed, hard closed (Note: The definition of intermediate and near closed has to be made for each project separately) Definition of "Clutch": Be aware that this information is not necessarily equal with the drivetrain open information. If a torque converter clutch is open, the drivetrain can still be closed. In contrary the drivetrain is open for Manual Transmission (MT) and Automatic Manual Transmission (AMT), if the clutch is open!Default value after reset is open. for Automatic Transmission (AT), Continuously Variable Transmission (CVT) it is the converter clutch for Manual Transmission (MT), Automatic Manual Transmission (AMT) it is the clutch between the gear box and the engine drivetrain
      data TrsmCluStTar: type=CluSt1
    TrsmDrvOffElmSt1  # Transmission: State of Drive-Off Element | State of drive-off element concerning power transmission. | The signal describes the transmission of power of the drive-off element only, independent of the gearbox design. The signal is independent of the position of the drive-off element in the power flow. The signal is also independent of whether the drive-off element is only used for drive-off or additionally used as a shift clutch. Drive-off elements are implemented, for example, as hydraulic torque converter or friction clutch. There are gearboxes where drive-off element and gearbox core are separate mechanical parts. There are also gearboxes where a clutch in the gearbox is used as both, drive-off element and shift clutch: a) If the clutch is used as a drive-off element: The signal is defined by the state of this clutch. b) If the clutch is used as a shift clutch: The state of the signal is "closed". States of power transmission: 0 = open 1 = open_touch 2 = slip_controlled 3 = slip_micro 4 = closed 5 = not_determined (state of power transmission cannot be identified) 6 = hydrodynamic 14 = init 15 = signal error Values 7… 13 are undefined.
      data TrsmDrvOffElmSt: type=TrsmPwrSt1  # Transmission: State of Drive-Off Element
    TrsmDrvOffElmStTar1  # Transmission: Target State of Drive-Off Element | Target state of the drive-off element concerning transmission of power. | The signal describes the target transmission of power of the drive-off element only, independent of the gearbox design. The signal is independent of the position of the drive-off element in the power flow. The signal is also independent of whether the drive-off element is only used for drive-off or additionally used as a shift clutch. Drive-off elements are implemented, for example, as a hydraulic torque converter or friction clutch. There are gearboxes with separate mechanical parts for the drive-off element and the gearbox core. There are also gearboxes where a clutch in the gearbox is used as both, drive-off element and shift clutch: a) If the clutch is used as a drive-off element: The signal is defined by the state of this clutch. b) If the clutch is used as a shift clutch: The state of the signal is "closed". States of power transmission: 0 = open 1 = open_touch 2 = slip_controlled 3 = slip_micro 4 = closed 5 = not_determined (state of power transmission cannot be identified) 6 = hydrodynamic 14 = init 15 = signal error Values 7… 13 are undefined.
      data TrsmDrvOffElmStTar: type=TrsmPwrSt1  # Transmission: Target State of Drive-Off Element
    TrsmFlgCtrsftActv1  # Transmission: Countershaft Active | Indicates whether the gear is in low range mode, e.g. for sport utility vehicles (SUV) or offroad vehicles with countershaft gearboxes (high range / low range). 0: countershaft inactive (standard condition) 1: countershaft active
      data TrsmFlgCtrsftActv: type=Flg1
    TrsmFlgDtOpen1  # Transmission: Drivetrain Opened | indicates whether the drive train is open due to driver input. Transitional states between fully open and fully closed drivetrain shall be indicated as open in this signal. Automatic Transmission (AT): Lever in N or in P or in neutral state because if internal reasons (e.g. internal failure) Manual Transmission (MT): Estimation based on clutch pedal pressed and optional neutral gear recognition. 0 : Drivetrain fully closed 1 : Drivetrain fully open or between fully open and fully closed)
      data TrsmFlgDtOpen: type=Flg1
    TrsmFlgParkLockEngd1  # Transmission: Park Lock Engaged | Status of gearbox on engaged parking lock (P-drive) of the Automatic Transmission (AT). 0 : not engaged 1 : engaged
      data TrsmFlgParkLockEngd: type=Flg1
    TrsmFlgShiftProgs1  # Transmission: Gear Shift in Progress | Flag indicates that a gear shift is in progress. | A gear shift is in progress while the transmission is changing the gear. This typically includes the preparation of the clutches, i.e. the fast filling phase of the clutch on automatic transmissions. “Gear shift is active” is a synonym for “Gear shift is in progress”.
      data TrsmFlgShiftProgs: type=Flg1  # Transmission: Gear Shift in Progress
    TrsmFlgSptMod1  # Transmission: Sport Mode Request by Driver | Flag signals that the driver activated the sport mode. 0 = deactivated 1 = activated
      data TrsmFlgSptMod: type=Flg1
    TrsmFlgSptModReq1  # Transmission: Sport Mode Request by Driver | Flag signals that the driver activated the sport mode. 0 = deactivated 1 = activated
      data TrsmFlgSptModReq: type=Flg1
    TrsmFlgWntrMod1  # Transmission: Winter Mode Request by Driver | Flag signals that the driver activated the winter mode 0 = deactivated 1 = activated
      data TrsmFlgWntrMod: type=Flg1
    TrsmFlgWntrModReq1  # Transmission: Winter Mode Request by Driver | Flag signals that the driver activated the winter mode 0 = deactivated 1 = activated
      data TrsmFlgWntrModReq: type=Flg1
    TrsmGbxCoreSt1  # Transmission: State of Gearbox Core | State of gearbox core concerning power transmission. | The signal describes the transmission of power between gearbox input shaft and output shaft. The signal summarizes the state of power transmission of all gears and all gearbox internal clutches except for the drive-off element. The gearbox core is the part of the gearbox which is not used as drive-off element. There are gearboxes where drive-off element and gearbox core are separate mechanical parts. There are also gearboxes where a clutch in the gearbox is used as both, drive-off element and shift clutch. a) If the clutch is used as a drive-off element: The signal "Transmission: State of Drive-Off Element” is defined by the state of this clutch. The signal specified by this text is then defined by the state of the other parts of the gearbox. These other parts are the gearbox core. b) If the clutch is used as a shift clutch: The state of the signal "Transmission: State of Drive-Off Element” is "closed". The signal specified by this text is then defined by the state of all parts of the gearbox. Then all parts of the gearbox are the gearbox core. States of power transmission: 0 = open 1 = open_touch 2 = slip_controlled 3 = slip_micro 4 = closed 5 = not_determined (state of power transmission cannot be identified) 6 = hydrodynamic 14 = init 15 = signal error Values 7… 13 are undefined. References to other signals: TrsmDrvOffElmSt
      data TrsmGbxCoreSt: type=TrsmPwrSt1  # Transmission: State of Gearbox Core
    TrsmGbxSt1  # Transmission: State of Gearbox | State of the gearbox concerning transmission of power. | The signal is defined for the serial connection of the drive-off element and the gearbox core with one input shaft and one output shaft. Gearboxes with more than one input shaft or more than one output shaft are not in the scope of this definition. States of power transmission: 0 = open 1 = open_touch 2 = slip_controlled 3 = slip_micro 4 = closed 5 = not_determined (state of power transmission cannot be identified) 6 = hydrodynamic 14 = init 15 = signal error Values 7… 13 are undefined.
      data TrsmGbxSt: type=TrsmPwrSt1  # Transmission: State of Gearbox
    TrsmGearSt1  # Transmission: Transmission Gear State | Gear state of the transmission. | Outside of a gear shift phase, this signal displays the gear which is engaged in the gearbox core. During a gear shift phase, this signal displays the gear which will be engaged at the end of the gear shift phase. For consecutive shifts during one gear shift phase, the gear which is intended to be engaged at the end is displayed. The target gear may change during the gear shift phase. The gear shift phase can be identified by the signal “Transmission: Gear Shift in Progress”. Gear information does not necessarily reflect the current driving direction of the vehicle. A signed gear as a pure numerical value (signed integer) can be created from the following payload part of the interface: 0 = reverse gear 2 1 = reverse gear 1 2 = no gear engaged 3 = gear 1 4 = gear 2 … 28 = gear 26 29 = no discrete gear State “no discrete gear" is typically used by continuous variable transmissions (CVT). References to other signals: TrsmFlgShiftProgs
      data TrsmGearSt: type=GearSt1  # Transmission: Transmission Gear State
    TrsmId1  # Transmission Identifier | Information related to the access device (transmission device) used to enter the car.
      data TrsmId: type=Nr8
    TrsmInpN1  # Transmission: Transmission Input Speed | Transmission input speed. | Rotational speed of the input shaft of the gearbox core. For automatic transmissions with a converter, the input shaft of the gearbox core and the output shaft of the converter are identical. The signal is not defined for transmissions with a gearbox core with more than one input shaft. The signal is especially not defined for double clutch transmissions.
      data TrsmInpN: type=N2  # Transmission: Transmission Input Speed
    TrsmIntvModReqForTqCluMaxFastReqForShiftIntv1  # Transmission: Intervention Mode Request for Maximum Torque at Clutch for Shift Intervention on Fast Path | Combination of ignition retard and cylinder cut-off for implementation of maximum torque requested for shift intervention on fast path. | 0 = No restrictions => ignition angle and cylinder cut-off permitted, default for diesel engines 1 = Ignition angle => cylinder cut-off not permitted 2 = Cylinder cut-off => ignition angle not permitted In parallel hybrid projects, implementation of the torque request by the electric machine is permitted. If the distribution of the torque request to electric machine and combustion engine must be defined, then a separate signal is necessary.
      data TrsmIntvModReqForTqCluMaxFastReqForShiftIntv: type=TrsmIntvModReqForTqCluReqForShiftIntvTyp1  # Transmission: Intervention Mode Request for Maximum Torque at Clutch for Shift Intervention on Fast Path
    TrsmIntvModReqForTqCluReqForShiftIntv1  # Transmission: Intervention Mode Request for Torque at Clutch for Shift Intervention | Combination of ignition retard, cylinder cut-off and air mass modulation for implementation of transmission torque request for shift intervention on fast path. | 0 = no restrictions => ignition angle, cylinder cut-off and air mass modulation permitted, default for diesel engines 1 = Ignition angle and cylinder cut-off => air mass modulation not permitted 2 = Ignition angle => cylinder cut-off and air mass modulation not permitted 3 = Ignition angle and air => cylinder cut-off not permitted 4 = Air => ignition angle and cylinder cut-off not permitted 5 = Cylinder cut-off => ignition angle and air mass modulation not permitted 6 = Cylinder cut-off and air => ignition retard not permitted 7 = Undefined => to be treated as "0 = no restrictions". In parallel hybrid projects, implementation of the torque request by the electric machine is permitted. If the distribution of the torque request to electric machine and combustion engine must be defined, then a separate signal is necessary.
      data TrsmIntvModReqForTqCluReqForShiftIntv: type=TrsmIntvModReqForTqCluReqForShiftIntvTyp1  # Transmission: Intervention Mode Request for Torque at Clutch for Shift Intervention
    TrsmNInp1  # Transmission: Speed at Input | For Transmission with a torque converter this interface represents the turbine speed, which is the output speed of the torque converter. For Dual Clutch Transmission (DCT) this speed represents the speed of the active clutch. | For low speed values the speed might be a virtual speed.
      data TrsmNInp: type=N1
    TrsmNrGearAct1  # Transmission: Actual Gear | Shows the gear being currently engaged in the gear box. | Mapping of physical gear to representation is left open, but according to: (Only for manual transmission: If no information about reverse gears is available then corresponding positive values are used for reverse gears.) 0 is drive train open (no torque at clutch is transmitted between the running engine(s) and the wheels). The use of Continuously Variable Transmission (CVT) has to be handled by separate SW-functionalities. Also for Continuously Variable Transmission (CVT), 0 is defined as open drive train.Default value after reset is zero. Negative values: Reverse gears. Positive values: Forward gears.
      data TrsmNrGearAct: type=Nr4
    TrsmNrGearConsold1  # Transmission: Consolidated Gear | Shows the gear being currently engaged in the gear box. | 0 is drive train open (no torque at clutch is transmitted between the running engine(s) and the wheels). The use of Continuously Variable Transmission (CVT) has to be handled by separate SW-functionalities. Also for Continuously Variable Transmission (CVT), 0 is defined as open drive train.Default value after reset is zero.
      data TrsmNrGearConsold: type=Nr4
    TrsmNrGearReq1  # Transmission: Requested Gear | Shows the gear being currently requested by the ratio strategy. | Mapping of physical gear to representation is left open, but according to: (Only for manual transmission: If no information about reverse gears is available then corresponding positive values are used for reverse gears.) The use of Continuously Variable Transmission (CVT) has to be handled by separate SW-functionalities. Also for Continuously Variable Transmission (CVT), 0 is defined as open drive train.Default value after reset is zero. Negative values: Reverse gears. Positive values: forward gears. 0 is drive train open (no torque at clutch is transmitted between the running engine(s) and the wheels).
      data TrsmNrGearReq: type=Nr4
    TrsmNrGearTar1  # Transmission: Target Gear | Shows the gear which will be engaged in the gear box. | During the shifting process this value informs about the gear which is expected to be engaged in the gear box after the shifting process. Therefore it switches to the expected gear state with the beginning of the shifting process. Mapping of physical gear to representation is left open, but according to: (Only for manual transmission: If no information about reverse gears is available then corresponding positive values are used for reverse gears.) 0 is drive train open (no torque at clutch is transmitted between the running engine(s) and the wheels). The use of Continuously Variable Transmission (CVT) has to be handled by separate SW-functionalities. Also for Continuously Variable Transmission (CVT), 0 is defined as open drive train.Default value after reset is zero. Negative values: Reverse gears. Positive values: forward gears.
      data TrsmNrGearTar: type=Nr4
    TrsmNrTyp1  # Transmission Type | Information on standard transmission. | Initialization possible by "End Of Line (EOL)" or "Key On". This information can come from compiler switch, calibration label, or as learned variant (SW identifies Gearbox type)Signal is sent with initialisation.
      data TrsmNrTyp: type=TrsmTyp1
    TrsmNrTypOfTqCluMaxMinFastSlowReqForShiftIntv1  # Transmission: Implementation Type of Request for Maximum and Minimum Torque at Clutch for Shift Intervention on Fast and Slow Path | Defines reference point of the signals requesting the maximum/minimum torque at clutch for shift intervention on fast/slow path. | This signal affects all of the following signals: “Transmission: Request for Maximum Torque at Clutch for Shift Intervention on Fast Path”, “Transmission: Request for Minimum Torque at Clutch for Shift Intervention on Fast Path”, “Transmission: Request for Maximum Torque at Clutch for Shift Intervention on Slow Path”, “Transmission: Request for Minimum Torque at Clutch for Shift Intervention on Slow Path”. 0 = absolute => the transmission requests an absolute limit for the torque to be produced by the engine on the fast and / or slow path. 1 = relative => the transmission requests a relative intervention for the torque to be produced by the engine on the fast and / or slow path. The reference signal is "Powertrain: Torque at Clutch without Transmission Intervention”. References to other signals: TrsmTqCluMaxFastReqForShiftIntv TrsmTqCluMinFastReqForShiftIntv TrsmTqCluMaxSlowReqForShiftIntv TrsmTqCluMinSlowReqForShiftIntv PtTqCluWoTrsmIntv
      data TrsmNrTypOfTqCluMaxMinFastSlowReqForShiftIntv: type=TrsmTqReqMaxMinTyp1  # Transmission: Implementation Type of Request for Maximum and Minimum Torque at Clutch for Shift
    TrsmNrTypOfTqCluReqForShiftIntv1  # Transmission: Implementation Type of Request for Torque at Clutch for Shift Intervention | Defines reference point and coordination of transmission torque request on fast path. | The reference point is 0 Nm for absolute requests and driver requested torque for relative requests. 0 = no request => the transmission does not send a request 1 = absolute maximum => the transmission requests an absolute upper limit for the torque to be produced by the engine. The real engine torque is permitted to be lower. It may be lower due to driver request or due to interventions by other systems. This case is usually used for torque decrease requests. 2 = absolute minimum => the transmission requests an absolute lower limit for the torque to be produced by the engine. The real engine torque is permitted to be higher. It may be higher due to driver request or due to interventions by other systems. This case is usually used for torque increase requests. 3 = absolute exact => the transmission requests exactly the torque to be produced by the engine. The real engine torque must comply with the request. This case is used for exact torque requests independently of whether the request is an increase or a decrease. 4 = relative => the transmission requests a torque relative to the reference "Powertrain: Torque at Clutch without Transmission Intervention”. The torque request to be implemented is the sum of "Powertrain: Torque at Clutch without Transmission Intervention" and "Transmission: Request for Torque at Clutch for Shift Intervention”. If the sign of the relative torque request is positive, then the sum is treated such as "2 = absolute minimum". If the sign of the relative torque request is negative, then the sum is treated such as "1 = absolute maximum". Advantage of the relative request: It immediately follows dynamic changes in the reference. It does not depend strongly on communication time delays. Advantage of the absolute request: It is independent of the reference and its dynamic behavior, so it meets exact absolute requests from the transmission. This signal does not define whether or not the intervention of stability control has priority over the intervention of the transmission. The signal can be used in both cases. The priority of stability control versus transmission intervention is not part of this definition. References to other signals: PtTqCluWoTrsmIntv TrsmTqCluReqForShiftIntv
      data TrsmNrTypOfTqCluReqForShiftIntv: type=TrsmTqReqTyp2  # Transmission: Implementation Type of Request for Torque at Clutch for Shift Intervention
    TrsmNrTypOfTqCluResvReq1  # Transmission: Implementation Type of Request for Torque Reserve at Clutch | Defines reference point of torque reserve requested by transmission. | 0 = no request => the transmission does not send a request. 1 = absolute minimum => the transmission requests an increase in the torque at clutch on slow path to the transmitted value, and compensation of the increased air mass by ignition retard and/or injection cutoff. 2 = relative => the transmission requests an increase in the torque at clutch on slow path to the transmitted value relative to the signal "Powertrain: Torque at Clutch without Transmission Intervention", and compensation of the increased air mass by ignition retard and/or injection cutoff. If the status is "relative", then only positive values are permitted for "Transmission: Request for Torque Reserve at Clutch". References to other signals: PtTqCluWoTrsmIntv TrsmTqCluResvReq
      data TrsmNrTypOfTqCluResvReq: type=TrsmTqReqTyp2  # Transmission: Implementation Type of Request for Torque Reserve at Clutch
    TrsmPosn1  # Transmission Position | Information to know if the transmitters of the vehicle are inside or outside the vehicle.
      data TrsmPosn: type=InOut1  # - Inside of the car - Outside of the car
