AUTOSAR XML (schema 00051)
package /AUTOSAR/AISpecification/Collections_Blueprint
  collection PtRefAll:
    category=SET
    auto-collect=REF-ALL
    element-role=PART_OF_SUBSET
    element=[P5, P6, P7, Perc10, Perc11, T5, T6, AbsCtrlIntvg, AccrPedlRat, AccrPedlRatGrdt, AcTq, AcTqReq, TrsmStAxleFrntActr, TrsmStAxleReActr, BrkActrVehSpdMax, BrkPedlPsd, BrkPedlVal, CluPedlRat, CoorrStActAtAxleFrnt, CoorrStActAtAxleRe, CoorrStActAtDftlForTqTrf, Crash, DftlTqReqAtAxleFrnt, DftlTqReqAtAxleRe, DftlTqReqAtDftlForTqTrf, PtAccrPedlPosnVirt, EgyMngt, EngN, EngNGrdt, EngTqDecAtCluReqByEscSlow, EngTqCrksft, EngTqIncAtCluReqByEsc, EscSt, TrsmFlgParkLockEngd, GearParkReq, TrsmRatGearAct, GearShiftDwnReqFromDrvr, GearShiftPrevnCmftReqByVlc, GearShiftPrevnStaby, GearShiftUpReqFromDrvr, TrsmNrGearTar, NoFuCutOffReq, OperMod, OutdT, PtFlgDrvOvrdVlc, PtFlgTqIncPsbl, PtTqDistbnToWhlsReqdByDtd, PtTqTotMaxAtWhlsReqdByVlc, PtTqTotMinAtWhlsReqdByVlc, PtTqWhl, PtTqWhlInd, PtTqWhlMax, PtTqWhlMin, PtTqWhlMinWoCutOff, PtTqWhlReq, PtTqWhlReqDrvVlc, SteerLoadHyd, SteerLoadHydReq, TrsmRatTqPtAct, TrsmStTrfCaseDftl, TrsmFlgCtrsftActv, TrsmFlgDtOpen, TrsmFlgShiftProgs, TrsmNrGearAct, TrsmTqDftlAxleFrntAct, TrsmTqDftlAxleFrntMax, TrsmTqDftlAxleReAct, TrsmTqDftlAxleReMax, TrsmTqDftlTrfAct, TrsmTqDftlTrfMax, BattU, VehSpdLgt, VlcA, WhlSpdCircumlStd, PtFlgTqDecPsbl, EngTqDecAtCluReqByEscFast, PtTqIncAtWhlsReqByEscSlow, PtTqDecAtWhlsReqByEscSlow, PtTqDecAtWhlsReqByEscFast, PtTqClu, DrvReqTqCluSlow, PtTqWhlMinDrv, TrsmFlgSptMod, TrsmFlgWntrMod, PtFlgEngRun, PtFlgEngStop, PtTqIncAtWhlsReqByEscFast, AbsFlgActv, AxleFrntCoorrSt, AxleReCoorrSt, BrkPedlFlgPsd, BrkPedlRat, DrvFlgGearShiftDwnReq, DrvFlgGearShiftUpReq, DtdRatTqDistbnReq, DtdTqDftlAxleFrntReq, DtdTqDftlAxleReReq, DtdTqDftlTrfReq, EgyMngtSt, EscFlgNoFuCutOff, EscTqCluPtMaxFast, EscTqCluPtMaxSlow, EscTqCluPtMin, EscTqWhlPtMaxSlow, EscTqWhlPtMinFast, EscTqWhlPtMinSlow, EscTqWhlPtMaxFast, EscVMax, SsmFlgGearParkReq, SteerTq, SteerTqReq, TrfCaseCoorrSt, VehStOper, VehVLgt, VlcStShiftPrevnCmft, VlcTqWhlPtMax, VlcTqWhlPtMin, EscVWhlInd, EscStShiftPrevnStaby, EngRunngDirSt, AltTq, AltTqReq, DrvReqTqWhlFast, DrvReqTqWhlSlow, EngNGearTar, EngNMax, EngNMin, EngPAmbAir, EngT, EngTqCrksftMax, EngTqCrksftMaxFast, EngTqCrksftMaxOptmCdn, EngTqCrksftMaxProtn, EngTqCrksftMin, EngTqCrksftMinBasc, EngTqCrksftMinFast, EngTqCrksftMinWoCutOff, EngTqResvPt, PtFlgAcDeactvt, PtFlgAltDeactvt, PtFlgEngStopReq, PtFlgEngStopReqAllwd, PtFlgEngStrtReq, PtFlgEngStrtReqAllwd, PtFlgNoTqWhlReq, PtNClu, PtNEngSp, PtRatTqDistbnReq, PtTqCluDyn, PtTqCluMaxDrv, PtTqCluMinDrv, PtTqCluReqWoTrsmIntv, PtTqCluTarGear, PtTqCluWoTrsmIntv, PtTqCrksftReqFast, PtTqCrksftReqSlow, PtTqMaxAc, PtTqMaxAlt, PtTqMaxSteer, PtTqMaxTrsmOilPmp, PtTqResvEng, PtTqWhlMaxDrv, TrsmCluStAct, TrsmCluStTar, TrsmNrGearReq, TrsmNrTyp, TrsmTqOilPmp, TrsmStGearLvr, TrsmRatGear, TrsmRatGearReq, TrsmRatGearTar, TrsmNInp, TrsmTOil, TrsmTqWhlIndDistbn, VehTqWhlMaxSftyLimn, AccrPedlRatFild, BodyPitchAgAbsltEstimd, RoadWhlAgEstimdFrnt, RoadWhlAgSpdEstimdFrnt, RoadWhlAgEstimdRe, SwtIndcr, SetSpdIndcn, DtOpend, RoadWhlAgSpdEstimdFrntWishdByDrvr, RoadWhlAgEstimdFrntWishdByDrvr, ALatStdWithRollCmpByEsc, ALatStdByEsc, ALgtStdFromWhlSpd, PrkgBrkActv, SteerWhlAgStd, YawRateBas, YawRateOffsStdByEsc, TracCtrlIntvg, VehMtnSt, WhlBrkOvrheatd, WhlRdTolrCoeff, WhlDirRotlStd, YawStabyCtrlIntvg, YawStabyInfoByEsc, AccActv, AccCtrlActv, CrsCtrlCtrlActv, AccVehDetdIndcn, VehSpdDispd, SetSpdInc, SetSpdDec, CrsCtrlAndAccSwtStEngd, CrsCtrlAndAccSetTiGapInc, VehCourseCrvtPred, AArbnRes, CrsCtrlActv, CrsCtrlAndAccSetTiGapDec, AReqForCmftByCrsCtrlFree, AccYawRateSpc, CrsCtrlAndAccVehSpdLgt, CrsCtrlAndAccDrvrOvrd, CrsCtrlAndAccSetTiGap, SetSpd, TrsmCluSt, TrsmNrGearConsold, TrsmRatGearConsold, TrsmCluSt1, PtCoorr, PtFlgHvacDeactvt1, AcTq1, AcTqReq1, PtFlgAcDeactvt1, HvacTq1, HvacTqReq1, PtTqMaxAc1, AcTq1, AcTqReq1, PtFlgAcDeactvtReq1, PtTqMaxAc1, Pt, HvacTq, HvacTqReq, PtFlgHvacDeactvt, PtTqMaxHvac, TrsmTqDftlAxleReConsold1, TrsmTqDftlTrfConsold1, TrsmTqDftlAxleFrntConsold1, TrsmNrGearConsold1, TrsmCluStConsold1, TrsmCluStConsold, PtNClu1, CrashSt1, EngTqCrksft1, PtTqCluWoTrsmIntv1, PtTqClu1, PtTqCluReqWoTrsmIntv1, EngTqCrksftMaxSpdCur1, CmbEng, EngTqModMngt, Trsm, DrvReq, VehMtnForPt, EngTqCrksftMin1, EngTqCluMin1, EmTqDynJ1, EngN1, EngNGearTar1, EngNMax1, EngNMin1, PtNEngSp1, TrsmNInp1, EngNGrdt1, AccrPedlMeasd1, AccrPedlMeasd, PtAccrPedlPosn1, AccrPedlGrdt1, AccrPedlRat1, AccrPedlRatFild1, AccrPedlRatGrdt1, PtAccrPedlPosn, AccrPedlGrdt, EngTqResvReqPt1, EngTqResvReqPt1, EngTqResvReqPt, PtFlgAcDeactvtReq1, PtFlgAcDeactvtReq, PtFlgAltDeactvtReq, PtFlgAltDeactvt1, PtTqResvReqEng1, PtTqResvReqEng, TrsmFlgSptModReq1, TrsmFlgSptModReq, TrsmFlgWntrModReq1, TrsmFlgWntrModReq, N2, TrsmRatTqPtConsold1, TrsmRatTqPtConsold]
  collection Pt:
    category=SET
    auto-collect=REF-NONE
    element-role=PART_OF_SUBSET
    element=[AArbnRes, AArbnRes1, ALat1, ALatStdByEsc, ALatStdWithRollCmpByEsc, ALgt1, ALgt2, ALgtStdFromWhlSpd, AReqForCmft1, AReqForCmftByCrsCtrlFree, AbsCtrlIntvg, AbsCtrlIntvg, AbsCtrlIntvg, AbsCtrlIntvg1, AbsCtrlIntvgToAbsCtrlIntvgOfPtCoorr, AbsFlgActv, AcTq, AcTq, AcTq, AcTq1, AcTq1, AcTqReq, AcTqReq1, AcTqReq1, AcTqToAcTqOfPtCoorr, AccActv, AccCtrlActv, AccCtrlActv1, AccVehDetd1, AccVehDetdIndcn, AccYawRateSpc, AccrPedl, AccrPedlGrdt, AccrPedlGrdt1, AccrPedlMeasd, AccrPedlMeasd, AccrPedlMeasd, AccrPedlMeasd, AccrPedlMeasd, AccrPedlMeasd, AccrPedlMeasd1, AccrPedlMeasdOfAccrPedlPosnToAccrPedlMeasdOfDrvReq, AccrPedlMeasdOfVehMtnForPtToAccrPedlMeasdOfPtCoorr, AccrPedlMeasdToAccrPedlMeasdOfAccrPedlPosn, AccrPedlMeasdToAccrPedlMeasdOfVehMtnForPt, AccrPedlOfAccrPedlPosnToAccrPedlOfDrvReq, AccrPedlPosn, AccrPedlRat, AccrPedlRat1, AccrPedlRatFild, AccrPedlRatFild1, AccrPedlRatGrdt, AccrPedlRatGrdt1, AltTq, AltTq, AltTq1, AltTqOfPtMiscToAltTqOfPtCoorr, AltTqReq, AltTqReq, AltTqReq1, AltTqReqOfPtMiscToAltTqReqOfPtCoorr, AmbAirT1, AxleFrntCoorrSt, AxleReCoorrSt, BattU, BattU, BattU, BattU1, BattUToBattUOfCmbEng, BattUToBattUOfCmbEngMisc, BodyPitchAg1, BodyPitchAgAbsltEstimd, BrkActrVehSpdMax, BrkActrVehSpdMax, BrkActrVehSpdMax, BrkActrVehSpdMaxToBrkActrVehSpdMaxOfVehMtnForPt, BrkActrVehSpdMaxToBrkActrVehSpdMaxOfVehSpdLimnForSfty, BrkPedlFlgPsd, BrkPedlPsd, BrkPedlPsd, BrkPedlPsd, BrkPedlPsd, BrkPedlPsd1, BrkPedlPsdToBrkPedlPsdOfDrvReq, BrkPedlPsdToBrkPedlPsdOfVehMtnForPt, BrkPedlRat, BrkPedlVal, BrkPedlVal, BrkPedlVal, BrkPedlVal, BrkPedlVal1, BrkPedlValToBrkPedlValOfDrvReq, BrkPedlValToBrkPedlValOfVehMtnForPt, CluPedlRat, CluPedlRat, CluPedlRat, CluPedlRat, CluPedlRat1, CluPedlRatOfVehMtnForPtToCluPedlRatOfPtCoorr, CluPedlRatToCluPedlRatOfVehMtnForPt, CluPedlRatToCluPedlRatOfVehMtnForPtMisc, CmbEng, CmbEng, CmbEngMisc, CoorrStActAtAxleFrnt, CoorrStActAtAxleRe, CoorrStActAtDftlForTqTrf, CoorrStConsoldAtAxleFrnt, CoorrStConsoldAtAxleRe, CoorrStConsoldAtDftlForTqTrf, Crash, Crash, Crash, CrashSt1, CrashToCrashOfCmbEng, CrashToCrashOfCmbEngMisc, CrsCtrlActv, CrsCtrlActv1, CrsCtrlAndAccDrvrOvrd, CrsCtrlAndAccDrvrOvrd1, CrsCtrlAndAccSetTiGap, CrsCtrlAndAccSetTiGapDec, CrsCtrlAndAccSetTiGapInc, CrsCtrlAndAccSwtStEngd, CrsCtrlAndAccSwtStEngd1, CrsCtrlAndAccVehSpdLgt, CrsCtrlAndAccVehSpdLgt1, CrsCtrlCtrlActv, CrsCtrlCtrlActv1, DftlCoorrSt1, DftlCoorrSts1, DftlTqReq1, DftlTqReqAtAxleFrnt, DftlTqReqAtAxleFrnt, DftlTqReqAtAxleRe, DftlTqReqAtAxleRe, DftlTqReqAtDftlForTqTrf, DftlTqReqAtDftlForTqTrf, DrvFlgGearShiftDwnReq, DrvFlgGearShiftUpReq, DrvReq, DrvReq, DrvReqRatVirtAccrPedl, DrvReqRatVirtAccrPedl, DrvReqRatVirtAccrPedl, DrvReqRatVirtAccrPedl, DrvReqRatVirtAccrPedlOfVehMtnForPtToDrvReqRatVirtAccrPedlOfPtCoorr, DrvReqRatVirtAccrPedlToDrvReqRatVirtAccrPedlOfDrvReq, DrvReqRatVirtAccrPedlToDrvReqRatVirtAccrPedlOfVehMtnForPt, DrvReqTqCluSlow, DrvReqTqCluSlow, DrvReqTqCluSlow, DrvReqTqCluSlow, DrvReqTqCluSlow, DrvReqTqCluSlow1, DrvReqTqCluSlowOfVehMtnForPtToDrvReqTqCluSlowOfPtCoorr, DrvReqTqCluSlowToDrvReqTqCluSlowOfDrvReq, DrvReqTqCluSlowToDrvReqTqCluSlowOfVehMtnForPt, DrvReqTqWhlFast, DrvReqTqWhlFast, DrvReqTqWhlFast, DrvReqTqWhlFast, DrvReqTqWhlFast1, DrvReqTqWhlFastOfVehMtnForPtToDrvReqTqWhlFastOfPtCoorr, DrvReqTqWhlFastToDrvReqTqWhlFastOfDrvReq, DrvReqTqWhlSlow, DrvReqTqWhlSlow, DrvReqTqWhlSlow, DrvReqTqWhlSlow, DrvReqTqWhlSlow1, DrvReqTqWhlSlowOfVehMtnForPtToDrvReqTqWhlSlowOfPtCoorr, DrvReqTqWhlSlowToDrvReqTqWhlSlowOfDrvReq, DtOpend, DtdRatTqDistbnReq, DtdTqDftlAxleFrntReq, DtdTqDftlAxleReReq, DtdTqDftlTrfReq, EgyMngt, EgyMngt, EgyMngt, EgyMngtSt, EgyMngtSt1, EgyMngtSts1, EgyMngtToEgyMngtOfPtCoorr, EmTqDynJ, EmTqDynJ1, EngN, EngN, EngN, EngN, EngN, EngN, EngN1, EngNGearTar, EngNGearTar, EngNGearTar1, EngNGrdt, EngNGrdt, EngNGrdt, EngNGrdt1, EngNGrdtToEngNGrdtOfCmbEng, EngNGrdtToEngNGrdtOfEngSpdAndPosn, EngNMax, EngNMax, EngNMax, EngNMax, EngNMax1, EngNMaxOfCmbEngToEngNMaxOfPtCoorr, EngNMaxToEngNMaxOfEngTqModMngt, EngNMin, EngNMin, EngNMin, EngNMin, EngNMin1, EngNMinOfCmbEngToEngNMinOfPtCoorr, EngNMinToEngNMinOfEngTqModMngt, EngNOfCmbEngToEngNOfPtCoorr, EngNOfCmbEngToEngNOfVehMtnForPt, EngNToEngNOfCmbEng, EngNToEngNOfDrvReq, EngNToEngNOfEngSpdAndPosn, EngPAmbAir, EngPAmbAir, EngPAmbAir, EngPAmbAir1, EngPAmbAirOfCmbEngToEngPAmbAirOfPtCoorr, EngRunngDirSt, EngRunngDirSt1, EngSpdAndPosn, EngT, EngT1, EngTqCluMin, EngTqCluMin1, EngTqCrksft, EngTqCrksft1, EngTqCrksftMax, EngTqCrksftMax, EngTqCrksftMax, EngTqCrksftMax, EngTqCrksftMax1, EngTqCrksftMaxFast, EngTqCrksftMaxFast, EngTqCrksftMaxFast, EngTqCrksftMaxFast, EngTqCrksftMaxFast1, EngTqCrksftMaxFastOfCmbEngToEngTqCrksftMaxFastOfPtCoorr, EngTqCrksftMaxFastToEngTqCrksftMaxFastOfEngTqModMngt, EngTqCrksftMaxOfCmbEngToEngTqCrksftMaxOfPtCoorr, EngTqCrksftMaxOptmCdn, EngTqCrksftMaxOptmCdn, EngTqCrksftMaxOptmCdn, EngTqCrksftMaxOptmCdn, EngTqCrksftMaxOptmCdn1, EngTqCrksftMaxOptmCdnOfCmbEngToEngTqCrksftMaxOptmCdnOfPtCoorr, EngTqCrksftMaxOptmCdnToEngTqCrksftMaxOptmCdnOfEngTqModMngt, EngTqCrksftMaxProtn, EngTqCrksftMaxProtn, EngTqCrksftMaxProtn, EngTqCrksftMaxProtn, EngTqCrksftMaxProtn1, EngTqCrksftMaxProtnOfCmbEngToEngTqCrksftMaxProtnOfPtCoorr, EngTqCrksftMaxProtnToEngTqCrksftMaxProtnOfEngTqModMngt, EngTqCrksftMaxSpdCur, EngTqCrksftMaxSpdCur1, EngTqCrksftMaxToEngTqCrksftMaxOfEngTqModMngt, EngTqCrksftMin, EngTqCrksftMin1, EngTqCrksftMinBasc, EngTqCrksftMinBasc, EngTqCrksftMinBasc, EngTqCrksftMinBasc, EngTqCrksftMinBasc1, EngTqCrksftMinBascOfCmbEngToEngTqCrksftMinBascOfPtCoorr, EngTqCrksftMinBascToEngTqCrksftMinBascOfEngTqModMngt, EngTqCrksftMinFast, EngTqCrksftMinFast1, EngTqCrksftMinWoCutOff, EngTqCrksftMinWoCutOff, EngTqCrksftMinWoCutOff, EngTqCrksftMinWoCutOff, EngTqCrksftMinWoCutOff1, EngTqCrksftMinWoCutOffOfCmbEngToEngTqCrksftMinWoCutOffOfPtCoorr, EngTqCrksftMinWoCutOffToEngTqCrksftMinWoCutOffOfEngTqModMngt, EngTqDecAtCluReqByEscFast, EngTqDecAtCluReqByEscFast, EngTqDecAtCluReqByEscFast, EngTqDecAtCluReqByEscFast1, EngTqDecAtCluReqByEscFastToEngTqDecAtCluReqByEscFastOfPtCoorr, EngTqDecAtCluReqByEscSlow, EngTqDecAtCluReqByEscSlow, EngTqDecAtCluReqByEscSlow, EngTqDecAtCluReqByEscSlow1, EngTqDecAtCluReqByEscSlowToEngTqDecAtCluReqByEscSlowOfPtCoorr, EngTqIncAtCluReqByEsc, EngTqIncAtCluReqByEsc, EngTqIncAtCluReqByEsc, EngTqIncAtCluReqByEsc1, EngTqIncAtCluReqByEscToEngTqIncAtCluReqByEscOfPtCoorr, EngTqModMngt, EngTqModMngt, EngTqResvPt, EngTqResvPt1, EngTqResvReqPt, EngTqResvReqPt, EngTqResvReqPt, EngTqResvReqPt, EngTqResvReqPt, EngTqResvReqPt, EngTqResvReqPt1, EngTqResvReqPt1, EngTqResvReqPtOfCmbEngToEngTqResvReqPtOfPtCoorr, EngTqResvReqPtToEngTqResvReqPtOfEngTqModMngt, EscFlgNoFuCutOff, EscSt, EscSt, EscSt, EscSt1, EscStShiftPrevnStaby, EscStToEscStOfPtCoorr, EscTqCluPtMaxFast, EscTqCluPtMaxSlow, EscTqCluPtMin, EscTqWhlPtMaxFast, EscTqWhlPtMaxSlow, EscTqWhlPtMinFast, EscTqWhlPtMinSlow, EscVMax, EscVWhlInd, GearParkReq, GearParkReq, GearParkReq1, GearShiftDwnReqFromDrvr, GearShiftDwnReqFromDrvr, GearShiftDwnReqFromDrvr, GearShiftDwnReqFromDrvr1, GearShiftDwnReqFromDrvrToGearShiftDwnReqFromDrvrOfPtCoorr, GearShiftPrevn1, GearShiftPrevnCmftReqByVlc, GearShiftPrevnCmftReqByVlc, GearShiftPrevnCmftReqByVlc, GearShiftPrevnCmftReqByVlcToGearShiftPrevnCmftReqByVlcOfPtCoorr, GearShiftPrevnStaby, GearShiftPrevnStaby, GearShiftPrevnStaby, GearShiftPrevnStabyToGearShiftPrevnStabyOfPtCoorr, GearShiftUpReqFromDrvr, GearShiftUpReqFromDrvr, GearShiftUpReqFromDrvr, GearShiftUpReqFromDrvr1, GearShiftUpReqFromDrvrToGearShiftUpReqFromDrvrOfPtCoorr, HvacTq, HvacTq, HvacTq1, HvacTqReq, HvacTqReq, HvacTqReq1, IndcrTurnReq1, N2, NoFuCutOffReq, NoFuCutOffReq, NoFuCutOffReq1, OperMod, OperMod, OperMod, OperModSt1, OperModToOperModOfPtCoorr, OutdT, OutdT, OutdT, OutdTToOutdTOfPtCoorr, P5, P6, P7, Perc10, Perc11, PrkgBrkActv, PrkgBrkActv1, Pt, PtAccrPedlPosn, PtAccrPedlPosn, PtAccrPedlPosn1, PtAccrPedlPosnVirt, PtAccrPedlPosnVirt1, PtCoorr, PtCoorr, PtFlgAcDeactvt, PtFlgAcDeactvt1, PtFlgAcDeactvtReq, PtFlgAcDeactvtReq, PtFlgAcDeactvtReq, PtFlgAcDeactvtReq, PtFlgAcDeactvtReq1, PtFlgAcDeactvtReq1, PtFlgAltDeactvt, PtFlgAltDeactvt1, PtFlgAltDeactvtReq, PtFlgAltDeactvtReq, PtFlgDrvOvrdVlc, PtFlgDrvOvrdVlc, PtFlgDrvOvrdVlc, PtFlgDrvOvrdVlc1, PtFlgDrvOvrdVlcToPtFlgDrvOvrdVlcOfPtCoorr, PtFlgEngRun, PtFlgEngRun, PtFlgEngRun, PtFlgEngRun, PtFlgEngRun, PtFlgEngRun1, PtFlgEngRunOfCmbEngToPtFlgEngRunOfPtCoorr, PtFlgEngRunToPtFlgEngRunOfCmbEng, PtFlgEngRunToPtFlgEngRunOfEngTqModMngt, PtFlgEngStop, PtFlgEngStop, PtFlgEngStop, PtFlgEngStop, PtFlgEngStop, PtFlgEngStop1, PtFlgEngStopOfCmbEngToPtFlgEngStopOfPtCoorr, PtFlgEngStopReq, PtFlgEngStopReq, PtFlgEngStopReq, PtFlgEngStopReq, PtFlgEngStopReq1, PtFlgEngStopReqAllwd, PtFlgEngStopReqAllwd, PtFlgEngStopReqAllwd, PtFlgEngStopReqAllwd, PtFlgEngStopReqAllwd1, PtFlgEngStopReqAllwdOfCmbEngToPtFlgEngStopReqAllwdOfPtCoorr, PtFlgEngStopReqAllwdToPtFlgEngStopReqAllwdOfEngTqModMngt, PtFlgEngStopReqOfPtCoorrToPtFlgEngStopReqOfCmbEng, PtFlgEngStopReqToPtFlgEngStopReqOfEngTqModMngt, PtFlgEngStopToPtFlgEngStopOfCmbEng, PtFlgEngStopToPtFlgEngStopOfEngTqModMngt, PtFlgEngStrtReq, PtFlgEngStrtReq, PtFlgEngStrtReq, PtFlgEngStrtReq, PtFlgEngStrtReq1, PtFlgEngStrtReqAllwd, PtFlgEngStrtReqAllwd, PtFlgEngStrtReqAllwd, PtFlgEngStrtReqAllwd, PtFlgEngStrtReqAllwd1, PtFlgEngStrtReqAllwdOfCmbEngToPtFlgEngStrtReqAllwdOfPtCoorr, PtFlgEngStrtReqAllwdToPtFlgEngStrtReqAllwdOfEngTqModMngt, PtFlgEngStrtReqOfPtCoorrToPtFlgEngStrtReqOfCmbEng, PtFlgEngStrtReqToPtFlgEngStrtReqOfEngTqModMngt, PtFlgHvacDeactvt, PtFlgHvacDeactvt, PtFlgHvacDeactvt1, PtFlgNoTqWhlReq, PtFlgNoTqWhlReq, PtFlgNoTqWhlReq1, PtFlgTqDecPsbl, PtFlgTqDecPsbl, PtFlgTqDecPsbl, PtFlgTqDecPsbl1, PtFlgTqDecPsblToPtFlgTqDecPsblOfPtCoorr, PtFlgTqIncPsbl, PtFlgTqIncPsbl, PtFlgTqIncPsbl, PtFlgTqIncPsbl1, PtFlgTqIncPsblToPtFlgTqIncPsblOfPtCoorr, PtMisc, PtNClu, PtNClu1, PtNEngSp, PtNEngSp1, PtRatTqDistbnReq, PtRatTqDistbnReq, PtRatTqDistbnReq1, PtTqClu, PtTqClu, PtTqClu, PtTqClu, PtTqClu1, PtTqCluDyn, PtTqCluDyn, PtTqCluDyn1, PtTqCluMaxDrv, PtTqCluMaxDrv, PtTqCluMaxDrv, PtTqCluMaxDrv, PtTqCluMaxDrv1, PtTqCluMaxDrvOfPtCoorrToPtTqCluMaxDrvOfVehMtnForPt, PtTqCluMaxDrvToPtTqCluMaxDrvOfDrvReq, PtTqCluMinDrv, PtTqCluMinDrv, PtTqCluMinDrv, PtTqCluMinDrv, PtTqCluMinDrv1, PtTqCluMinDrvOfPtCoorrToPtTqCluMinDrvOfVehMtnForPt, PtTqCluMinDrvToPtTqCluMinDrvOfDrvReq, PtTqCluOfPtCoorrToPtTqCluOfTrsm, PtTqCluReqWoTrsmIntv, PtTqCluReqWoTrsmIntv1, PtTqCluTarGear, PtTqCluTarGear, PtTqCluTarGear1, PtTqCluToPtTqCluOfPtCoorr, PtTqCluWoTrsmIntv, PtTqCluWoTrsmIntv1, PtTqCrksftReqFast, PtTqCrksftReqFast, PtTqCrksftReqFast, PtTqCrksftReqFast, PtTqCrksftReqFast1, PtTqCrksftReqFastOfPtCoorrToPtTqCrksftReqFastOfCmbEng, PtTqCrksftReqFastToPtTqCrksftReqFastOfEngTqModMngt, PtTqCrksftReqSlow, PtTqCrksftReqSlow, PtTqCrksftReqSlow, PtTqCrksftReqSlow, PtTqCrksftReqSlow1, PtTqCrksftReqSlowOfPtCoorrToPtTqCrksftReqSlowOfCmbEng, PtTqCrksftReqSlowToPtTqCrksftReqSlowOfEngTqModMngt, PtTqDecAtWhlsReqByEscFast, PtTqDecAtWhlsReqByEscFast, PtTqDecAtWhlsReqByEscFast, PtTqDecAtWhlsReqByEscFastToPtTqDecAtWhlsReqByEscFastOfPtCoorr, PtTqDecAtWhlsReqByEscSlow, PtTqDecAtWhlsReqByEscSlow, PtTqDecAtWhlsReqByEscSlow, PtTqDecAtWhlsReqByEscSlowToPtTqDecAtWhlsReqByEscSlowOfPtCoorr, PtTqDistbnToWhls1, PtTqDistbnToWhlsReqdByDtd, PtTqDistbnToWhlsReqdByDtd, PtTqDistbnToWhlsReqdByDtd, PtTqDistbnToWhlsReqdByDtdToPtTqDistbnToWhlsReqdByDtdOfPtCoorr, PtTqIncAtWhlsReqByEscFast, PtTqIncAtWhlsReqByEscFast, PtTqIncAtWhlsReqByEscFast, PtTqIncAtWhlsReqByEscFastToPtTqIncAtWhlsReqByEscFastOfPtCoorr, PtTqIncAtWhlsReqByEscSlow, PtTqIncAtWhlsReqByEscSlow, PtTqIncAtWhlsReqByEscSlow, PtTqIncAtWhlsReqByEscSlowToPtTqIncAtWhlsReqByEscSlowOfPtCoorr, PtTqMaxAc, PtTqMaxAc, PtTqMaxAc1, PtTqMaxAc1, PtTqMaxAlt, PtTqMaxAlt, PtTqMaxAlt1, PtTqMaxHvac, PtTqMaxHvac1, PtTqMaxSteer, PtTqMaxSteer, PtTqMaxSteer1, PtTqMaxTrsmOilPmp, PtTqMaxTrsmOilPmp, PtTqMaxTrsmOilPmp1, PtTqResvEng, PtTqResvEng1, PtTqResvReqEng, PtTqResvReqEng, PtTqResvReqEng, PtTqResvReqEng, PtTqResvReqEng, PtTqResvReqEng1, PtTqResvReqEngOfPtCoorrToPtTqResvReqEngOfCmbEng, PtTqResvReqEngToPtTqResvReqEngOfEngTqModMngt, PtTqTotAtWhls1, PtTqTotMaxAtWhlsReqdByVlc, PtTqTotMaxAtWhlsReqdByVlc, PtTqTotMaxAtWhlsReqdByVlc, PtTqTotMaxAtWhlsReqdByVlcToPtTqTotMaxAtWhlsReqdByVlcOfPtCoorr, PtTqTotMinAtWhlsReqdByVlc, PtTqTotMinAtWhlsReqdByVlc, PtTqTotMinAtWhlsReqdByVlc, PtTqTotMinAtWhlsReqdByVlcToPtTqTotMinAtWhlsReqdByVlcOfPtCoorr, PtTqWhl, PtTqWhl, PtTqWhl, PtTqWhl1, PtTqWhlInd, PtTqWhlInd, PtTqWhlInd, PtTqWhlInd1, PtTqWhlIndToPtTqWhlIndOfPtCoorr, PtTqWhlMax, PtTqWhlMax, PtTqWhlMax, PtTqWhlMax, PtTqWhlMax, PtTqWhlMax1, PtTqWhlMaxDrv, PtTqWhlMaxDrv, PtTqWhlMaxDrv1, PtTqWhlMaxOfPtCoorrToPtTqWhlMaxOfVehMtnForPt, PtTqWhlMaxToPtTqWhlMaxOfDrvReq, PtTqWhlMaxToPtTqWhlMaxOfPtCoorr, PtTqWhlMin, PtTqWhlMin, PtTqWhlMin, PtTqWhlMin1, PtTqWhlMinDrv, PtTqWhlMinDrv, PtTqWhlMinDrv, PtTqWhlMinDrv, PtTqWhlMinDrv, PtTqWhlMinDrv1, PtTqWhlMinDrvOfPtCoorrToPtTqWhlMinDrvOfVehMtnForPt, PtTqWhlMinDrvToPtTqWhlMinDrvOfDrvReq, PtTqWhlMinDrvToPtTqWhlMinDrvOfPtCoorr, PtTqWhlMinToPtTqWhlMinOfPtCoorr, PtTqWhlMinWoCutOff, PtTqWhlMinWoCutOff, PtTqWhlMinWoCutOff, PtTqWhlMinWoCutOff1, PtTqWhlMinWoCutOffToPtTqWhlMinWoCutOffOfPtCoorr, PtTqWhlReq, PtTqWhlReq, PtTqWhlReq, PtTqWhlReq1, PtTqWhlReqDrvVlc, PtTqWhlReqDrvVlc, PtTqWhlReqDrvVlc, PtTqWhlReqDrvVlc1, PtTqWhlReqDrvVlcToPtTqWhlReqDrvVlcOfPtCoorr, PtTqWhlReqToPtTqWhlReqOfPtCoorr, PtTqWhlToPtTqWhlOfPtCoorr, RoadWhlAg1, RoadWhlAgEstimdFrnt, RoadWhlAgEstimdFrntWishdByDrvr, RoadWhlAgEstimdRe, RoadWhlAgSpd1, RoadWhlAgSpdEstimdFrnt, RoadWhlAgSpdEstimdFrntWishdByDrvr, SetSpd, SetSpd1, SetSpdDec, SetSpdDec1, SetSpdInc, SetSpdInc1, SetSpdIndcn, SetSpdIndcn1, SetTiGap1, SsmFlgGearParkReq, SteerLoadHyd, SteerLoadHyd, SteerLoadHyd, SteerLoadHyd1, SteerLoadHydReq, SteerLoadHydReq, SteerLoadHydReq, SteerLoadHydReqToSteerLoadHydReqOfPtCoorr, SteerLoadHydToSteerLoadHydOfPtCoorr, SteerTq, SteerTqReq, SteerWhlAg1, SteerWhlAgStd, SwtIndcr, T5, T6, TiGapDec1, TiGapInc1, TracCtrlIntvg, TracCtrlIntvg1, TrfCaseCoorrSt, Trsm, Trsm, TrsmAxleActrSt1, TrsmCluSt, TrsmCluSt1, TrsmCluStAct, TrsmCluStAct1, TrsmCluStConsold, TrsmCluStConsold, TrsmCluStConsold, TrsmCluStConsold1, TrsmCluStTar, TrsmCluStTar, TrsmCluStTar1, TrsmFlgCtrsftActv, TrsmFlgCtrsftActv, TrsmFlgCtrsftActv, TrsmFlgCtrsftActv, TrsmFlgCtrsftActv, TrsmFlgCtrsftActv1, TrsmFlgCtrsftActvToTrsmFlgCtrsftActvOfDrvReq, TrsmFlgDtOpen, TrsmFlgDtOpen, TrsmFlgDtOpen1, TrsmFlgParkLockEngd, TrsmFlgParkLockEngd, TrsmFlgParkLockEngd1, TrsmFlgShiftProgs, TrsmFlgShiftProgs1, TrsmFlgSptMod, TrsmFlgSptMod1, TrsmFlgSptModReq, TrsmFlgSptModReq, TrsmFlgSptModReq, TrsmFlgSptModReq1, TrsmFlgWntrMod, TrsmFlgWntrMod1, TrsmFlgWntrModReq, TrsmFlgWntrModReq, TrsmFlgWntrModReq, TrsmFlgWntrModReq1, TrsmNInp, TrsmNInp1, TrsmNrGearAct, TrsmNrGearAct1, TrsmNrGearConsold, TrsmNrGearConsold, TrsmNrGearConsold, TrsmNrGearConsold, TrsmNrGearConsold, TrsmNrGearConsold1, TrsmNrGearConsoldToTrsmNrGearConsoldOfDrvReq, TrsmNrGearReq, TrsmNrGearReq, TrsmNrGearReq1, TrsmNrGearTar, TrsmNrGearTar, TrsmNrGearTar, TrsmNrGearTar1, TrsmNrTyp, TrsmNrTyp, TrsmNrTyp, TrsmNrTyp, TrsmNrTyp1, TrsmNrTypToTrsmNrTypOfDrvReq, TrsmRatGear, TrsmRatGear, TrsmRatGear, TrsmRatGear, TrsmRatGear1, TrsmRatGearAct, TrsmRatGearAct1, TrsmRatGearConsold, TrsmRatGearConsold, TrsmRatGearConsold, TrsmRatGearConsold, TrsmRatGearConsold, TrsmRatGearConsold1, TrsmRatGearConsoldToTrsmRatGearConsoldOfDrvReq, TrsmRatGearReq, TrsmRatGearReq, TrsmRatGearReq1, TrsmRatGearTar, TrsmRatGearTar, TrsmRatGearTar1, TrsmRatGearToTrsmRatGearOfDrvReq, TrsmRatTqPtAct, TrsmRatTqPtAct1, TrsmRatTqPtConsold, TrsmRatTqPtConsold, TrsmRatTqPtConsold, TrsmRatTqPtConsold, TrsmRatTqPtConsold, TrsmRatTqPtConsold, TrsmRatTqPtConsold1, TrsmRatTqPtConsoldToTrsmRatTqPtConsoldOfDrvReq, TrsmStAxleFrntActr, TrsmStAxleFrntActr, TrsmStAxleReActr, TrsmStAxleReActr, TrsmStGearLvr, TrsmStGearLvr, TrsmStGearLvr, TrsmStGearLvr, TrsmStGearLvr1, TrsmStGearLvrToTrsmStGearLvrOfDrvReq, TrsmStTrfCaseDftl, TrsmStTrfCaseDftl, TrsmStTrfCaseDftl1, TrsmTOil, TrsmTOil1, TrsmTqDftlAxleFrntAct, TrsmTqDftlAxleFrntAct1, TrsmTqDftlAxleFrntConsold, TrsmTqDftlAxleFrntConsold, TrsmTqDftlAxleFrntConsold1, TrsmTqDftlAxleFrntMax, TrsmTqDftlAxleFrntMax, TrsmTqDftlAxleFrntMax1, TrsmTqDftlAxleReAct, TrsmTqDftlAxleReAct1, TrsmTqDftlAxleReConsold, TrsmTqDftlAxleReConsold, TrsmTqDftlAxleReConsold1, TrsmTqDftlAxleReMax, TrsmTqDftlAxleReMax, TrsmTqDftlAxleReMax1, TrsmTqDftlTrfAct, TrsmTqDftlTrfAct1, TrsmTqDftlTrfConsold, TrsmTqDftlTrfConsold, TrsmTqDftlTrfConsold1, TrsmTqDftlTrfMax, TrsmTqDftlTrfMax, TrsmTqDftlTrfMax1, TrsmTqLoss, TrsmTqOilPmp, TrsmTqOilPmp1, TrsmTqWhlIndDistbn, TrsmTqWhlIndDistbn, TrsmTqWhlIndDistbn1, VehCourseCrvtPred, VehCourseCrvtPred1, VehMtnForPt, VehMtnForPt, VehMtnForPtMisc, VehMtnSt, VehMtnSt1, VehSpd1, VehSpdDispd, VehSpdDispd1, VehSpdLgt, VehSpdLgt, VehSpdLgt, VehSpdLgt, VehSpdLgt, VehSpdLgt1, VehSpdLgtToVehSpdLgtOfDrvReq, VehSpdLgtToVehSpdLgtOfPtCoorr, VehSpdLgtToVehSpdLgtOfVehMtnForPt, VehSpdLimnForSfty, VehStOper, VehTqWhlMaxSftyLimn, VehTqWhlMaxSftyLimn, VehTqWhlMaxSftyLimn, VehTqWhlMaxSftyLimn1, VehTqWhlMaxSftyLimnOfVehMtnForPtToVehTqWhlMaxSftyLimnOfPtCoorr, VehTqWhlMaxSftyLimnToVehTqWhlMaxSftyLimnOfVehSpdLimnForSfty, VehVLgt, VlcA, VlcStShiftPrevnCmft, VlcTqWhlPtMax, VlcTqWhlPtMin, WhlBrkOvrheatd, WhlBrkOvrheatd1, WhlDirRotl1, WhlDirRotlStd, WhlRdTolrCoeff, WhlRdTolrCoeff1, WhlSpdCircuml1, WhlSpdCircumlMeasd, WhlSpdCircumlMeasd, WhlSpdCircumlMeasdToWhlSpdCircumlMeasdOfPtCoorr, WhlSpdCircumlStd, YawRate1, YawRateBas, YawRateOffsStdByEsc, YawStabyCtrlIntvg, YawStabyCtrlIntvg1, YawStabyInfo1, YawStabyInfoByEsc]
  collection PtRefAllToPt: category=RELATION, element-role=AUTO_COLLECTED_FROM, element=Pt, source-element=PtRefAll
