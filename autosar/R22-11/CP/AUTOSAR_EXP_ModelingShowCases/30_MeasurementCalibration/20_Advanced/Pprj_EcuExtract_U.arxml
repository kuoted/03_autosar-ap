AUTOSAR XML (schema 00051)
package /Tier1/ARPlatform1/System
  system SystemU_System: category=ECU_EXTRACT
    root-software-compositions:
      root sw composition prototype SystemU: flat-map=FlatMap_SystemU_EcuExtract, software-composition=SystemU_Root
package /Tier1/ARPlatform1/System/CompositionSwComponentTypes
  composition sw component type SystemU_Root
    7 x component:
      CMscA: type=CMscA
      CMscA_par: type=CMscA_par
      CMscB: type=CMscB
      CMscB_par: type=CMscB_par
      CMscC_nvm: type=CMscC_nvm
      CMscD: type=CMscD
      CMscD_par: type=CMscD_par
    connect CMscA.P_ModeDirection -> CMscA.R_ModeDirection
    connect CMscA.P_ModeDirection -> CMscB.R_ModeDirection
    connect CMscA.P_PrimData_Mass_Lnr_Kg_uint8 -> CMscA.R_PrimData_Mass_Lnr_Kg_uint8
    connect CMscA.P_PrimData_Mass_Lnr_Kg_uint8 -> CMscB.R_PrimData_Mass_Lnr_Kg_uint8
    connect CMscA.P_PrimData_StepsSpeed_Txt_sint8 -> CMscC_nvm.R_PrimData_StepsSpeed_Txt_sint8
    connect CMscA.P_PrimData_Temperature_Lin_K_C_uint16 -> CMscA.R_PrimData_Temperature_Lin_K_C_uint16
    connect CMscA.P_PrimData_Temperature_Lin_K_C_uint16 -> CMscB.R_PrimData_Temperature_Lin_K_C_uint16
    connect CMscA_par.P_PrimCal_Mass_Lnr_Kg -> CMscA.R_PrimCal_Mass_Lnr_Kg
    connect CMscB.P_PrimData_MassCorrected_Lnr_Kg_uint8 -> CMscB.R_PrimData_MassCorrected_Lnr_Kg_uint8
    connect CMscB.P_PrimData_MassCorrected_Lnr_Kg_uint8 -> CMscD.R_PrimData_MassCorrected_Lnr_Kg_uint8
    connect CMscB.P_PrimData_Time_Lnr_s_uint16 -> CMscB.R_PrimData_Time_Lnr_s_uint16
    connect CMscB.P_PrimData_ValidState_Txt_noUnit_boolean -> CMscB.R_PrimData_ValidState_Txt_noUnit_boolean
    connect CMscB_par.P_ComAxis_Mass_Lnr_Kg_uint8 -> CMscB.R_ComAxis_Mass_Lnr_Kg_uint8
    connect CMscB_par.P_ComAxis_Mass_Lnr_Kg_uint8 -> CMscD.R_ComAxis_Mass_Lnr_Kg_uint8
    connect CMscB_par.P_ComAxis_Steps_Txt_sint8 -> CMscB.R_ComAxis_Steps_Txt_sint8
    connect CMscB_par.P_ComAxis_Temp_Lin_K_uint16 -> CMscB.R_ComAxis_Temp_Lin_K_uint16
    connect CMscB_par.P_Curve_Mass_Lnr_Kg_uint8 -> CMscB.R_Curve_Mass_Lnr_Kg_uint8
    connect CMscB_par.P_Map_Time_Lnr_s_uint16 -> CMscB.R_Map_Time_Lnr_s_uint16
    connect CMscC_nvm.P_PrimData_StepsSpeed_Txt_sint8 -> CMscA.R_PrimData_StepsSpeed_Txt_sint8
    connect CMscC_nvm.P_PrimData_StepsSpeed_Txt_sint8 -> CMscB.R_PrimData_StepsSpeed_Txt_sint8
    connect CMscD.P_Arr1dPrimData_Temperature_Lin_K_C_uint16 -> CMscD.R_Arr1dPrimData_Temperature_Lin_K_C_uint16
    connect CMscD_par.P_Arr1dComAxis_Temp_Lin_K_uint16 -> CMscD.R_Arr1dComAxis_Temp_Lin_K_uint16
    connect CMscD_par.P_Arr1dMap_Time_Lnr_s_uint16 -> CMscD.R_Arr1dMap_Time_Lnr_s_uint16
