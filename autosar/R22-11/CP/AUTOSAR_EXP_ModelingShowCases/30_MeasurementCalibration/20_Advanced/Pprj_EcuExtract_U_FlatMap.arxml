AUTOSAR XML (schema 00051)
package /Tier1/ARPlatform1/System/FlatMaps
  flat map FlatMap_SystemU_EcuExtract
    28 x flat instance descriptor:
      Arr1dComAxis_Temp_Lin_K_uint16: ecu-extract-reference=SystemU.CMscD_par.P_Arr1dComAxis_Temp_Lin_K_uint16.Arr1dComAxis_Temp_Lin_K_uint16
      Arr1dComAxis_Temp_Lin_K_uint16_FrontLeft: ecu-extract-reference=SystemU.CMscD_par.P_Arr1dComAxis_Temp_Lin_K_uint16.Arr1dComAxis_Temp_Lin_K_uint16.ComAxis_Temp_Lin_K_uint16_ScNoOfWheels
      Arr1dComAxis_Temp_Lin_K_uint16_FrontRight: ecu-extract-reference=SystemU.CMscD_par.P_Arr1dComAxis_Temp_Lin_K_uint16.Arr1dComAxis_Temp_Lin_K_uint16.ComAxis_Temp_Lin_K_uint16_ScNoOfWheels
      Arr1dComAxis_Temp_Lin_K_uint16_RearLeft: ecu-extract-reference=SystemU.CMscD_par.P_Arr1dComAxis_Temp_Lin_K_uint16.Arr1dComAxis_Temp_Lin_K_uint16.ComAxis_Temp_Lin_K_uint16_ScNoOfWheels
      Arr1dComAxis_Temp_Lin_K_uint16_RearRight: ecu-extract-reference=SystemU.CMscD_par.P_Arr1dComAxis_Temp_Lin_K_uint16.Arr1dComAxis_Temp_Lin_K_uint16.ComAxis_Temp_Lin_K_uint16_ScNoOfWheels
      Arr1dMap_Time_Lnr_s_uint16: ecu-extract-reference=SystemU.CMscD_par.P_Arr1dMap_Time_Lnr_s_uint16.Arr1dMap_Time_Lnr_s_uint16
      Arr1dMap_Time_Lnr_s_uint16_FrontLeft: ecu-extract-reference=SystemU.CMscD_par.P_Arr1dMap_Time_Lnr_s_uint16.Arr1dMap_Time_Lnr_s_uint16.Map_Time_Lnr_s_uint16_ScNoOfWheels
      Arr1dMap_Time_Lnr_s_uint16_FrontRight: ecu-extract-reference=SystemU.CMscD_par.P_Arr1dMap_Time_Lnr_s_uint16.Arr1dMap_Time_Lnr_s_uint16.Map_Time_Lnr_s_uint16_ScNoOfWheels
      Arr1dMap_Time_Lnr_s_uint16_RearLeft: ecu-extract-reference=SystemU.CMscD_par.P_Arr1dMap_Time_Lnr_s_uint16.Arr1dMap_Time_Lnr_s_uint16.Map_Time_Lnr_s_uint16_ScNoOfWheels
      Arr1dMap_Time_Lnr_s_uint16_RearRight: ecu-extract-reference=SystemU.CMscD_par.P_Arr1dMap_Time_Lnr_s_uint16.Arr1dMap_Time_Lnr_s_uint16.Map_Time_Lnr_s_uint16_ScNoOfWheels
      Arr1dPrimData_Temperature_Lin_K_C_uint16: ecu-extract-reference=SystemU.CMscD.P_Arr1dPrimData_Temperature_Lin_K_C_uint16.Arr1dPrimData_Temperature_Lin_K_C_uint16
      Arr1dPrimData_Temperature_Lin_K_C_uint16_FrontLeft: ecu-extract-reference=SystemU.CMscD.P_Arr1dPrimData_Temperature_Lin_K_C_uint16.Arr1dPrimData_Temperature_Lin_K_C_uint16.K_Celsius_Lnr_0_511d9921875_0_FFFF_uint16_ScNoOfWheels
      Arr1dPrimData_Temperature_Lin_K_C_uint16_FrontRight: ecu-extract-reference=SystemU.CMscD.P_Arr1dPrimData_Temperature_Lin_K_C_uint16.Arr1dPrimData_Temperature_Lin_K_C_uint16.K_Celsius_Lnr_0_511d9921875_0_FFFF_uint16_ScNoOfWheels
      Arr1dPrimData_Temperature_Lin_K_C_uint16_RearLeft: ecu-extract-reference=SystemU.CMscD.P_Arr1dPrimData_Temperature_Lin_K_C_uint16.Arr1dPrimData_Temperature_Lin_K_C_uint16.K_Celsius_Lnr_0_511d9921875_0_FFFF_uint16_ScNoOfWheels
      Arr1dPrimData_Temperature_Lin_K_C_uint16_RearRight: ecu-extract-reference=SystemU.CMscD.P_Arr1dPrimData_Temperature_Lin_K_C_uint16.Arr1dPrimData_Temperature_Lin_K_C_uint16.K_Celsius_Lnr_0_511d9921875_0_FFFF_uint16_ScNoOfWheels
      CMscC_nvm: ecu-extract-reference=SystemU.CMscC_nvm
      ComAxis_Mass_Lnr_Kg_uint8: ecu-extract-reference=SystemU.CMscB_par.P_ComAxis_Mass_Lnr_Kg_uint8.ComAxis_Mass_Lnr_Kg_uint8
      ComAxis_Steps_Txt_sint8: ecu-extract-reference=SystemU.CMscB_par.P_ComAxis_Steps_Txt_sint8.ComAxis_Steps_Txt_sint8
      ComAxis_Temp_Lin_K_uint16: ecu-extract-reference=SystemU.CMscB_par.P_ComAxis_Temp_Lin_K_uint16.ComAxis_Temp_Lin_K_uint16
      Curve_Mass_Lnr_Kg_uint8: ecu-extract-reference=SystemU.CMscB_par.P_Curve_Mass_Lnr_Kg_uint8.Curve_Mass_Lnr_Kg_uint8
      Map_Time_Lnr_s_uint16: ecu-extract-reference=SystemU.CMscB_par.P_Map_Time_Lnr_s_uint16.Map_Time_Lnr_s_uint16
      PrimCal_Mass_Lnr_Kg: ecu-extract-reference=SystemU.CMscA_par.P_PrimCal_Mass_Lnr_Kg.PrimCal_Mass_Lnr_Kg
      PrimData_MassCorrected_Lnr_Kg_uint8: ecu-extract-reference=SystemU.CMscB.P_PrimData_MassCorrected_Lnr_Kg_uint8.PrimData_MassCorrected_Lnr_Kg_uint8
      PrimData_Mass_Lnr_Kg_uint8: ecu-extract-reference=SystemU.CMscA.P_PrimData_Mass_Lnr_Kg_uint8.PrimData_Mass_Lnr_Kg_uint8
      PrimData_StepsSpeed_Txt_sint8: ecu-extract-reference=SystemU.CMscC_nvm.P_PrimData_StepsSpeed_Txt_sint8.PrimData_StepsSpeed_Txt_sint8
      PrimData_Temperature_Lin_K_C_uint16: ecu-extract-reference=SystemU.CMscA.P_PrimData_Temperature_Lin_K_C_uint16.PrimData_Temperature_Lin_K_C_uint16
      PrimData_Time_Lnr_s_uint16: ecu-extract-reference=SystemU.CMscB.P_PrimData_Time_Lnr_s_uint16.PrimData_Time_Lnr_s_uint16
      PrimData_ValidState_Txt_noUnit_boolean: ecu-extract-reference=SystemU.CMscB.P_PrimData_ValidState_Txt_noUnit_boolean.PrimData_ValidState_Txt_noUnit_boolean
