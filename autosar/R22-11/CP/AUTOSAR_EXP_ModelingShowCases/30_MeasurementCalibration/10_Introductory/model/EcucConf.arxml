AUTOSAR XML (schema 00051)
package /McInt/OS
  module config OS_CFG: definition=Os
    OSDEFAULTAPPMODE (OsAppMode)
    task_100ms (OsTask): OsTaskPriority=1, OsTaskActivation=1, OsTaskSchedule=FULL
package /McInt/RTE
  module config RTE_CFG: definition=Rte
    RteGeneration:
      RteGenerationMode = COMPATIBILITY_MODE
      RteCalibrationSupport = NONE
      RteDevErrorDetect = 0
      RteDevErrorDetectUninit = 0
      RteIocInteractionReturnValue = RTE_COM
      RteMeasurementSupport = 1
      RteOptimizationMode = RUNTIME
      RteToolChainSignificantCharacters = 127
      RteVfbTraceEnabled = 0
    3 x RteSwComponentInstance:
      CPT_Controller: RteSoftwareComponentInstanceRef=CPT_Controller
        controller100ms (RteEventToTaskMapping): RtePositionInTask=3, RteActivationOffset=0.0, RteMappedToTaskRef=task_100ms, RteEventRef=controller100ms
      CPT_Plant: RteSoftwareComponentInstanceRef=CPT_Plant
        plant100ms (RteEventToTaskMapping): RtePositionInTask=2, RteActivationOffset=0.0, RteMappedToTaskRef=task_100ms, RteEventRef=plant100ms
      CPT_Environment: RteSoftwareComponentInstanceRef=CPT_Environment
        env100ms (RteEventToTaskMapping): RtePositionInTask=1, RteActivationOffset=0.0, RteMappedToTaskRef=task_100ms, RteEventRef=env100ms
package /McInt/EcucValueCollection
  ecuc value collection EcucValueCollection: ecu-extract=EcuExtract, ecuc-values=[RTE_CFG, OS_CFG]
