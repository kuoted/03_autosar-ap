AUTOSAR XML (schema 00051)
package /McInt/System
  flat map FlatMap
    11 x flat instance descriptor:
      TPlant: ecu-extract-reference=RootSwCompositionPrototype.CPT_Plant.PlantTemperaturePPP.T
      I: ecu-extract-reference=RootSwCompositionPrototype.CPT_Controller.CurrentPPP.I
      ctrl_ESum: ecu-extract-reference=RootSwCompositionPrototype.CPT_Controller.ESum
      plnt_QPlant: ecu-extract-reference=RootSwCompositionPrototype.CPT_Plant.QPlant
      plnt_QEnv: ecu-extract-reference=RootSwCompositionPrototype.CPT_Plant.QEnv
      plnt_QHeater: ecu-extract-reference=RootSwCompositionPrototype.CPT_Plant.QHeater
      TEnv: ecu-extract-reference=RootSwCompositionPrototype.CPT_Environment.EnvTemperaturePPP.T
      ctrl_E: ecu-extract-reference=RootSwCompositionPrototype.CPT_Controller.E
      env_THighLimit: ecu-extract-reference=RootSwCompositionPrototype.CPT_Environment.THighLimit
      env_TEnv: ecu-extract-reference=RootSwCompositionPrototype.CPT_Environment.TEnv
      env_Seed: ecu-extract-reference=RootSwCompositionPrototype.CPT_Environment.Seed
