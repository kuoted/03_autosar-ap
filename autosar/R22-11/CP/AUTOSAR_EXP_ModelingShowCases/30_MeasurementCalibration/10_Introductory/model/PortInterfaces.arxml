AUTOSAR XML (schema 00051)
package /McInt/PortInterfaces
  sender receiver interface TemperatureSRIF  # Interface type for transferring temperatures in [°C]
    data T: sw-addr-method=VAR, sw-calibration-access=READ-ONLY, type=Temperature_C
  parameter interface ControllerPIF  # Interface with all parameters for the controller
    parameter data prototype ctrl_SetPoint: sw-addr-method=CALIB, sw-calibration-access=READ-WRITE, type=Temperature_C  # Set point for the temperature of the plant
    parameter data prototype ctrl_K: sw-addr-method=CALIB, sw-calibration-access=READ-WRITE, type=Amplification  # Amplification factor for the I-controller
    parameter data prototype ctrl_MaxESum: sw-addr-method=CALIB, sw-calibration-access=READ-WRITE, type=ESum  # Upper limit of the integal part of the I-controller
  sender receiver interface CurrentSRIF  # Interface type for transferring a current in [mA]
    data I: sw-addr-method=VAR, sw-calibration-access=READ-ONLY, type=Current
  parameter interface PlantPIF  # Interface with all parameters for the plant
    parameter data prototype plnt_EnvFactor: sw-addr-method=CALIB, sw-calibration-access=READ-WRITE, type=EnvFactor  # Proportionality factor for the heat flow between plant and environment
    parameter data prototype plnt_HeaterFactor: sw-addr-method=CALIB, sw-calibration-access=READ-WRITE, type=HeaterFactor  # Proportionality factor for the heat flow between plant and the electrical heater
  parameter interface EnvironmentPIF  # Interface with all parameters for the environment
    parameter data prototype env_TLowLimit: sw-addr-method=CALIB, sw-calibration-access=READ-WRITE, type=Temperature_C  # Lower limit of the generated temeprature profile
    parameter data prototype env_TStepSize: sw-addr-method=CALIB, sw-calibration-access=READ-WRITE, type=Temperature_K  # The maximal temperature diffenrence of the environment in one time step
    parameter data prototype env_THighLimitDistance: sw-addr-method=CALIB, sw-calibration-access=READ-WRITE, type=Temperature_K  # Distance of the upper limit from the lower limit for the generated temeprature profile.
  parameter interface DtPIF
    parameter data prototype Dt: sw-addr-method=CALIB, sw-calibration-access=READ-WRITE, type=Time  # Scheduling time of the components
