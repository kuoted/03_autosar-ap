AUTOSAR XML (schema 00049)
package /Tier1/ARPlatform1/System
  system SystemU_System: category=ECU_EXTRACT
    root-software-compositions:
      root sw composition prototype SystemU: flat-map=FlatMap_SystemU_EcuExtract, software-composition=SystemU_Root
package /Tier1/ARPlatform1/System/FlatMaps
  flat map FlatMap_SystemU_EcuExtract
package /Tier1/ARPlatform1/System/EcucValueCollections
  ecuc value collection SystemU_EcuCValues: ecu-extract=SystemU_System, ecuc-values=[EMS3DIP, EcuC]
