AUTOSAR XML (schema 00049)
standard types defined: float32
package /AUTOSAR_Rte/BswImplementations
  bsw implementation Rte
    mc-support mc-sw-emulation-method-support=category=NONE:
      mc-parameter-instances:
        9 x mc data instance, all with category=VALUE:
          ctrl_K: resulting-properties={base-type=float32, sw-calibration-access=READ-WRITE, compu-method=McInt_CompuMethods_Identical, display-format=%.1f, unit=McInt_Units_MilliAmperePerKelvinSecond}  # Amplification factor for the I-controller
          ctrl_MaxESum: resulting-properties={base-type=float32, sw-calibration-access=READ-WRITE, compu-method=McInt_CompuMethods_Identical, display-format=%.1f, unit=McInt_Units_KelvinSecond}  # Upper limit of the integal part of the I-controller
          ctrl_SetPoint: resulting-properties={base-type=float32, sw-calibration-access=READ-WRITE, compu-method=McInt_CompuMethods_Temperature_C, display-format=%.1f, unit=McInt_Units_DegreeCelsius}  # Set point for the temperature of the plant
          Dt: resulting-properties={base-type=float32, sw-calibration-access=READ-WRITE, compu-method=McInt_CompuMethods_Identical, display-format=%.3f, unit=McInt_Units_Second}  # Scheduling time of the components
          env_THighLimitDistance: resulting-properties={base-type=float32, sw-calibration-access=READ-WRITE, compu-method=McInt_CompuMethods_Identical, display-format=%.1f, unit=McInt_Units_Kelvin}  # Distance of the upper limit from the lower limit for the generated temeprature profile.
          env_TLowLimit: resulting-properties={base-type=float32, sw-calibration-access=READ-WRITE, compu-method=McInt_CompuMethods_Temperature_C, display-format=%.1f, unit=McInt_Units_DegreeCelsius}  # Lower limit of the generated temeprature profile
          env_TStepSize: resulting-properties={base-type=float32, sw-calibration-access=READ-WRITE, compu-method=McInt_CompuMethods_Identical, display-format=%.1f, unit=McInt_Units_Kelvin}  # The maximal temperature diffenrence of the environment in one time step
          plnt_EnvFactor: resulting-properties={base-type=float32, sw-calibration-access=READ-WRITE, compu-method=McInt_CompuMethods_Identical, display-format=%.1f, unit=McInt_Units_JoulePerKelvinSecond}  # Proportionality factor for the heat flow between plant and environment
          plnt_HeaterFactor: resulting-properties={base-type=float32, sw-calibration-access=READ-WRITE, compu-method=McInt_CompuMethods_Identical, display-format=%.1f, unit=McInt_Units_JoulePerMilliAmpereSecond}  # Proportionality factor for the heat flow between plant and the electrical heater
      mc-variable-instances:
        10 x mc data instance, all with category=VALUE:
          I: flat-map-entry=I, resulting-properties={base-type=float32, sw-calibration-access=READ-ONLY, compu-method=McInt_CompuMethods_Current_mA, display-format=%.1f, unit=McInt_Units_MilliAmpere}  # Type for the current in [mA]
          ctrl_E: flat-map-entry=ctrl_E, resulting-properties={base-type=float32, sw-calibration-access=READ-ONLY, compu-method=McInt_CompuMethods_Identical, display-format=%.1f, unit=McInt_Units_Kelvin}  # Measurement point for the control error, the deviation between set point and acutal temperature of the plant, in the current time step
          ctrl_ESum: flat-map-entry=ctrl_ESum, resulting-properties={base-type=float32, sw-calibration-access=READ-ONLY, compu-method=McInt_CompuMethods_Identical, display-format=%.1f, unit=McInt_Units_KelvinSecond}  # Internal state of the controller: the sum of control errors
          TEnv: flat-map-entry=TEnv, resulting-properties={base-type=float32, sw-calibration-access=READ-ONLY, compu-method=McInt_CompuMethods_Temperature_C, display-format=%.1f, unit=McInt_Units_DegreeCelsius}  # Type for a temperature in [ï¿½C]
          env_THighLimit: flat-map-entry=env_THighLimit, resulting-properties={base-type=float32, sw-calibration-access=READ-ONLY, compu-method=McInt_CompuMethods_Temperature_C, display-format=%.1f, unit=McInt_Units_DegreeCelsius}  # Measurement point for the upper limit of the generated temperature profile
          env_TEnv: flat-map-entry=env_TEnv, resulting-properties={base-type=float32, sw-calibration-access=READ-ONLY, compu-method=McInt_CompuMethods_Temperature_C, display-format=%.1f, unit=McInt_Units_DegreeCelsius}  # Internal state of the environment: the temperture of the environment
          TPlant: flat-map-entry=TPlant, resulting-properties={base-type=float32, sw-calibration-access=READ-ONLY, compu-method=McInt_CompuMethods_Temperature_C, display-format=%.1f, unit=McInt_Units_DegreeCelsius}  # Type for a temperature in [ï¿½C]
          plnt_QEnv: flat-map-entry=plnt_QEnv, resulting-properties={base-type=float32, sw-calibration-access=READ-ONLY, compu-method=McInt_CompuMethods_Identical, display-format=%.1f, unit=McInt_Units_Joule}  # Measurement point for heat flow between the plant and the environment in the current time step.
          plnt_QHeater: flat-map-entry=plnt_QHeater, resulting-properties={base-type=float32, sw-calibration-access=READ-ONLY, compu-method=McInt_CompuMethods_Identical, display-format=%.1f, unit=McInt_Units_Joule}  # Measurement point for heat flow between the electrical heater and the plant in the current time step.
          plnt_QPlant: flat-map-entry=plnt_QPlant, resulting-properties={base-type=float32, sw-calibration-access=READ-ONLY, compu-method=McInt_CompuMethods_Identical, display-format=%.1f, unit=McInt_Units_Joule}  # Internal state of the plant: the stored eneregy quantity in the current time step
package /AUTOSAR_Rte/Units
  9 x unit:
    McInt_Units_MilliAmpere: display-name=mA, factor-si-to-unit=1000.0, offset-si-to-unit=0.0, physical-dimension=McInt_PhysicalDimensions_Current
    McInt_Units_Kelvin: display-name=K, factor-si-to-unit=1.0, offset-si-to-unit=0.0, physical-dimension=McInt_PhysicalDimensions_Temparature
    McInt_Units_KelvinSecond: display-name=Ks, factor-si-to-unit=1.0, offset-si-to-unit=0.0, physical-dimension=McInt_PhysicalDimensions_TemparatureTime
    McInt_Units_DegreeCelsius: display-name=ï¿½C, factor-si-to-unit=1.0, offset-si-to-unit=-273.15, physical-dimension=McInt_PhysicalDimensions_Temparature
    McInt_Units_MilliAmperePerKelvinSecond: display-name=mA/Ks, factor-si-to-unit=1000.0, offset-si-to-unit=0.0, physical-dimension=McInt_PhysicalDimensions_CurrentPerTemperatureTime
    McInt_Units_Second: display-name=s, factor-si-to-unit=1.0, offset-si-to-unit=0.0, physical-dimension=McInt_PhysicalDimensions_Time
    McInt_Units_JoulePerKelvinSecond: display-name=J/Ks, factor-si-to-unit=1.0, offset-si-to-unit=0.0, physical-dimension=McInt_PhysicalDimensions_EnergyPerTemperatureTime
    McInt_Units_JoulePerMilliAmpereSecond: display-name=J/mAs, factor-si-to-unit=0.001, offset-si-to-unit=0.0, physical-dimension=McInt_PhysicalDimensions_EnergyPerCurrentTime
    McInt_Units_Joule: display-name=J, factor-si-to-unit=1.0, offset-si-to-unit=0.0, physical-dimension=McInt_PhysicalDimensions_Energy
package /AUTOSAR_Rte/CompuMethods
  compu method McInt_CompuMethods_Current_mA: phys=raw*1000; unit McInt_Units_MilliAmpere  # Conversion to illustrate proportional scaling between interface and internal computations
  compu method McInt_CompuMethods_Identical: identical  # Identical conversion (Physical == Internal). Used for most data types here.
  compu method McInt_CompuMethods_Temperature_C: phys=raw-273.15; unit McInt_Units_DegreeCelsius  # Conversion from [ï¿½C] to [K]
package /AUTOSAR_Rte/PhysicalDimensions
  8 x physical dimension, all with molar-amount-exp=0, luminous-intensity-exp=0:
    McInt_PhysicalDimensions_Current: length-exp=0, mass-exp=0, time-exp=0, current-exp=1, temperature-exp=0
    McInt_PhysicalDimensions_Temparature: length-exp=0, mass-exp=0, time-exp=0, current-exp=0, temperature-exp=1
    McInt_PhysicalDimensions_TemparatureTime: length-exp=0, mass-exp=0, time-exp=1, current-exp=0, temperature-exp=1
    McInt_PhysicalDimensions_CurrentPerTemperatureTime: length-exp=0, mass-exp=0, time-exp=-1, current-exp=1, temperature-exp=-1
    McInt_PhysicalDimensions_Time: length-exp=0, mass-exp=0, time-exp=1, current-exp=0, temperature-exp=0
    McInt_PhysicalDimensions_EnergyPerTemperatureTime: length-exp=2, mass-exp=1, time-exp=-3, current-exp=0, temperature-exp=-1
    McInt_PhysicalDimensions_EnergyPerCurrentTime: length-exp=2, mass-exp=1, time-exp=-3, current-exp=-1, temperature-exp=0
    McInt_PhysicalDimensions_Energy: length-exp=2, mass-exp=1, time-exp=-2, current-exp=0, temperature-exp=0
