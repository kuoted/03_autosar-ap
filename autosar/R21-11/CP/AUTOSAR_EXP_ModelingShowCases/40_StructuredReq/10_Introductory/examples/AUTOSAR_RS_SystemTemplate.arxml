AUTOSAR XML (schema 00049)
package /AUTOSAR/Documents/RS_SystemTemplate/Documentations
  documentation RS_SystemTemplate  # Requirements on System Template
    documentation-content table=tgroup=tbody=[entry=p=l-1=Document Change History, [p=l-1=Date, p=l-1=Release, p=l-1=Changed by, p=l-1=Description], [p=l-1=2018-10-31, p=l-1=4.4.0, p=l-1=AUTOSAR Release Management, p=l-1=minor corrections / clarifications / editorial changes; For details please refer to the ChangeDocumentation], [p=l-1=2017-12-08, p=l-1=4.3.1, p=l-1=AUTOSAR Release Management, p=l-1=editorial changes;], [p=l-1=2016-11-30, p=l-1=4.3.0, p=l-1=AUTOSAR Release Management, p=l-1=minor corrections / clarifications / editorial changes; For details please refer to the ChangeDocumentation], [p=l-1=2015-07-31, p=l-1=4.2.2, p=l-1=AUTOSAR Release Management, p=l-1=minor corrections / clarifications / editorial changes; For details please refer to the ChangeDocumentation], [p=l-1=2014-10-31, p=l-1=4.2.1, p=l-1=AUTOSAR Release Management, list=item=p=l-1=Added requirements RS_SYST_00049, RS_SYST_00050, RS_SYST_00051, RS_SYST_00052, RS_SYST_00053, RS_SYST_00054, RS_SYST_00055, RS_SYST_00056], [p=l-1=2013-10-31, p=l-1=4.1.2, p=l-1=AUTOSAR Release Management, p=l-1=Layout update.], [p=l-1=2013-03-15, p=l-1=4.1.1, p=l-1=AUTOSAR Administration, list=item=p=l-1=Added requirements RS_SYST_00043, RS_SYST_00044, RS_SYST_00045, RS_SYST_00046, RS_SYST_00047, RS_SYST_00048], [p=l-1=2011-12-22, p=l-1=4.0.3, p=l-1=AUTOSAR Administration, list=item=p=l-1=Added requirement RS_SYST_00042], [p=l-1=2009-12-18, p=l-1=4.0.1, p=l-1=AUTOSAR Administration, list=[p=l-1=Added requirements RS_SYST_00027, RS_SYST_00028, RS_SYST_00029, RS_SYST_00030, RS_SYST_00031, RS_SYST_00037, RS_SYST_00038, RS_SYST_00039, RS_SYST_00041, p=l-1=Refined requirement SYSCT0004 with SYSCT32, SYSCT33, SYSCT34, SYSCT35, SYSCT36, p=l-1=Refined requirement SYSCT0005 with RS_SYST_00037 and RS_SYST_00040, p=l-1=Refined requirement RS_SYST_00007, RS_SYST_00001, RS_SYST_00035, p=l-1=Legal disclaimer revised]], [p=l-1=2008-08-13, p=l-1=3.1.1, p=l-1=AUTOSAR Administration, p=l-1=Legal disclaimer revised], [p=l-1=2007-12-21, p=l-1=3.0.1, p=l-1=AUTOSAR Administration, list=[p=l-1=Added requirements RS_SYST_00025 and RS_SYST_00026, p=l-1=Set requirement RS_SYST_00023 to "postponed", p=l-1=Document meta information extended, p=l-1=Small layout adaptations made]], [p=l-1=2006-11-28, p=l-1=2.1, p=l-1=AUTOSAR Administration, {p=l-1=Release as a separate Document. The Specification of System Template V1.0.0 has been split into independent documents for Release 2.1, list=[p=l-1=Legal disclaimer revised, p=l-1=Release Notes added, p=l-1="Advice for users" revised, p=l-1="Revision Information" added]}], [p=l-1=2005-05-31, p=l-1=1.0, p=l-1=AUTOSAR Administration, p=l-1=Initial release as part of the Specification of System Template V1.0.0]], msr-query-topic-1=msr-query-props=msr-query-name=ARDisclaimer, msr-query-topic-1=msr-query-props=msr-query-name=tableofcontents, msr-query-topic-1=msr-query-props={msr-query-name=ARBibliography, msr-query-arg=autosar}:
      chapter sec_3a_scope:  # Scope of this document
        p=l-1=This document collects the requirements on the System Template (SYS-T). The main goal of the System Template is the definition of a relationship between the pure Software View on the System and a Physical System Architecture with networked ECUs.
        p=l-1=The System Template covers the following areas:
        list=[p=l-1=System topology: In the system topology the logical layout of the system is described. This means it is documented which ECU is connected to which cluster or channel., p=l-1=Communication properties: The central purpose of a communication system is the exchange of frames with certain properties., p=l-1=Mapping: The mapping covers the distribution of software components to ECUs as well as the mapping of data elements that are to be exchanged between software components onto signals and frames.]
        p=l-1=The requirements collected in this document will be satisfied by the System Template specification TPS_2d_SystemTemplate. This document implements most of the requirements stated here.
        msr-query-p-1=msr-query-props={msr-query-name=ARInput, msr-query-arg=DocumentConventionsRS, msr-query-arg=DocumentConventionsRS}
        chapter sec_3a_RequirementsTracing: p=l-1=The following table references the requirements specified in RS_2d_RSMain and links to the fulfillments of these.  # Requirements Tracing
          table tgroup=tbody=[[p=l-1=e=Requirement, p=l-1=e=Description, p=l-1=e=Satisfied by], [p=l-1=tt=RS_Main_00010, p=l-1=AUTOSAR shall support the development of safety related systems, p=l-1=[RS_SYST_00028, RS_SYST_00056]], [p=l-1=tt=RS_Main_00026, p=l-1=AUTOSAR shall support high speed and high bandwidth communication between executed SW, p=l-1=[RS_SYST_00048, RS_SYST_00049, RS_SYST_00050, RS_SYST_00055]], [p=l-1=tt=RS_Main_00030, p=l-1=AUTOSAR shall support development processes for safety related systems, p=l-1=[RS_SYST_00003, RS_SYST_00008, RS_SYST_00009, RS_SYST_00016, RS_SYST_00017, RS_SYST_00018, RS_SYST_00019, RS_SYST_00020]], [p=l-1=tt=RS_Main_00060, p=l-1=AUTOSAR shall provide a standardized software interface for communication between Applications, p=l-1=[RS_SYST_00031, RS_SYST_00057]], [p=l-1=tt=RS_Main_00100, p=l-1=AUTOSAR shall provide standardized Basic Software, p=l-1=[RS_SYST_00002, RS_SYST_00025]], [p=l-1=tt=RS_Main_00140, p=l-1=AUTOSAR shall provide network independent communication mechanisms for applications, p=l-1=[RS_SYST_00014, RS_SYST_00049, RS_SYST_00050, RS_SYST_00051]], [p=l-1=tt=RS_Main_00150, p=l-1=AUTOSAR shall support the deployment and reallocation of AUTOSAR Application Software, p=l-1=[RS_SYST_00002, RS_SYST_00007, RS_SYST_00008, RS_SYST_00009, RS_SYST_00016, RS_SYST_00017, RS_SYST_00018, RS_SYST_00019, RS_SYST_00020]], [p=l-1=tt=RS_Main_00161, p=l-1=AUTOSAR shall provide a unified way to describe software systems deployed to Adaptive and / or Classic platforms, p=l-1=[RS_SYST_00045, RS_SYST_00046]], [p=l-1=tt=RS_Main_00180, p=l-1=AUTOSAR shall provide mechanisms to protect intellectual property in a shared development process, p=l-1=RS_SYST_00027], [p=l-1=tt=RS_Main_00190, p=l-1=AUTOSAR shall support standardized interoperability with non-AUTOSAR software, p=l-1=RS_SYST_00001], [p=l-1=tt=RS_Main_00210, p=l-1=No description, p=l-1=[RS_SYST_00001, RS_SYST_00015]], [p=l-1=tt=RS_Main_00230, p=l-1=AUTOSAR shall support network topologies including gateways, p=l-1=[RS_SYST_00013, RS_SYST_00044, RS_SYST_00052]], [p=l-1=tt=RS_Main_00280, p=l-1=AUTOSAR shall support standardized automotive communication protocols, p=l-1=RS_SYST_00058], [p=l-1=tt=RS_Main_00300, p=l-1=AUTOSAR shall provide data exchange formats to support work-share in large inter and intra company development groups, p=l-1=[RS_SYST_00006, RS_SYST_00027]], [p=l-1=tt=RS_Main_00320, p=l-1=AUTOSAR shall provide formats to specify system development, p=l-1=[RS_SYST_00007, RS_SYST_00013, RS_SYST_00045, RS_SYST_00047]], [p=l-1=tt=RS_Main_00340, p=l-1=AUTOSAR shall support the continuous timing requirement analysis, p=l-1=[RS_SYST_00037, RS_SYST_00040]], [p=l-1=tt=RS_Main_00360, p=l-1=AUTOSAR shall support variant management, p=l-1=[RS_SYST_00032, RS_SYST_00033, RS_SYST_00034, RS_SYST_00035, RS_SYST_00036, RS_SYST_00041]], [p=l-1=tt=RS_Main_00400, p=l-1=AUTOSAR shall provide a layered software architecture, p=l-1=RS_SYST_00043], [p=l-1=tt=RS_Main_00420, p=l-1=AUTOSAR shall use established software standards and consolidate de-facto standards for basic software functionality, p=l-1=RS_SYST_00026], [p=l-1=tt=RS_Main_00430, p=l-1=AUTOSAR shall support established automotive communication standards, p=l-1=[RS_SYST_00015, RS_SYST_00021, RS_SYST_00022, RS_SYST_00023, RS_SYST_00024, RS_SYST_00025, RS_SYST_00029, RS_SYST_00030, RS_SYST_00038, RS_SYST_00039, RS_SYST_00052]], [p=l-1=tt=RS_Main_00460, p=l-1=AUTOSAR shall standardize methods to organize mode management on Application, ECU and System level, p=l-1=RS_SYST_00042], [p=l-1=tt=RS_Main_00500, p=l-1=AUTOSAR shall provide naming conventions, p=l-1=RS_SYST_00053], [p=l-1=tt=RS_Main_00510, p=l-1=AUTOSAR shall support secure onboard communication, p=l-1=RS_SYST_00054], [p=l-1=tt=RS_Main_01003, p=l-1=AUTOSAR shall support data-oriented communication, p=l-1=RS_SYST_00051]]:
            table caption table_3a_RequirementsTracing  # RequirementsTracing
      chapter chap_3a_Reqnts__e88309c2  # Requirements
        chapter chap_3a_Catry_3a__Main_Reqnts__f16cc39b  # Category: Main Requirements
          chapter chap_3a_Comity_beteen_the_AUTSAR_Temtes__bc133b24  # Compatibility between the AUTOSAR Templates
            structured req RS_SYST_00006:  # Compatibility between the AUTOSAR Templates
              category=REQUIREMENT_ITEM
              date=2007-07-29
              issued-by=WP Methodology&Templates
              type=valid
              importance=high
              description=p=l-1=The compatibility between the AUTOSAR Templates must be guaranteed. In this context, compatibility means that each AUTOSAR template can have references to elements of another AUTOSAR template.
              rationale=p=l-1=Ensuring coherence and interoperability between AUTOSAR templates.
              use-case=p=l-1=Development of an in-vehicle electronic architecture (software modelling, hardware modelling and mapping constraint modelling) using the same tool chain.
              conflicts=p=l-1=None identified.
              supporting-material=p=l-1=--
              remark=p=l-1=--
        chapter chap_3a_Catry_3a__System_Temate_Reqnts__6879bed1  # Category: System Template Requirements
          51 x chapter:
            chap_3a_Legacy_sysems__9b785a11  # Legacy systems
              structured req RS_SYST_00001:  # Mixed Systems (AUTOSAR/NON-AUTOSAR)
                category=REQUIREMENT_ITEM
                date=2004-03-30
                issued-by=WP Methodology&Templates
                type=valid
                importance=high
                description=p=l-1=System constraints, which arise through usage of mixed systems, must be treated by System Template.
                rationale=p=l-1=The transition between non-AUTOSAR systems to full-AUTOSAR systems can only be achieved gradually. Furthermore, interoperability with legacy solutions must be ensured. Thus, it must be possible to have AUTOSAR and non-AUTOSAR ECUs together on the same system ("mixed" systems).
                use-case=p=l-1=Gradual AUTOSAR introduction into an existing architecture e.g. it shall be possible to handle signals not originating from AUTOSAR software components.
                conflicts=p=l-1=None identified.
                supporting-material=p=l-1=--
                remark=p=l-1=--
            chap_3a_Basic_Sofare_and_RTE_Resces__dadab35e  # Basic Software and RTE Resources
              structured req RS_SYST_00002:  # Basic Software Resources and RTE Resources
                category=REQUIREMENT_ITEM
                date=2004-03-30
                issued-by=WP Methodology&Templates
                type=valid
                importance=high
                description=p=l-1=The System Template has to cover resource requests of the basic SW and the RTE.
                rationale=p=l-1=Resources of an ECU are, by their own definition, limited (RAM, ROM, CPU time, etc.). Such limitations act as constraints during the mapping process.
                use-case=p=l-1=Taking into account memory limitations when allocating AUTOSAR services and features on a small ECU.
                conflicts=p=l-1=None identified.
                supporting-material=p=l-1=--
                remark=p=l-1=--
            chap_3a_Iteive_Devent__c4919242  # Iterative Development
              structured req RS_SYST_00003:  # Iterative Development
                category=REQUIREMENT_ITEM
                date=2004-03-30
                issued-by=WP Methodology&Templates
                type=valid
                importance=high
                description=p=l-1=The System Template has to support an iterative system development.
                rationale=p=l-1=During the development of an AUTOSAR system, solutions found in former steps of the system design process are themselves system constraints for the next system generation steps.
                use-case=p=l-1=If new functionalities are added to a vehicle project in a late development phase, the current mapping become itself a constraint for the mapping of the new SW components associated with such new functionalities.
                conflicts=p=l-1=None identified.
                supporting-material=p=l-1=--
                remark=p=l-1=--
            chap_3a_Maing_of_Sofare_Comnts_to_ECUs__3b435270  # Mapping of Software Components to ECUs
              structured req RS_SYST_00007:  # Mapping of Software Components to ECUs
                category=REQUIREMENT_ITEM
                date=2008-06-10
                issued-by=WP Methodology&Templates
                type=valid
                importance=high
                description=p=l-1=The System Template has to describe the mapping of software components to ECUs. An optional mapping of software components to individual processing units residing in one ECU shall also be possible.
                rationale=p=l-1=--
                use-case=p=l-1=For safety reasons (or simply due to the experience) some specific Software Components can run only on some specific ECUs. Such "pre-mapping" is a constraint for the real mapping process.
                conflicts=p=l-1=None identified.
                supporting-material=p=l-1=--
                remark=p=l-1=--
            chap_3a_Maing_of_Sofare_Comnts_to_ECUs_3a__Cluing__2bd5387d  # Mapping of Software Components to ECUs: Clustering
              structured req RS_SYST_00008:  # SWC Cluster
                category=REQUIREMENT_ITEM
                date=2004-03-30
                issued-by=WP Methodology&Templates
                type=valid
                importance=high
                description=p=l-1=The System Constraint Description has to cover the clustering of SW Components. SW Component Clustering means that two SW Components cannot be divided and must be mapped to the same ECU.
                rationale=p=l-1=Due to performance requirements, to safe communication requirements or simply to experience, some communication paths must be prevented to be mapped onto an external bus. Involved SW Components shall then be mapped together onto the same ECU.
                use-case=p=l-1=Safe communication, which may not be carried out over a communication bus, or very strict timing requirements.
                conflicts=p=l-1=None identified.
                supporting-material=p=l-1=--
                remark=p=l-1=--
            chap_3a_Maing_of_Sofare_Comnts_to_ECUs_3a__Sepion__8c82df09  # Mapping of Software Components to ECUs: Separation
              structured req RS_SYST_00009:  # SWC Separation
                category=REQUIREMENT_ITEM
                date=2004-03-30
                issued-by=WP Methodology&Templates
                type=valid
                importance=high
                description=p=l-1=The System Constraint Description has to cover the separation of SW Components. SW Component Separation means that two SW Components cannot be on the same ECU.
                rationale=p=l-1=To enhance the independence of redundant SWC.
                use-case=p=l-1=Two redundant Software Components, implementing safety critical functions, will not be mapped together on the same ECU because of safety requirements (of course, redundancy does not always imply SWC separation).
                conflicts=p=l-1=None identified.
                supporting-material=p=l-1=--
                remark=p=l-1=--
            chap_3a_Topogy_Desion__02de5825  # Topology Description
              structured req RS_SYST_00013:  # Topology
                category=REQUIREMENT_ITEM
                date=2004-03-30
                issued-by=WP Methodology&Templates
                type=valid
                importance=high
                description=p=l-1=The System Template has to describe the topology of an EE System.
                rationale=p=l-1=The available communication paths limit the possible distributions of SW Components to some ECUs.
                use-case=p=l-1=Mapping of SW Components being tightly linked from a functional point of view: the topology must then be known in order to avoid too long data paths.
                conflicts=p=l-1=None identified.
                supporting-material=p=l-1=--
                remark=p=l-1=--
            chap_3a_Data_Segion__ff68c271  # Data Segmentation
              structured req RS_SYST_00014:  # Data Segmentation
                category=REQUIREMENT_ITEM
                date=2004-03-30
                issued-by=WP Methodology&Templates
                type=valid
                importance=medium
                description=p=l-1=The System Template must provide information, which can be used for the segmenting of (application) data to more than 1 frame.
                rationale=p=l-1=Data length limitations of the underlying bus technology.
                use-case=p=l-1=Transmission of diagnostic data, often longer than bus specific maximum frame size.
                conflicts=p=l-1=None identified.
                supporting-material=p=l-1=--
                remark=p=l-1=--
            chap_3a_Bus_bandth__fc672663  # Bus bandwidth
              structured req RS_SYST_00015:  # Bus bandwidth
                category=REQUIREMENT_ITEM
                date=2004-10-22
                issued-by=WP Methodology&Templates
                type=valid
                importance=high
                description=p=l-1=The System Template shall support bandwidth calculation as a constraint for the definition of the Communication Matrix.
                rationale=p=l-1=Bandwidth is a limited resource, acting as a constraint during the definition of the Communication Matrix.
                use-case=p=l-1=When defining the Communication Matrix for mixed systems (AUTOSAR and non-AUTOSAR ECUs), only one part of the Communication Matrix is freely configurable using the AUTOSAR process. That means that the available bandwidth for the AUTOSAR system generator is limited by the non-AUTOSAR part of the Communication Matrix.
                conflicts=p=l-1=None identified.
                supporting-material=p=l-1=--
                remark=p=l-1=--
            chap_3a_Dedted_phycal_conons__1c1be961  # Dedicated physical connections
              structured req RS_SYST_00016:  # Dedicated physical connections
                category=REQUIREMENT_ITEM
                date=2004-10-29
                issued-by=WP Methodology&Templates
                type=valid
                importance=medium
                description=p=l-1=The System Constraint Description shall be able to describe that a signal has to be sent over a dedicated wire, which is only used by two SW-Components (sender and receiver).
                rationale=p=l-1=This technique is commonly used in current safety concepts.
                use-case=p=l-1=Communication with the airbag module.
                conflicts=p=l-1=None identified.
                supporting-material=p=l-1=--
                remark=p=l-1=--
            chap_3a_Maing_of_sigals_to_the_same_phycal_line__e7915c07  # Mapping of signals to the same physical line
              structured req RS_SYST_00017: category=REQUIREMENT_ITEM, date=2004-10-29, issued-by=WP Methodology&Templates, type=valid, importance=medium, description=p=l-1=The System Constraint Description shall be able to describe that a group of signals has to be sent via the same physical line., rationale=p=l-1=--, use-case=p=l-1=--, conflicts=p=l-1=None identified., supporting-material=p=l-1=--, remark=p=l-1=--  # Mapping of signals to the same physical line
            chap_3a_Maing_of_sigals_to_difent_phycal_lines__259799e0  # Mapping of signals to different physical lines
              structured req RS_SYST_00018:  # Mapping of signals to different physical lines
                category=REQUIREMENT_ITEM
                date=2004-10-22
                issued-by=WP Safety
                type=valid
                importance=medium
                description=p=l-1=The System Constraint Description shall be able to describe, if needed, that signals between ECUs are sent via different physical lines.
                rationale=p=l-1=To support hardware and information redundancy (as a mean to support fault detection and fault handling).
                use-case=p=l-1=A mean to guarantee the transmission of very safety critical data, is to force the sending of redundant copies onto different physical lines.
                conflicts=p=l-1=None identified.
                supporting-material=p=l-1=--
                remark=p=l-1=--
            chap_3a_Maing_of_sigals_to_a_spefic_phycal_line__bf5d09de  # Mapping of signals to a specific physical line
              structured req RS_SYST_00019:  # Mapping of signals to a specific physical line
                category=REQUIREMENT_ITEM
                date=2004-10-29
                issued-by=WP Safety
                type=valid
                importance=medium
                description=p=l-1=The System Constraint Description shall be able to describe that signals have to be mapped to a specific physical line.
                rationale=p=l-1=Some signals have to be mapped to specific physical lines due to e.g. special performance and/or safety needs.
                use-case=p=l-1=Powertrain signals have to be mapped to a high-speed bus, due to their timing requirements.
                conflicts=p=l-1=None identified.
                supporting-material=p=l-1=--
                remark=p=l-1=--
            chap_3a_Excion_of_sigals_from_a_spefic_phycal_line__4aad9137  # Exclusion of signals from a specific physical line
              structured req RS_SYST_00020:  # Exclusion of signals from a specific physical line
                category=REQUIREMENT_ITEM
                date=2004-10-29
                issued-by=WP Methodology&Templates
                type=valid
                importance=medium
                description=p=l-1=The System Constraint Description shall be able to describe that signals have not to be mapped to a specific physical line.
                rationale=p=l-1=Some physical lines can result unsuitable (too slow, unsafe communication protocol, etc.) for the transmission of some specific signals.
                use-case=p=l-1=Most of power train signals cannot be mapped to a low speed CAN bus, due to their timing requirements.
                conflicts=p=l-1=None identified.
                supporting-material=p=l-1=--
                remark=p=l-1=--
            chap_3a_ECU_Comion_via_CAN__1f75edf8  # ECU Communication via CAN
              structured req RS_SYST_00021:  # ECU Communication via CAN
                category=REQUIREMENT_ITEM
                date=2005-02-23
                issued-by=WP Methodology&Templates
                type=valid
                importance=high
                description=p=l-1=The System Template has to cover the system communication via CAN Bus.
                rationale=p=l-1=CAN is widely used in the automotive systems.
                use-case=p=l-1=Development of a complete, multi-networked, in-vehicle electronic architecture.
                conflicts=p=l-1=None identified.
                supporting-material=p=l-1=--
                remark=p=l-1=--
            chap_3a_ECU_Comion_via_LIN__e5c93a14  # ECU Communication via LIN
              structured req RS_SYST_00022:  # ECU Communication via LIN
                category=REQUIREMENT_ITEM
                date=2004-03-30
                issued-by=WP Methodology&Templates
                type=valid
                importance=high
                description=p=l-1=The System Template has to cover the system communication via LIN.
                rationale=p=l-1=LIN is widely used in the automotive systems.
                use-case=p=l-1=Development of a complete, multi-networked, in-vehicle electronic architecture.
                conflicts=p=l-1=None identified.
                supporting-material=p=l-1=--
                remark=p=l-1=--
            chap_3a_ECU_Comion_via_MOST__0fc27092  # ECU Communication via MOST
              structured req RS_SYST_00023:  # ECU Communication via MOST
                category=REQUIREMENT_ITEM
                date=2004-03-30
                issued-by=WP Methodology&Templates
                type=valid
                importance=high
                description=p=l-1=The System Template has to cover the system communication via MOST.
                rationale=p=l-1=MOST is going to become a standard communication protocol in the automotive industry.
                use-case=p=l-1=Development of a complete, multi-networked, in-vehicle electronic architecture.
                conflicts=p=l-1=None identified.
                supporting-material=p=l-1=--
                remark=p=l-1=--
            chap_3a_ECU_Comion_via_FleRay__3a7056e3  # ECU Communication via FlexRay
              structured req RS_SYST_00024:  # ECU Communication via FlexRay
                category=REQUIREMENT_ITEM
                date=2004-03-30
                issued-by=WP Methodology&Templates
                type=valid
                importance=High
                description=p=l-1=The System Template has to cover the system communication via FlexRay.
                rationale=p=l-1=FlexRay is going to become a standard communication protocol in the automotive industry.
                use-case=p=l-1=Development of a complete, multi-networked, in-vehicle electronic architecture.
                conflicts=p=l-1=None identified.
                supporting-material=p=l-1=--
                remark=p=l-1=--
            chap_3a_Derion_of_COM_Stack_Conion_Parers_from_the_System_Temate__27f30389  # Derivation of COM Stack Configuration Parameters from the System Template
              structured req RS_SYST_00025:  # Derivation of COM Stack Configuration Parameters from the System Template
                category=REQUIREMENT_ITEM
                date=2007-06-29
                issued-by=WP Methodology&Templates
                type=valid
                importance=High
                description=p=l-1=The System Template shall enable the configuration of the Com Stack of the ECU. It handles those parameters that are necessary to describe the inter-ECU communication. Configuration parameters local to an ECU are not in the scope of the System Template.
                rationale=p=l-1=All ECUs connected in one communication cluster needs to be configured consistently.
                use-case=p=l-1=Generate Base ECU Configuration from ECU Extract
                conflicts=p=l-1=None identified.
                supporting-material=p=l-1=--
                remark=p=l-1=--
            chap_3a_ASAM_FIBEX_comity__781400c3  # ASAM FIBEX compatibility
              structured req RS_SYST_00026:  # Fibex compatibility
                category=REQUIREMENT_ITEM
                date=2007-06-29
                issued-by=WP Methodology&Templates
                type=valid
                importance=High
                description=p=l-1=Whenever there is a considerable overlap between the System Template and the ASAM FIBEX Standard, the System Template shall adopt the structures of the ASAM FIBEX Standard.
                rationale=p=l-1=The System Template will benefit from FIBEX as an established proven standard.
                use-case=p=l-1=Facilitate the adoption of the System Template into existing tools which deal with the FIBEX Standard.
                conflicts=p=l-1=None identified.
                supporting-material=p=l-1=ASAM FIBEX
                remark=p=l-1=--
            chap_3a_ECU_Extact_genion_rules__814107c4  # ECU Extract generation rules
              structured req RS_SYST_00027:  # ECU Extract generation rules
                category=REQUIREMENT_ITEM
                date=2008-06-10
                issued-by=WP Methodology&Templates
                type=valid
                importance=High
                description=p=l-1=The ECU Extract is derived from a System Description. The specification for generating the ECU Extract shall be detailed enough to enable semantically unambiguous generation of this artifact.
                rationale=p=l-1=Tool interoperability requires unambiguous description of the ECU Extract.
                use-case=p=l-1=Generate Base ECU Configuration from ECU Extract
                conflicts=p=l-1=None identified.
                supporting-material=p=l-1=--
                remark=p=l-1=--
            chap_3a_IPdu_EndEnd_Comion_Proion_suort__ae48aaeb  # IPdu End-to-End Communication Protection support
              structured req RS_SYST_00028:  # IPdu End-to-End Communication Protection support
                category=REQUIREMENT_ITEM
                date=2008-06-10
                issued-by=WP Safety
                type=valid
                importance=High
                description=p=l-1=The System Template shall enable to select E2E protection settings for IPdus.
                rationale=p=l-1=Protect communication between COM modules.
                use-case=p=l-1=Transmission of safety-related data on a single channel without redundancy.
                conflicts=p=l-1=None identified.
                supporting-material=p=l-1=--
                remark=p=l-1=--
            chap_3a_Dynmic_length_sigals__40a9a211  # Dynamic length signals
              structured req RS_SYST_00029:  # Dynamic length signals
                category=REQUIREMENT_ITEM
                date=2008-06-10
                issued-by=WP COM
                type=valid
                importance=High
                description=p=l-1=The System Template shall support a definition of dynamic length signals. A Signal shall have either a static length or its length should vary up to some statically defined maximum. Signals with a maximum length are called dynamic length signals.
                rationale=p=l-1=Dynamic length signals can change size during run time.
                use-case=p=l-1=--
                conflicts=p=l-1=None identified.
                supporting-material=p=l-1=OSEK COM
                remark=p=l-1=--
            chap_3a_Dynmic_length_IPdus__7ad27888  # Dynamic length IPdus
              structured req RS_SYST_00030:  # Dynamic length IPdus
                category=REQUIREMENT_ITEM
                date=2008-06-10
                issued-by=WP COM
                type=valid
                importance=High
                description=p=l-1=The System Template shall support a definition of IPdus that contain dynamic length signals.
                rationale=p=l-1=Dynamic length IPdus can change size during run time.
                use-case=p=l-1=The Network Layer and the Data Link Layer are capable of transmitting and receiving both fixed and dynamic-length I-Pdus as determined by the Interaction Layer.
                conflicts=p=l-1=None identified.
                supporting-material=p=l-1=OSEK COM
                remark=p=l-1=--
            chap_3a_Dision_of_Appion_and_Vehcle_Mode_Reqsts__fb482b90  # Distribution of Application and Vehicle Mode Requests
              structured req RS_SYST_00031:  # Distribution of Application and Vehicle Mode Requests
                category=REQUIREMENT_ITEM
                date=2008-06-10
                issued-by=WP VMM/AMM
                type=valid
                importance=High
                description=p=l-1=The System Template shall support the distribution of application and vehicle mode requests to all affected ECUs.
                rationale=p=l-1=A Mode Requester is an entity that requests modes from a Mode Manager by sending some data via a port with a Mode Request interface. The Mode Manager receives the incoming information, arbitrates the requests and decides upon a resulting mode.
                use-case=p=l-1=Depending on Vehicle and Application Modes, the BSW modes may change, e.g. the communication needs of an Application may cause a change in the BSW Mode of a communication network.
                conflicts=p=l-1=None identified.
                supporting-material=p=l-1=--
                remark=p=l-1=--
            chap_3a_Topogy_varnts__4b6f94b5  # Topology variants
              structured req RS_SYST_00032:  # Topology variants
                category=REQUIREMENT_ITEM
                date=2008-06-12
                issued-by=WP Methodology&Templates
                type=valid
                importance=High
                description=p=l-1=The System Template shall provide the means to describe topology variants with optional/alternative ECUs and communication clusters.
                rationale=p=l-1=In a product line approach different product variants can be realized by a common core topology with only a few varying topology nodes.
                use-case=p=l-1=In a product line two different product variants HIGH and LOW use the same common core topology with the difference, that the product variant HIGH requires an additional ECU.
                conflicts=p=l-1=None identified.
                supporting-material=p=l-1=--
                remark=p=l-1=--
            chap_3a_SofECU_maing_varnts__e9f39435  # Software-to-ECU mapping variants
              structured req RS_SYST_00033:  # Software-to-ECU mapping variants
                category=REQUIREMENT_ITEM
                date=2008-06-12
                issued-by=WP Methodology&Templates
                type=valid
                importance=High
                description=p=l-1=The System Template shall provide the means to describe alternative mappings of software components to ECUs.
                rationale=p=l-1=In order to reach different specific characteristics of the overall system for products within a product line a different mapping of software components is used.
                use-case=p=l-1=In a product line two different product variants HIGH and LOW use the same common software architecture but define a different mapping to the network topology.
                conflicts=p=l-1=None identified.
                supporting-material=p=l-1=--
                remark=p=l-1=--
            chap_3a_Timing_Varnts__5bbcc7bd  # Timing Variants
              structured req RS_SYST_00034:  # Timing Variants
                category=REQUIREMENT_ITEM
                date=2008-06-12
                issued-by=WP Methodology&Templates
                type=valid
                importance=High
                description=p=l-1=The System Template shall provide the means to describe alternative timing properties (e.g. trigger type, period, priority) and timing constraints (e.g. latency, age).
                rationale=p=l-1=Due to a different software-to-ECU mapping the timing properties and constraints for the transmission of signals can vary.
                use-case=p=l-1=A PDU is transmitted cyclically for two different product variants HIGH and LOW with a period of 10ms for the variant HIGH and 20ms for the variant LOW.
                conflicts=p=l-1=None identified.
                supporting-material=p=l-1=--
                remark=p=l-1=--
            chap_3a_Data_maing_varnts__2754a89e  # Data mapping variants
              structured req RS_SYST_00035:  # Data mapping variants
                category=REQUIREMENT_ITEM
                date=2008-06-12
                issued-by=WP Methodology&Templates
                type=valid
                importance=High
                description=p=l-1=The System Template shall provide the means to describe data mapping Variants.
                rationale=p=l-1=Variants in the Software Component Description have an impact on the data mapping which is described in the System Template.
                use-case=p=l-1=A DataElement exists only in one product variant HIGH.
                conflicts=p=l-1=None identified.
                supporting-material=p=l-1=--
                remark=p=l-1=--
            chap_3a_Comion_varnts__38221b79  # Communication variants
              structured req RS_SYST_00036:  # Communication variants
                category=REQUIREMENT_ITEM
                date=2008-06-12
                issued-by=WP Methodology&Templates
                type=valid
                importance=High
                description=p=l-1=The System Template shall provide the means to describe communication variants, such as alternative signal-to-PDU mappings, alternative communication paths, and alternative signal and PDU properties (e.g. data type, data length).
                rationale=p=l-1=To optimize the communication matrix for different product variants which use the same network topology the description of communication variants in the System Template is an essential prerequisite.
                use-case=p=l-1=A signal is transmitted for two different product variants HIGH and LOW with the byte order LittleEndian for the variant HIGH and the byte order BidEndian for the variant LOW.
                conflicts=p=l-1=None identified.
                supporting-material=p=l-1=--
                remark=p=l-1=--
            chap_3a_Timing_proies__2b05540d  # Timing properties
              structured req RS_SYST_00037:  # Timing properties
                category=REQUIREMENT_ITEM
                date=2008-06-12
                issued-by=WP Methodology&Templates
                type=valid
                importance=High
                description=p=l-1=The System Template shall provide the means to describe the timing properties of a system's dynamics, which are determined by the consumption of computation, communication, and other hardware resources.
                rationale=p=l-1=The description of timing properties in the System Template is an essential prerequisite for the analysis and validation of a system's timing behavior or its prediction early in the process.
                use-case=p=l-1=Analysis and validation of timing behavior, early prediction of modification impacts, support for hardware dimensioning, system configuration optimization
                conflicts=p=l-1=None identified.
                supporting-material=p=l-1=--
                remark=p=l-1=--
            chap_3a_Suort_of_SAE_J1939_Procol_Feares__10e26563  # Support of SAE J1939 Protocol Features
              structured req RS_SYST_00038:  # Support of SAE J1939 Protocol Features
                category=REQUIREMENT_ITEM
                date=2008-06-12
                issued-by=WP Methodology&Templates
                type=valid
                importance=High
                description=p=l-1=The System Template has to cover the system communication via SAE J1939.
                rationale=p=l-1=SAE J1939 protocol is an industry standard that is used in automotive systems.
                use-case=p=l-1=Development of a complete, multi-networked, in-vehicle electronic architecture.
                conflicts=p=l-1=None identified.
                supporting-material=p=l-1=--
                remark=p=l-1=--
            chap_3a_ECU_Comion_via_Ethnet__d9d7af95  # ECU Communication via Ethernet
              structured req RS_SYST_00039:  # ECU Communication via Ethernet
                category=REQUIREMENT_ITEM
                date=2008-06-12
                issued-by=WP Methodology&Templates
                type=valid
                importance=High
                description=p=l-1=The System Template has to cover the system communication via Ethernet.
                rationale=p=l-1=Ethernet is going to become a standard communication protocol in the automotive industry.
                use-case=p=l-1=Development of a complete, multi-networked, in-vehicle electronic architecture.
                conflicts=p=l-1=None identified.
                supporting-material=p=l-1=--
                remark=p=l-1=--
              structured req RS_SYST_00052:  # Ethernet Switch Configuration
                category=REQUIREMENT_ITEM
                date=2014-09-01
                issued-by=WP Methodology&Templates
                type=valid
                importance=High
                description=p=l-1=Ethernet Switch Configuration shall provide standardized artifacts to describe the structure of egress ports, port scheduling mechanisms as well as the forwarding process within the switch. Common parameters which can be written to a switch, e.g. during the initialization phase, need to be integrated in the system description.
                rationale=p=l-1=The timing behavior of messages within the switch depends on the configuration of switches. Therefore, the switch behavior needs to be described.
                use-case=p=l-1=Provide the description of an Ethernet topology including the model for switches and their behavior.
                conflicts=p=l-1=--
                supporting-material=p=l-1=--
                remark=p=l-1=--
            chap_3a_Timing_connts__f6d1e225  # Timing constraints
              structured req RS_SYST_00040:  # Timing constraints
                category=REQUIREMENT_ITEM
                date=2008-06-12
                issued-by=WP Methodology&Templates
                type=valid
                importance=High
                description=p=l-1=The System Template shall provide the means to describe the timing constraints of a system's dynamics, which are determined by the consumption of computation, communication, and other hardware resources.
                rationale=p=l-1=The description of timing constraints in the System Template is an essential prerequisite for the analysis and validation of a system's timing behavior or its prediction early in the process.
                use-case=p=l-1=Analysis and validation of timing behavior, early prediction of modification impacts, support for hardware dimensioning, system configuration optimization
                conflicts=p=l-1=None identified.
                supporting-material=p=l-1=--
                remark=p=l-1=--
            chap_3a_Varnts_in_ECU_Extact__1898e0f6  # Variants in ECU Extract
              structured req RS_SYST_00041:  # Variants in ECU Extract
                category=REQUIREMENT_ITEM
                date=2008-08-29
                issued-by=WP Methodology&Templates
                type=valid
                importance=High
                description=p=l-1=The ECU Extract shall support variability of elements taken over or derived during the transformation from the System Description.
                rationale=p=l-1=Data mapping and communication variants (see RS_SYST_00035, RS_SYST_00036) may have to be preserved in artifacts, which are generated out of a System Description (e.g. ECU-Extract), if the binding time is at a later point in the process.
                use-case=p=l-1=Pdu Layout is postbuild configurable during the ECU Configuration, variability needs to be visible at build time.
                conflicts=p=l-1=None identified.
                supporting-material=p=l-1=--
                remark=p=l-1=--
            chap_3a_Suort_for_Parial_Neting__4b9228b0  # Support for Partial Networking
              structured req RS_SYST_00042:  # Support for Partial Networking
                category=REQUIREMENT_ITEM
                date=2011-06-07
                issued-by=WP Methodology&Templates
                type=valid
                importance=high
                description=p=l-1=System Template shall support the definition of partial network clusters, the mapping of virtual function clusters to partial network clusters and the wakeup information of individual ECUs.
                rationale=p=l-1=System Template shall contain all system relevant parameters required for the configuration of a partial network.
                use-case=p=l-1=Describe the size and location of the system wide partial network cluster vector.
                conflicts=p=l-1=None identified.
                supporting-material=p=l-1=--
                remark=p=l-1=--
            chap_3a_Comion_via_Comlex_Driers__e9ddb3b6  # Communication via Complex Drivers
              structured req RS_SYST_00043:  # Communication via Complex Drivers
                category=REQUIREMENT_ITEM
                date=2012-07-12
                issued-by=WP Methodology&Templates
                type=valid
                importance=high
                description=p=l-1=System Template shall support the Pdu-based communication via Complex Drivers.
                rationale=p=l-1=It shall be possible to describe the Complex Driver Pdus that are transmitted over the network.
                use-case=p=l-1=A new BSW module is used above the PduR, e.g a Diagnostic Service.
                conflicts=p=l-1=None identified.
                supporting-material=p=l-1=--
                remark=p=l-1=--
            chap_3a_Desion_of_custom_bus_sysems__1087ae81  # Description of custom bus systems
              structured req RS_SYST_00044:  # Description of custom bus systems
                category=REQUIREMENT_ITEM
                date=2012-07-12
                issued-by=WP Methodology&Templates
                type=valid
                importance=high
                description=p=l-1=System Template shall support the integration of custom bus systems on the topology level.
                rationale=p=l-1=It shall be possible to describe the complete network topology of a vehicle with a System Description.
                use-case=p=l-1=Alternative communication technologies (e.g. I2C, USB, serial line) are integrated as Complex Drivers
                conflicts=p=l-1=None identified.
                supporting-material=p=l-1=--
                remark=p=l-1=--
            chap_3a_Co_2d_ing_System_artcts_in_the_same_model__8f7248c5  # Co-existing System artifacts in the same model
              structured req RS_SYST_00045:  # Co-existing System artifacts in the same model
                category=REQUIREMENT_ITEM
                date=2012-07-12
                issued-by=WP Methodology&Templates
                type=valid
                importance=high
                description=p=l-1=The System Template shall provide means to describe different System Extracts, which can co exist with the complete system description and each other in the same model.
                rationale=p=l-1=--
                use-case=p=l-1=The OEM hands a system extract over to the supplier, as a formal "requirement" specification. The supplier extends and refactors this system extract. In the next development cycle the OEM hands over an updated system extract to the supplier. The supplier updates his system extract according to the update of the OEM.
                conflicts=p=l-1=None identified.
                supporting-material=p=l-1=tt=RS_METH_00077
                remark=p=l-1=--
            chap_3a_Difent_views_on_the_sysm_27_s_SWCure__c48b597f  # Different views on the system's SWC-structure
              structured req RS_SYST_00046:  # Different views on the system's SWC-structure
                category=REQUIREMENT_ITEM
                date=2012-07-12
                issued-by=WP Methodology&Templates
                type=valid
                importance=high
                description=p=l-1=The System Template shall provide means to describe the different views on the SWC-structure and the mapping between their elements.
                rationale=p=l-1=--
                use-case=p=l-1=Different views on the SWC-structure at an OEM: Functional view (independent of ECUs) and ECU-topological view
                conflicts=p=l-1=None identified.
                supporting-material=p=l-1=[RS_METH_00078, RS_METH_00079]
                remark=p=l-1=--
            chap_3a_Netork_and_phycal_repion_on_signal_level__be7a4e92  # Network and physical representation on signal level
              structured req RS_SYST_00047: category=REQUIREMENT_ITEM, date=2012-07-12, issued-by=WP Methodology&Templates, type=valid, importance=high, description=p=l-1=The System Template shall provide means to describe the physical representation and the network representation of signals., rationale=p=l-1=--, use-case=p=l-1=--, conflicts=p=l-1=None identified., supporting-material=p=l-1=--, remark=p=l-1=--  # Network and physical representation on signal level
            chap_3a_CAN_with_Fleble_Datate__b4d089cf  # CAN with Flexible Data-Rate
              structured req RS_SYST_00048:  # CAN with Flexible Data-Rate
                category=REQUIREMENT_ITEM
                date=2012-11-27
                issued-by=WP Methodology&Templates
                type=valid
                importance=high
                description=p=l-1=The System Template shall support the CAN FD protocol.
                rationale=p=l-1=CAN FD increases the bandwidth of a CAN network and allows payload larger than 8 byte.
                use-case=p=l-1=Development of a complete, multi-networked, in-vehicle electronic architecture
                conflicts=p=l-1=None identified.
                supporting-material=p=l-1=--
                remark=p=l-1=--
            chap_3a_Suort_of_Effent_COM_for_large_data_conion__5d5e4b4d  # Support of Efficient COM for large data configuration
              structured req RS_SYST_00049:  # Support of Efficient COM for large data configuration
                category=REQUIREMENT_ITEM
                date=2014-07-04
                issued-by=WP Methodology&Templates
                type=valid
                importance=high
                description=p=l-1=The System Template shall support the configuration of communication over Efficient COM for large data.
                rationale=p=l-1=Efficient COM for large data provides a lean mechanism how the interaction of RTE with the Communication Stack is handled. There are however some prerequisites which need to be fulfilled if this interaction shall be done via Efficient COM for large data. The System Template shall define these prerequisites.
                use-case=p=l-1=IPdus which only contain one signal and have no special transmission mode defined can be processed by Efficient COM for large data.
                conflicts=p=l-1=None identified.
                supporting-material=p=l-1=--
                remark=p=l-1=--
            chap_3a_Data_traion_of_intECU_comion__b8a71db1  # Data transformation of inter-ECU communication
              structured req RS_SYST_00050:  # Data transformation of inter-ECU communication
                category=REQUIREMENT_ITEM
                description=p=l-1=The System Template shall provide the means to describe data transformation for inter-ECU communication.
                rationale=p=l-1=If data of an inter-ECU communication shall be transformed, this has to be configured within the System to enable sending and receiving ECUs to execute the data transformation.
                use-case=p=l-1=Large composite data shall be mapped in one go to bus communication to avoid the mapping of each atomic element of the composite data.
                supporting-material=p=l-1=--
            chap_3a_Suort_of_COM_Based_Data_Traion__d33f387e  # Support of COM Based Data Transformation
              structured req RS_SYST_00051:  # Support of COM Based Data Transformation
                category=REQUIREMENT_ITEM
                description=p=l-1=The System Template shall provide the means to define the usage of the uint8-array API to pass the serialized representation of a composite data to COM module.
                rationale=p=l-1=The AUTOSAR transformer chain provides means to serialize composite data into a uint8-array representation. This serialized uint8-array shall be passed as one entity to COM.
                use-case=p=l-1=Usage of transformer with COM based serialization and Com Interaction to enable the communication with ECUs running AUTOSAR R4.1 versions and earlier.
                supporting-material=p=l-1=--
            chap_3a_Naming_conons__26a99d47: p=l-1=Please note that the System Template does not define specific naming conventions.  # Naming conventions
              structured req RS_SYST_00053:  # The System Template shall provide the ability to define naming conventions for public symbols
                category=REQUIREMENT_ITEM
                date=2014-08-28
                issued-by=AUTOSAR PL Team
                type=valid
                description=p=l-1=The System Template shall provide the ability to define naming conventions for public symbols. This especially includes requirement ids, module abbreviations, meta data and configuration symbols used in the document of a release
                rationale=p=l-1=Avoid ambiguities and name clashes inside the specification. Provide a consistent uniform presentation of meta data to the reader of the specification. Allow automatic processing of specification elements
                conflicts=p=l-1=--
                supporting-material=p=l-1=--
            chap_3a_Suort_of_Secred_Pdus__333aba21  # Support of Secured Pdus
              structured req RS_SYST_00054: category=REQUIREMENT_ITEM, description=p=l-1=The System Template shall support the definition of Secured Pdus., rationale=p=l-1=It shall be possible to define a Pdu that is supplemented with additional Authentication Information., use-case=p=l-1=Protection of Pdus against unauthorized manipulation and replay attacks., supporting-material=p=l-1=--  # Support of Secured Pdus
            chap_3a_Suort_of_Conner_Pdus__242683ab  # Support of Container Pdus
              structured req RS_SYST_00055: category=REQUIREMENT_ITEM, description=p=l-1=The System Template shall support the definition of Container Pdus., rationale=p=l-1=It shall be possible to define that one Container Pdu shall transport several contained Pdus., use-case=p=l-1=Routing of Pdus from a network onto a network with higher payload possibility (e.g. CAN onto CanFD or Ethernet)., supporting-material=p=l-1=--  # Support of Container Pdus
            chap_3a_E2Eted_comion__28f1bb1c  # E2E-protected communication
              structured req RS_SYST_00056: category=REQUIREMENT_ITEM, description=p=l-1=The System Template has to cover the protection of communication via E2E., rationale=p=l-1=Enables safety-related communication over non-safety-related communication buses., use-case=p=l-1=Development of a complete, multi-networked, in-vehicle electronic architecture., supporting-material=p=l-1=--  # E2E-protected communication
            chap_3a_Assing_comion_graphs_to_parlar_RTE_Impion_PluIns__3b867bbe  # Assigning communication graphs to particular RTE Implementation Plug-Ins
              structured req RS_SYST_00057: category=REQUIREMENT_ITEM, type=draft, description=p=l-1=The System Template shall support to assign communication graphs of software components to particular RTE Implementation Plug-Ins., rationale=p=l-1=The RTE of an ECU is build modularized with RTE Implementation Plug-Ins. Each communication graph is handled by a specific RTE Implementation Plug-In., use-case=p=l-1=--, supporting-material=p=l-1=--  # Assigning communication graphs to particular RTE Implementation Plug-Ins
            chap_3a_Optnal_Elents__d35d7e39  # Optional Elements
              structured req RS_SYST_00058:  # The System Template shall support the usage of the TLV encoding in SOME/IP messages
                category=REQUIREMENT_ITEM
                type=draft
                description=p=l-1=The System Template shall provide means to configure a SOME/IP transformer to consider TLV encoding according to the system model
                rationale=p=l-1=The existence of optional elements in composite data structures is semantically different from the receiver simply taking an initial value if the received information does not contain a respective sub-element of a composite data structure. The receiver is supposed to actively acknowledge the fact that certain information is missing and still be able to deal with this fact in a meaningful way.
                use-case=p=l-1=A composite data structure that qualifies for TLV encoding is defined and used for communication on the VFB. The SOME/IP transformer configured for this composite data structure needs to take the specification of the tLV encoding into account
                conflicts=p=l-1=--
                supporting-material=p=l-1=--
                remark=p=l-1=--
      chapter chap_3a_Change_Hisory__77c84f6a  # Change History
        10 x chapter:
          chap_3a_Change_Hisory_for_AUTSAR_4_2e_0_2e_1_aganst_3_2e_1_2e_5__f8ae3622  # Change History for AUTOSAR 4.0.1 against 3.1.5
            chapter chap_3a_Remved_SRS_Items__3a7567d1  # Removed SRS Items
              table tgroup=tbody=[[p=l-1=e=Number, p=l-1=e=Heading], [p=l-1=tt=RS_SYST_00004, p=l-1=Variant Handling], [p=l-1=tt=RS_SYST_00005, p=l-1=Timing Requirements]]:
                table caption table_3a_RemovedSpecitems4_2e_0_2e_1  # Removed Specification Items in 4.0.1
            chapter chap_3a_Chaged_SRS_Items__714a86bd  # Changed SRS Items
              table tgroup=tbody=[[p=l-1=e=Number, p=l-1=e=Heading], [p=l-1=RS_SYST_00001, p=l-1=Mixed Systems (AUTOSAR/NON-AUTOSAR)], [p=l-1=RS_SYST_00007, p=l-1=Mapping of Software Components to ECUs]]:
                table caption table_3a_ChangedSpecitems4_2e_0_2e_1  # Changed Specification Items in 4.0.1
            chapter chap_3a_Added_SRS_Items__488e03d3  # Added SRS Items
              table tgroup=tbody=[[p=l-1=e=Number, p=l-1=e=Heading], [p=l-1=RS_SYST_00027, p=l-1=ECU Extract generation rules], [p=l-1=RS_SYST_00028, p=l-1=IPdu End-to-End Communication Protection support], [p=l-1=RS_SYST_00029, p=l-1=Dynamic length signals], [p=l-1=RS_SYST_00030, p=l-1=Dynamic length IPdus], [p=l-1=RS_SYST_00031, p=l-1=Distribution of Application and Vehicle Mode Requests], [p=l-1=RS_SYST_00032, p=l-1=Topology variants], [p=l-1=RS_SYST_00033, p=l-1=Software-to-ECU mapping variants], [p=l-1=RS_SYST_00034, p=l-1=Timing variants], [p=l-1=RS_SYST_00035, p=l-1=Data mapping variants], [p=l-1=RS_SYST_00036, p=l-1=Communication variants], [p=l-1=RS_SYST_00037, p=l-1=Timing properties], [p=l-1=RS_SYST_00038, p=l-1=Support of SAE J1939 Protocol Features], [p=l-1=RS_SYST_00039, p=l-1=ECU Communication via Ethernet], [p=l-1=RS_SYST_00040, p=l-1=Timing constraints], [p=l-1=RS_SYST_00041, p=l-1=Variants in ECU Extract]]:
                table caption table_3a_AddedSpecitems4_2e_0_2e_1  # Added Specification Items in 4.0.1
          chap_3a_Change_Hisory_for_AUTSAR_4_2e_0_2e_2_aganst_4_2e_0_2e_1__d9324925  # Change History for AUTOSAR 4.0.2 against 4.0.1
            chapter chap_3a_Remved_SRS_Items__9b795c01: p=l-1=N/A  # Removed SRS Items
            chapter chap_3a_Chaged_SRS_Items__ca338843: p=l-1=N/A  # Changed SRS Items
            chapter chap_3a_Added_SRS_Items__c8bc89ca: p=l-1=N/A  # Added SRS Items
          chap_3a_Change_Hisory_for_AUTSAR_4_2e_0_2e_3_aganst_4_2e_0_2e_2__f07a3c52  # Change History for AUTOSAR 4.0.3 against 4.0.2
            chapter chap_3a_Remved_SRS_Items__16d97174: p=l-1=N/A  # Removed SRS Items
            chapter chap_3a_Chaged_SRS_Items__96bda736: p=l-1=N/A  # Changed SRS Items
            chapter chap_3a_Added_SRS_Items__96203e1f  # Added SRS Items
              table tgroup=tbody=[[p=l-1=e=Number, p=l-1=e=Heading], [p=l-1=RS_SYST_00042, p=l-1=Support for Partial Networking]]:
                table caption table_3a_AddedSpecitems4_2e_0_2e_3  # Added Specification Items in 4.0.3
          chap_3a_Change_Hisory_for_AUTSAR_4_2e_1_2e_1_aganst_4_2e_0_2e_3__95aa02fb  # Change History for AUTOSAR 4.1.1 against 4.0.3
            4 x chapter:
              chap_3a_Remved_SRS_Items__88d08f9d: p=l-1=N/A  # Removed SRS Items
              chap_3a_Chaged_SRS_Items__8328784a: p=l-1=N/A  # Changed SRS Items
              chap_3a_Added_SRS_Items__021c7e7b  # Added SRS Items
              chap_3a_Added_SRS_Items__021c7e7b  # Added SRS Items
                table tgroup=tbody=[[p=l-1=e=Number, p=l-1=e=Heading], [p=l-1=RS_SYST_00043, p=l-1=Communication via Complex Device Drivers], [p=l-1=RS_SYST_00044, p=l-1=Description of custom bus systems], [p=l-1=RS_SYST_00045, p=l-1=Co-existing System artifacts in the same model], [p=l-1=RS_SYST_00046, p=l-1=Different views on the system's SWC-structure], [p=l-1=RS_SYST_00047, p=l-1=Network and physical representation on signal level], [p=l-1=RS_SYST_00048, p=l-1=CAN with Flexible Data-Rate]]:
                  table caption table_3a_AddedSpecitems4_2e_1_2e_1  # Added Specification Items in 4.1.1
          chap_3a_Change_Hisory_for_AUTSAR_4_2e_1_2e_1_aganst_4_2e_1_2e_2__0f59fc88  # Change History for AUTOSAR 4.1.1 against 4.1.2
            chapter chap_3a_Remved_SRS_Items__3648d824: p=l-1=N/A  # Removed SRS Items
            chapter chap_3a_Chaged_SRS_Items__b588283a: p=l-1=N/A  # Changed SRS Items
            chapter chap_3a_Added_SRS_Items__65350fea: p=l-1=N/A  # Added SRS Items
          chap_3a_Change_Hisory_for_AUTSAR_4_2e_1_2e_2_aganst_4_2e_2_2e_1__78fc2303  # Change History for AUTOSAR 4.1.2 against 4.2.1
            chapter chap_3a_Remved_SRS_Items__e1ac8cbe: p=l-1=N/A  # Removed SRS Items
            chapter chap_3a_Chaged_SRS_Items__993e45e8  # Changed SRS Items
              table tgroup=tbody=[[p=l-1=e=Number, p=l-1=e=Heading], [p=l-1=RS_SYST_00014, p=l-1=Data Segmentation]]:
                table caption table_3a_ChangedSpecitems4_2e_2_2e_1  # Changed Specification Items in 4.2.1
            chapter chap_3a_Added_SRS_Items__62e8e466  # Added SRS Items
              table tgroup=tbody=[[p=l-1=e=Number, p=l-1=e=Heading], [p=l-1=RS_SYST_00049, p=l-1=Support of Efficient COM for large data configuration], [p=l-1=RS_SYST_00050, p=l-1=Data transformation of inter-ECU communication], [p=l-1=RS_SYST_00051, p=l-1=Support of COM Based Data Transformation], [p=l-1=RS_SYST_00052, p=l-1=Ethernet Switch Configuration], [p=l-1=RS_SYST_00053, p=l-1=Naming conventions], [p=l-1=RS_SYST_00054, p=l-1=Support of Secured Pdus], [p=l-1=RS_SYST_00055, p=l-1=Support of Container Pdus], [p=l-1=RS_SYST_00056, p=l-1=E2E-protected communication]]:
                table caption table_3a_AddedSpecitems4_2e_2_2e_1  # Added Specification Items in 4.2.1
          chap_3a_Change_Hisory_for_AUTSAR_4_2e_2_2e_1_aganst_4_2e_2_2e_2__da27f989  # Change History for AUTOSAR 4.2.1 against 4.2.2
            chapter chap_3a_Remved_SRS_Items__aee3f421: p=l-1=N/A  # Removed SRS Items
            chapter chap_3a_Chaged_SRS_Items__132f34e4: p=l-1=N/A  # Changed SRS Items
            chapter chap_3a_Added_SRS_Items__226b3fd3: p=l-1=N/A  # Added SRS Items
          chap_3a_Change_Hisory_for_AUTSAR_4_2e_2_2e_2_aganst_4_2e_3_2e_0__1b64b2f9  # Change History for AUTOSAR 4.2.2 against 4.3.0
            chapter chap_3a_Added_Trales_in_4_2e_3_2e_0__a9ab77e1: p=l-1=none  # Added Traceables in 4.3.0
            chapter chap_3a_Chaged_Trales_in_4_2e_3_2e_0__a16d69db: p=l-1=none  # Changed Traceables in 4.3.0
            chapter chap_3a_Dltd_Trales_in_4_2e_3_2e_0__919f4a4e  # Deleted Traceables in 4.3.0
              table tgroup=tbody=[[p=l-1=e=Id, p=l-1=e=Heading], [p=l-1=tt=RS_SYST_00010, p=l-1=Exclusive Mapping of SWCs], [p=l-1=tt=RS_SYST_00011, p=l-1=Dedicated Mapping of SWCs]]:
                table caption table_3a_Deleted_Traceables_in_4_2e_3_2e_0  # Deleted Traceables in 4.3.0
          chap_3a_Change_Hisory_for_AUTSAR_4_2e_3_2e_0_aganst_4_2e_3_2e_1__b33cacb3  # Change History for AUTOSAR 4.3.0 against 4.3.1
            chapter chap_3a_Added_Trales_in_4_2e_3_2e_1__52768e1d: p=l-1=none  # Added Traceables in 4.3.1
            chapter chap_3a_Chaged_Trales_in_4_2e_3_2e_1__20d247fe: p=l-1=none  # Changed Traceables in 4.3.1
            chapter chap_3a_Dltd_Trales_in_4_2e_3_2e_1__76a945bc: p=l-1=none  # Deleted Traceables in 4.3.1
          chap_3a_Change_Hisory_for_AUTSAR_4_2e_3_2e_1_aganst_4_2e_4_2e_0__c76820b1  # Change History for AUTOSAR 4.3.1 against 4.4.0
            chapter chap_3a_Added_Trales_in_4_2e_4_2e_0__97c56c4b  # Added Traceables in 4.4.0
              table tgroup={thead=row=[p=l-1=e=Number, p=l-1=e=Heading], tbody=[[p=l-1=tt=RS_SYST_00057, p=l-1=Assigning communication graphs to particular RTE Implementation Plug-Ins], [p=l-1=tt=RS_SYST_00058, p=l-1=The System Template shall support the usage of the TLV encoding in SOME/IP messages]]}:
                table caption Added_Traceables_in_4_2e_4_2e_0  # Added Traceables in 4.4.0
            chapter chap_3a_Chaged_Trales_in_4_2e_4_2e_0__a83793fc: p=l-1=none  # Changed Traceables in 4.4.0
            chapter chap_3a_Dltd_Trales_in_4_2e_4_2e_0__3771a6e3: p=l-1=none  # Deleted Traceables in 4.4.0
