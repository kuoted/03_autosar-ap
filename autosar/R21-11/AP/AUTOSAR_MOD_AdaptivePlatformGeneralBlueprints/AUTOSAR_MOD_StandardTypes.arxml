AUTOSAR XML (schema 00050)
package /AUTOSAR/StdTypes
  11 x std cpp implementation data type, all with category=VALUE:
    bool: type-emitter=FundamentalType
    float: type-emitter=FundamentalType
    double: type-emitter=FundamentalType
    int8_t: header-file=cstdint
    int16_t: header-file=cstdint
    int32_t: header-file=cstdint
    int64_t: header-file=cstdint
    uint8_t: header-file=cstdint
    uint16_t: header-file=cstdint
    uint32_t: header-file=cstdint
    uint64_t: header-file=cstdint
